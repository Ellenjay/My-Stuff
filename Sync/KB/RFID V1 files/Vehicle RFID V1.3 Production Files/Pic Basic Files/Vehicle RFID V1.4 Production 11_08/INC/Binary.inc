Split: 
	   B1 = CE[0]
	   B2 = 0
	   B2.3 = B1.7
	   B2.2 = B1.6
	   B2.1 = B1.5
	   B2.0 = B1.4
	   EmpIN[0] = B2
	   B2 = 0
	   B2.3 = B1.3
	   B2.2 = B1.2
	   B2.1 = B1.1
	   B2.0 = B1.0
	   EmpIN[1] = B2
	   
	   B1 = CE[1]
	   B2 = 0
	   B2.3 = B1.7
	   B2.2 = B1.6
	   B2.1 = B1.5
	   B2.0 = B1.4
	   EmpIN[2] = B2
	   B2 = 0
	   B2.3 = B1.3
	   B2.2 = B1.2
	   B2.1 = B1.1
	   B2.0 = B1.0
	   EmpIN[3] = B2	
	   
	   B1 = CE[2]
	   B2 = 0
	   B2.3 = B1.7
	   B2.2 = B1.6
	   B2.1 = B1.5
	   B2.0 = B1.4
	   EmpIN[4] = B2
	   B2 = 0
	   B2.3 = B1.3
	   B2.2 = B1.2
	   B2.1 = B1.1
	   B2.0 = B1.0
	   EmpIN[5] = B2		

Return	
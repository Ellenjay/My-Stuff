
	LIST
;{
;FILE F1 = C:\MY PROTON\PROTON  MAR 2012\CWRITE_TEST.BAS
;FILE F2 = C:\MY PROTON\PROTON  MAR 2012\CWRITE_TEST.PRP
;}

;[VARIABLE LISTING]
;INDEX1,0007,DT_BYTE,1
;INDEX2,0008,DT_BYTE,1
;PROMADDRESS,0009,DT_WORD,2
;MEMORYPOINTER,000B,DT_WORD,2
;TEMPB1,000D,DT_BYTE,1
;TEMPB2,000E,DT_BYTE,1
;DELAYUSBVALUE,0010,DT_BYTE,1
;DELAYCOUNT,0011,DT_BYTE,1
;USBINBUFFER,0012,DT_BYTE,64
;USBOUTBUFFER,0052,DT_BYTE,64
;USBCOMMANDIN,0012,DT_BYTE,1
;OFFSETREADALIAS,0013,DT_BYTE,1
;STARTADDRESSALIAS,0013,DT_DWORD,4
;BYTECOUNTALIAS,0017,DT_BYTE,1
;DATASTARTALIAS,0018,DT_BYTE,1
;NOT_RABPU,0FF1.7,DT_BIT
;RABIF,0FF2.0,DT_BIT
;USBDPLUS,0F80.0,DT_BIT
;FSR_0,0FE9,DT_WORD,2
;FSR_0H,0FEA,DT_BYTE,1
;BOOTOK,000F.0,DT_BIT
;EEPROMADDRESSALIAS,0013,DT_BYTE,1
;CARRY_FLAG,0FD8.0,DT_BIT
;TRNIF,0F62.3,DT_BIT
;[END LISTING]
;[TOTAL VARS] 146

#DEFINE CONFIG_REQ 1


UEP0 EQU 0X0F53
UEP1 EQU 0X0F54
UEP2 EQU 0X0F55
UEP3 EQU 0X0F56
UEP4 EQU 0X0F57
UEP5 EQU 0X0F58
UEP6 EQU 0X0F59
UEP7 EQU 0X0F5A
UEIE EQU 0X0F5B
UADDR EQU 0X0F5C
UFRML EQU 0X0F5D
UFRMLH EQU 0X0F5E
UFRMH EQU 0X0F5E
UEIR EQU 0X0F5F
UIE EQU 0X0F60
UCFG EQU 0X0F61
UIR EQU 0X0F62
USTAT EQU 0X0F63
UCON EQU 0X0F64
SRCON0 EQU 0X0F68
SRCON1 EQU 0X0F69
CM2CON0 EQU 0X0F6B
CM2CON1 EQU 0X0F6C
CM1CON0 EQU 0X0F6D
SSPMSK EQU 0X0F6F
SLRCON EQU 0X0F76
WPUA EQU 0X0F77
WPUB EQU 0X0F78
IOCA EQU 0X0F79
IOCB EQU 0X0F7A
ANSEL EQU 0X0F7E
ANSELH EQU 0X0F7F
PORTA EQU 0X0F80
PORTB EQU 0X0F81
PORTC EQU 0X0F82
LATA EQU 0X0F89
LATB EQU 0X0F8A
LATC EQU 0X0F8B
DDRA EQU 0X0F92
TRISA EQU 0X0F92
DDRB EQU 0X0F93
TRISB EQU 0X0F93
DDRC EQU 0X0F94
TRISC EQU 0X0F94
OSCTUNE EQU 0X0F9B
PIE1 EQU 0X0F9D
PIR1 EQU 0X0F9E
IPR1 EQU 0X0F9F
PIE2 EQU 0X0FA0
PIR2 EQU 0X0FA1
IPR2 EQU 0X0FA2
EECON1 EQU 0X0FA6
EECON2 EQU 0X0FA7
EEDATL EQU 0X0FA8
EEDATA EQU 0X0FA8
EEADR EQU 0X0FA9
EEADRH EQU 0X0FAA
RCSTA EQU 0X0FAB
TXSTA EQU 0X0FAC
TXREG EQU 0X0FAD
RCREG EQU 0X0FAE
SPBRG EQU 0X0FAF
SPBRGH EQU 0X0FB0
T3CON EQU 0X0FB1
TMR3L EQU 0X0FB2
TMR3LH EQU 0X0FB3
TMR3H EQU 0X0FB3
ECCP1AS EQU 0X0FB6
PWM1CON EQU 0X0FB7
BAUDCON EQU 0X0FB8
BAUDCTL EQU 0X0FB8
PSTRCON EQU 0X0FB9
REFCON0 EQU 0X0FBA
REFCON1 EQU 0X0FBB
REFCON2 EQU 0X0FBC
CCP1CON EQU 0X0FBD
CCPR1 EQU 0X0FBE
CCPR1L EQU 0X0FBE
CCPR1LH EQU 0X0FBF
CCPR1H EQU 0X0FBF
ADCON2 EQU 0X0FC0
ADCON1 EQU 0X0FC1
ADCON0 EQU 0X0FC2
ADRES EQU 0X0FC3
ADRESL EQU 0X0FC3
ADRESLH EQU 0X0FC4
ADRESH EQU 0X0FC4
SSPCON2 EQU 0X0FC5
SSPCON1 EQU 0X0FC6
SSPSTAT EQU 0X0FC7
SSPADD EQU 0X0FC8
SSPBUF EQU 0X0FC9
T2CON EQU 0X0FCA
PR2 EQU 0X0FCB
TMR2 EQU 0X0FCC
T1CON EQU 0X0FCD
TMR1L EQU 0X0FCE
TMR1LH EQU 0X0FCF
TMR1H EQU 0X0FCF
RCON EQU 0X0FD0
WDTCON EQU 0X0FD1
OSCCON2 EQU 0X0FD2
OSCCON EQU 0X0FD3
T0CON EQU 0X0FD5
TMR0L EQU 0X0FD6
TMR0LH EQU 0X0FD7
TMR0H EQU 0X0FD7
STATUS EQU 0X0FD8
FSR2L EQU 0X0FD9
FSR2LH EQU 0X0FDA
FSR2H EQU 0X0FDA
PLUSW2 EQU 0X0FDB
PREINC2 EQU 0X0FDC
POSTDEC2 EQU 0X0FDD
POSTINC2 EQU 0X0FDE
INDF2 EQU 0X0FDF
BSR EQU 0X0FE0
FSR1L EQU 0X0FE1
FSR1LH EQU 0X0FE2
FSR1H EQU 0X0FE2
PLUSW1 EQU 0X0FE3
PREINC1 EQU 0X0FE4
POSTDEC1 EQU 0X0FE5
POSTINC1 EQU 0X0FE6
INDF1 EQU 0X0FE7
WREG EQU 0X0FE8
FSR0L EQU 0X0FE9
FSR0LH EQU 0X0FEA
FSR0H EQU 0X0FEA
PLUSW0 EQU 0X0FEB
PREINC0 EQU 0X0FEC
POSTDEC0 EQU 0X0FED
POSTINC0 EQU 0X0FEE
INDF0 EQU 0X0FEF
INTCON3 EQU 0X0FF0
INTCON2 EQU 0X0FF1
INTCON EQU 0X0FF2
PRODL EQU 0X0FF3
PRODLH EQU 0X0FF4
PRODH EQU 0X0FF4
TABLAT EQU 0X0FF5
TBLPTRL EQU 0X0FF6
TBLPTRLH EQU 0X0FF7
TBLPTRH EQU 0X0FF7
TBLPTRLHH EQU 0X0FF8
TBLPTRLHHH EQU 0X0FE8
TBLPTRU EQU 0X0FF8
PC EQU 0X0FF9
PCL EQU 0X0FF9
PCLATH EQU 0X0FFA
PCLATU EQU 0X0FFB
STKPTR EQU 0X0FFC
TOSL EQU 0X0FFD
TOSLH EQU 0X0FFE
TOSH EQU 0X0FFE
TOSU EQU 0X0FFF
_I2C_SCL_PORT = TRISB
_I2C_SCL_PIN = 6
_I2C_SDA_PORT = TRISB
_I2C_SDA_PIN = 4
EPSTALL=0
PP_EPSTALL=0
EPINEN=1
EPOUTEN=2
EPCONDIS=3
EPHSHK=4
PIDEE=0
CRC5EE=1
CRC16EE=2
DFN8EE=3
BTOEE=4
BTSEE=7
ADDR0=0
ADDR1=1
ADDR2=2
ADDR3=3
ADDR4=4
ADDR5=5
ADDR6=6
FRM0=0
FRM1=1
FRM2=2
FRM3=3
FRM4=4
FRM5=5
FRM6=6
FRM7=7
FRM8=0
FRM9=1
FRM10=2
PIDEF=0
CRC5EF=1
CRC16EF=2
DFN8EF=3
BTOEF=4
BTSEF=7
URSTIE=0
PP_URSTIE=0
UERRIE=1
PP_UERRIE=1
ACTVIE=2
PP_ACTVIE=2
TRNIE=3
PP_TRNIE=3
IDLEIE=4
PP_IDLEIE=4
STALLIE=5
PP_STALLIE=5
SOFIE=6
PP_SOFIE=6
PPB0=0
PPB1=1
FSEN=2
UPUEN=4
UTEYE=7
URSTIF=0
PP_URSTIF=0
UERRIF=1
PP_UERRIF=1
ACTVIF=2
PP_ACTVIF=2
TRNIF=3
PP_TRNIF=3
IDLEIF=4
PP_IDLEIF=4
STALLIF=5
PP_STALLIF=5
SOFIF=6
PP_SOFIF=6
PPBI=1
DIR=2
ENDP0=3
ENDP1=4
ENDP2=5
SUSPND=1
PP_SUSPND=1
RESUME=2
PP_RESUME=2
USBEN=3
PP_USBEN=3
PKTDIS=4
PP_PKTDIS=4
SE0=5
PP_SE0=5
PPBRST=6
SRPR=0
SRPS=1
SRNQEN=2
SRQEN=3
SRCLK0=4
SRCLK1=5
SRCLK2=6
SRLEN=7
SRRC1E=0
SRRC2E=1
SRRCKE=2
SRRPE=3
SRSC1E=4
SRSC2E=5
SRSCKE=6
SRSPE=7
C2CH0=0
C2CH1=1
C2R=2
C2SP=3
C2POL=4
C2OE=5
C2OUT=6
C2ON=7
C2SYNC=0
C1SYNC=1
C2HYS=2
C1HYS=3
C2RSEL=4
C1RSEL=5
MC2OUT=6
MC1OUT=7
C1CH0=0
C1CH1=1
C1R=2
C1SP=3
C1POL=4
C1OE=5
C1OUT=6
C1ON=7
MSK0=0
MSK1=1
MSK2=2
MSK3=3
MSK4=4
MSK5=5
MSK6=6
MSK7=7
SLRA=0
SLRB=1
SLRC=2
WPUA3=3
WPUA4=4
WPUA5=5
WPUB4=4
WPUB5=5
WPUB6=6
WPUB7=7
IOCA0=0
IOCA1=1
IOCA3=3
IOCA4=4
IOCA5=5
IOCB4=4
IOCB5=5
IOCB6=6
IOCB7=7
ANS3=3
ANS4=4
ANS5=5
ANS6=6
ANS7=7
ANS8=0
ANS9=1
ANS10=2
ANS11=3
RA0=0
RA1=1
RA3=3
RA4=4
RA5=5
AN3=4
OSC2=4
OSC1=5
CLKOUT=4
CLKIN=5
RB4=4
RB5=5
RB6=6
RB7=7
SDI=4
RX=5
SCL=6
TX=7
SDA=4
SCK=6
CK=7
AN10=4
AN11=5
RC0=0
RC1=1
RC2=2
RC3=3
RC4=4
RC5=5
RC6=6
RC7=7
AN4=0
AN5=1
AN6=2
AN7=3
AN8=6
AN9=7
C12INP=0
C12IN1M=1
C12IN2M=2
C12IN3M=3
C12OUT=4
INT0=0
INT1=1
INT2=2
PGM=3
SRQ=4
T0CKI=5
T13CKI=6
T1OSCO=7
VREFP=0
VREFM=1
CVREF=2
T1OSCI=6
P1D=2
P1C=3
P1B=4
P1A=5
SS=6
SDO=7
CCP1=5
NOT_SS=6
LATA4=4
LATA5=5
LATB4=4
LATB5=5
LATB6=6
LATB7=7
LATC0=0
LATC1=1
LATC2=2
LATC3=3
LATC4=4
LATC5=5
LATC6=6
LATC7=7
TRISA4=4
TRISA5=5
TRISB4=4
TRISB5=5
TRISB6=6
TRISB7=7
TRISC0=0
TRISC1=1
TRISC2=2
TRISC3=3
TRISC4=4
TRISC5=5
TRISC6=6
TRISC7=7
TUN0=0
TUN1=1
TUN2=2
TUN3=3
TUN4=4
TUN5=5
SPLLEN=6
INTSRC=7
TMR1IE=0
TMR2IE=1
CCP1IE=2
SSPIE=3
TXIE=4
RCIE=5
ADIE=6
TMR1IF=0
TMR2IF=1
CCP1IF=2
SSPIF=3
TXIF=4
PP_TXIF=4
RCIF=5
PP_RCIF=5
ADIF=6
TMR1IP=0
TMR2IP=1
CCP1IP=2
SSPIP=3
TXIP=4
RCIP=5
ADIP=6
TMR3IE=1
USBIE=2
BCLIE=3
EEIE=4
C2IE=5
C1IE=6
OSCFIE=7
TMR3IF=1
USBIF=2
BCLIF=3
EEIF=4
C2IF=5
C1IF=6
OSCFIF=7
TMR3IP=1
USBIP=2
BCLIP=3
EEIP=4
C2IP=5
C1IP=6
OSCFIP=7
RD=0
PP_RD=0
WR=1
PP_WR=1
WREN=2
PP_WREN=2
WRERR=3
FREE=4
CFGS=6
EEPGD=7
PP_EEPGD=7
EEADR0=0
EEADR1=1
EEADR2=2
EEADR3=3
EEADR4=4
EEADR5=5
EEADR6=6
EEADR7=7
EEADR8=0
EEADR9=1
RX9D=0
OERR=1
PP_OERR=1
FERR=2
ADDEN=3
CREN=4
PP_CREN=4
SREN=5
RX9=6
SPEN=7
ADEN=3
TX9D=0
TRMT=1
BRGH=2
SENDB=3
SYNC=4
TXEN=5
TX9=6
CSRC=7
TMR3ON=0
TMR3CS=1
T3SYNC=2
T3CCP1=3
T3CKPS0=4
T3CKPS1=5
RD16=7
NOT_T3SYNC=2
PSSBD0=0
PSSBD1=1
PSSAC0=2
PSSAC1=3
ECCPAS0=4
ECCPAS1=5
ECCPAS2=6
ECCPASE=7
PDC0=0
PDC1=1
PDC2=2
PDC3=3
PDC4=4
PDC5=5
PDC6=6
PRSEN=7
ABDEN=0
WUE=1
BRG16=3
CKTXP=4
DTRXP=5
RCIDL=6
ABDOVF=7
SCKP=4
STRA=0
STRB=1
STRC=2
STRD=3
STRSYNC=4
TSRS=2
TSEN=3
FVR1S0=4
FVR1S1=5
FVR1ST=6
FVR1EN=7
D1NSS=0
D1PSS0=2
D1PSS1=3
DAC1OE=5
D1LPS=6
D1EN=7
DAC1R0=0
DAC1R1=1
DAC1R2=2
DAC1R3=3
DAC1R4=4
CCP1M0=0
CCP1M1=1
CCP1M2=2
CCP1M3=3
DC1B0=4
DC1B1=5
P1M0=6
P1M1=7
ADCS0=0
ADCS1=1
ADCS2=2
ACQT0=3
ACQT1=4
ACQT2=5
ADFM=7
NVCFG0=0
NVCFG1=1
PVCFG0=2
PVCFG1=3
ADON=0
PP_ADON=0
GO=1
CHS0=2
CHS1=3
CHS2=4
CHS3=5
DONE=1
NOT_DONE=1
GO_DONE=1
PP_GO_DONE=1
SEN=0
PP_SEN=0
RSEN=1
PP_RSEN=1
PEN=2
PP_PEN=2
RCEN=3
PP_RCEN=3
ACKEN=4
PP_ACKEN=4
ACKDT=5
PP_ACKDT=5
ACKSTAT=6
GCEN=7
SSPM0=0
SSPM1=1
SSPM2=2
SSPM3=3
CKP=4
SSPEN=5
SSPOV=6
WCOL=7
BF=0
UA=1
R=2
S=3
P=4
D=5
CKE=6
SMP=7
NOT_W=2
NOT_A=5
R_W=2
PP_R_W=2
D_A=5
NOT_WRITE=2
NOT_ADDRESS=5
T2CKPS0=0
PP_T2CKPS0=0
T2CKPS1=1
PP_T2CKPS1=1
TMR2ON=2
PP_TMR2ON=2
T2OUTPS0=3
T2OUTPS1=4
T2OUTPS2=5
T2OUTPS3=6
TMR1ON=0
TMR1CS=1
T1SYNC=2
T1OSCEN=3
T1CKPS0=4
T1CKPS1=5
T1RUN=6
NOT_T1SYNC=2
BOR=0
POR=1
PD=2
TO=3
RI=4
SBOREN=6
IPEN=7
NOT_BOR=0
NOT_POR=1
NOT_PD=2
NOT_TO=3
NOT_RI=4
SWDTEN=0
SWDTE=0
LFIOFS=0
HFIOFL=1
PRI_SD=2
SCS0=0
SCS1=1
IOFS=2
OSTS=3
IRCF0=4
IRCF1=5
IRCF2=6
IDLEN=7
T0PS0=0
T0PS1=1
T0PS2=2
PSA=3
T0SE=4
T0CS=5
T08BIT=6
TMR0ON=7
C=0
DC=1
Z=2
OV=3
N=4
INT1F=0
INT2F=1
INT1E=3
INT2E=4
INT1P=6
INT2P=7
INT1IF=0
INT2IF=1
INT1IE=3
INT2IE=4
INT1IP=6
INT2IP=7
RABIP=0
TMR0IP=2
INTEDG2=4
INTEDG1=5
INTEDG0=6
RABPU=7
NOT_RABPU=7
RABIF=0
INT0F=1
TMR0IF=2
RABIE=3
INT0E=4
TMR0IE=5
PEIE=6
GIE=7
INT0IF=1
T0IF=2
INT0IE=4
T0IE=5
GIEL=6
GIEH=7
SP0=0
SP1=1
SP2=2
SP3=3
SP4=4
STKUNF=6
STKOVF=7
STKFUL=7
  __MAXRAM  0X0FFF
  __BADRAM  0X0300-0X0F3F
  __BADRAM  0X0F65-0X0F67
  __BADRAM  0X0F6A
  __BADRAM  0X0F6E
  __BADRAM  0X0F70-0X0F75
  __BADRAM  0X0F7B-0X0F7D
  __BADRAM  0X0F83-0X0F88
  __BADRAM  0X0F8C-0X0F91
  __BADRAM  0X0F95-0X0F9A
  __BADRAM  0X0F9C
  __BADRAM  0X0FA3-0X0FA5
  __BADRAM  0X0FB4-0X0FB5
  __BADRAM  0X0FD4
CONFIG1L EQU 0X300000
CONFIG1H EQU 0X300001
CONFIG2L EQU 0X300002
CONFIG2H EQU 0X300003
CONFIG3H EQU 0X300005
CONFIG4L EQU 0X300006
CONFIG5L EQU 0X300008
CONFIG5H EQU 0X300009
CONFIG6L EQU 0X30000A
CONFIG6H EQU 0X30000B
CONFIG7L EQU 0X30000C
CONFIG7H EQU 0X30000D
CPU_DIV_NOCLKDIV_1 EQU 0XE7
CPU_DIV_CLKDIV2_1 EQU 0XEF
CPU_DIV_CLKDIV3_1 EQU 0XF7
CPU_DIV_CLKDIV4_1 EQU 0XFF
USB_LSCLK_OFF_1 EQU 0XDF
USB_LSCLK_ON_1 EQU 0XFF
FOSC_LP_1 EQU 0XF0
FOSC_XT_1 EQU 0XF1
FOSC_HS_1 EQU 0XF2
FOSC_ERCCLKOUT_1 EQU 0XF3
FOSC_ECCLKOUTH_1 EQU 0XF4
FOSC_ECH_1 EQU 0XF5
FOSC_ERC_1 EQU 0XF7
FOSC_IRC_1 EQU 0XF8
FOSC_IRCCLKOUT_1 EQU 0XF9
FOSC_ECCLKOUTM_1 EQU 0XFA
FOSC_ECM_1 EQU 0XFB
FOSC_ECCLKOUTL_1 EQU 0XFC
FOSC_ECL_1 EQU 0XFD
PLL_EN_OFF_1 EQU 0XEF
PLL_EN_ON_1 EQU 0XFF
PRI_CLK_EN_OFF_1 EQU 0XDF
PRI_CLK_EN_ON_1 EQU 0XFF
FCMEN_OFF_1 EQU 0XBF
FCMEN_ON_1 EQU 0XFF
IESO_OFF_1 EQU 0X7F
IESO_ON_1 EQU 0XFF
PWRT_ON_2 EQU 0XFE
PWRT_OFF_2 EQU 0XFF
BOREN_OFF_2 EQU 0XF9
BOREN_ON_2 EQU 0XFB
BOREN_NOSLP_2 EQU 0XFD
BOREN_SBORDIS_2 EQU 0XFF
BORV_30_2 EQU 0XE7
BORV_27_2 EQU 0XEF
BORV_22_2 EQU 0XF7
BORV_18_2 EQU 0XFF
VREGEN_OFF_2 EQU 0XDF
VREGEN_ON_2 EQU 0XFF
WDTEN_OFF_2 EQU 0XFE
WDTEN_ON_2 EQU 0XFF
WDTPS_1_2 EQU 0XE1
WDTPS_2_2 EQU 0XE3
WDTPS_4_2 EQU 0XE5
WDTPS_8_2 EQU 0XE7
WDTPS_16_2 EQU 0XE9
WDTPS_32_2 EQU 0XEB
WDTPS_64_2 EQU 0XED
WDTPS_128_2 EQU 0XEF
WDTPS_256_2 EQU 0XF1
WDTPS_512_2 EQU 0XF3
WDTPS_1024_2 EQU 0XF5
WDTPS_2048_2 EQU 0XF7
WDTPS_4096_2 EQU 0XF9
WDTPS_8192_2 EQU 0XFB
WDTPS_16384_2 EQU 0XFD
WDTPS_32768_2 EQU 0XFF
MCLRE_OFF_3 EQU 0X7F
MCLRE_ON_3 EQU 0XFF
HFOFST_OFF_3 EQU 0XF7
HFOFST_ON_3 EQU 0XFF
STVREN_OFF_4 EQU 0XFE
STVREN_ON_4 EQU 0XFF
LVP_OFF_4 EQU 0XFB
LVP_ON_4 EQU 0XFF
BBSIZ_OFF_4 EQU 0XF7
BBSIZ_ON_4 EQU 0XFF
XINST_OFF_4 EQU 0XBF
XINST_ON_4 EQU 0XFF
BKBUG_ON_4 EQU 0X7F
BKBUG_OFF_4 EQU 0XFF
CP0_ON_5 EQU 0XFE
CP0_OFF_5 EQU 0XFF
CP1_ON_5 EQU 0XFD
CP1_OFF_5 EQU 0XFF
CPB_ON_5 EQU 0XBF
CPB_OFF_5 EQU 0XFF
CPD_ON_5 EQU 0X7F
CPD_OFF_5 EQU 0XFF
WRT0_ON_6 EQU 0XFE
WRT0_OFF_6 EQU 0XFF
WRT1_ON_6 EQU 0XFD
WRT1_OFF_6 EQU 0XFF
WRTB_ON_6 EQU 0XBF
WRTB_OFF_6 EQU 0XFF
WRTC_ON_6 EQU 0XDF
WRTC_OFF_6 EQU 0XFF
WRTD_ON_6 EQU 0X7F
WRTD_OFF_6 EQU 0XFF
EBTR0_ON_7 EQU 0XFE
EBTR0_OFF_7 EQU 0XFF
EBTR1_ON_7 EQU 0XFD
EBTR1_OFF_7 EQU 0XFF
EBTRB_ON_7 EQU 0XBF
EBTRB_OFF_7 EQU 0XFF
DEVID1 EQU 0X3FFFFE
DEVID2 EQU 0X3FFFFF
IDLOC0 EQU 0X200000
__IDLOC0 EQU 0X200000
IDLOC1 EQU 0X200001
__IDLOC1 EQU 0X200001
IDLOC2 EQU 0X200002
__IDLOC2 EQU 0X200002
IDLOC3 EQU 0X200003
__IDLOC3 EQU 0X200003
IDLOC4 EQU 0X200004
__IDLOC4 EQU 0X200004
IDLOC5 EQU 0X200005
__IDLOC5 EQU 0X200005
IDLOC6 EQU 0X200006
__IDLOC6 EQU 0X200006
IDLOC7 EQU 0X200007
__IDLOC7 EQU 0X200007



#DEFINE __18F14K50 1
#DEFINE XTAL 24
#DEFINE _CORE 16
#DEFINE _MAXRAM 512
#DEFINE _RAM_END 768
#DEFINE _MAXMEM 16384
#DEFINE _ADC 11
#DEFINE _ADC_RES 10
#DEFINE _EEPROM 256
#DEFINE RAM_BANKS 3
#DEFINE _USART 1
#DEFINE _USB 1
#DEFINE _USB#RAM_START 512
#DEFINE _FLASH 1
#DEFINE _CWRITE_BLOCK 16
#DEFINE BANK0_START 96
#DEFINE BANK0_END 255
#DEFINE BANK1_START 256
#DEFINE BANK1_END 511
#DEFINE BANK2_START 512
#DEFINE BANK2_END 767
#DEFINE BANKA_START 0
#DEFINE BANKA_END 95
#DEFINE _SYSTEM_VARIABLE_COUNT 7
RAM_BANK = 0
#DEFINE LCD#TYPE 0
#DEFINE __HIGH_INTERRUPTS_ENABLED 1
#DEFINE __LOW_INTERRUPTS_ENABLED 1
NOLIST
IFDEF HLVDCON
NOLIST
IFNDEF LVDCON

#DEFINE LVDCON HLVDCON
NOLIST
ENDIF
NOLIST
ENDIF

#DEFINE CLRW CLRF WREG
#DEFINE NEGW NEGF WREG
#DEFINE SKPC BTFSS STATUS,0
#DEFINE SKPNC BTFSC STATUS,0
#DEFINE CLRC BCF STATUS,0
#DEFINE SETC BSF STATUS,0
#DEFINE SKPZ BTFSS STATUS,2
#DEFINE SKPNZ BTFSC STATUS,2
#DEFINE CLRZ BCF STATUS,2
#DEFINE SETZ BSF STATUS,2


NOLIST
MOVFW MACRO PVARIN


    ERROR "CANNOT USE THE MOVFW MACRO DIRECTLY WHEN USING OPTIMISATION. USE MOVF VAR,W"
NOLIST
    ENDM

NOLIST
RLF MACRO PVARIN,PDESTINATION


    ERROR "CANNOT USE THE RLF MACRO DIRECTLY WHEN USING OPTIMISATION. USE RLCF"
NOLIST
    ENDM

NOLIST
RRF MACRO PVARIN,PDESTINATION


    ERROR "CANNOT USE THE RRF MACRO DIRECTLY WHEN USING OPTIMISATION. USE RRCF"
NOLIST
    ENDM

NOLIST
JUMP MACRO PLABEL


    ERROR "CANNOT USE THE JUMP MACRO DIRECTLY WHEN USING OPTIMISATION. USE GOTO"
NOLIST
    ENDM


NOLIST
F@CALL MACRO PDESTINATION


    ERROR "CANNOT USE THE F@CALL MACRO DIRECTLY WHEN USING OPTIMISATION"
NOLIST
    ENDM

NOLIST
F@JUMP MACRO PDESTINATION


    ERROR "CANNOT USE THE F@JUMP MACRO DIRECTLY WHEN USING OPTIMISATION"
NOLIST
    ENDM

NOLIST
NOLIST
IFDEF WATCHDOG_REQ

NOLIST
NOLIST
    CHK@SLF MACRO PDESTINATION

NOLIST
NOLIST
IF ($ == PDESTINATION)


    CLRWDT
NOLIST
NOLIST
ENDIF


NOLIST
    ENDM

NOLIST
ENDIF


NOLIST
G@OTO MACRO PDESTINATION


    ERROR "CANNOT USE THE G@OTO MACRO DIRECTLY WHEN USING OPTIMISATION"
NOLIST
    ENDM

NOLIST
GO@TO MACRO PDESTINATION


    ERROR "CANNOT USE THE GO@TO MACRO DIRECTLY WHEN USING OPTIMISATION"
NOLIST
    ENDM

NOLIST
S@B MACRO PVARIN

NOLIST
NOLIST
IF ((PVARIN > BANKA_END) & (PVARIN < 0X0F80))


NOLIST
NOLIST
IF ((PVARIN & 0X0F00) != (RAM_BANK << 8))


    MOVLB HIGH (PVARIN)
RAM_BANK = (PVARIN >> 8)
NOLIST
NOLIST
ENDIF

NOLIST
NOLIST
ENDIF


NOLIST
    ENDM

NOLIST
R@B MACRO

NOLIST
NOLIST
IF(RAM_BANK != 0)


    MOVLB 0
RAM_BANK = 0
NOLIST
NOLIST
ENDIF


NOLIST
    ENDM

NOLIST
WREG_BYTE MACRO PBYTEOUT

NOLIST
NOLIST
IF(PBYTEOUT <= BANKA_END)


    MOVWF PBYTEOUT
NOLIST
NOLIST
ELSE


    MOVFF WREG,PBYTEOUT
NOLIST
NOLIST
ENDIF


NOLIST
    ENDM

NOLIST
WREG_BIT MACRO PVAROUT,PBITOUT

NOLIST
    S@B PVAROUT

    BTFSC WREG,0
    BSF PVAROUT,PBITOUT
    BTFSS WREG,0
    BCF PVAROUT,PBITOUT
NOLIST
    R@B

NOLIST
    ENDM

NOLIST
WREG_WORD MACRO PWORDOUT


    MOVFF WREG,PWORDOUT
    MOVLW 0
    MOVFF WREG,PWORDOUT+1
NOLIST
    ENDM

NOLIST
WREG_DWORD MACRO PDWORDOUT


    MOVFF WREG,PDWORDOUT
    MOVLW 0
    MOVFF WREG,PDWORDOUT+3
    MOVFF WREG,PDWORDOUT+2
    MOVFF WREG,PDWORDOUT+1
NOLIST
    ENDM

NOLIST
BYTE_WREG MACRO PBYTEIN

NOLIST
NOLIST
IF(PBYTEIN <= BANKA_END)


    MOVF PBYTEIN,W
NOLIST
NOLIST
ELSE


    MOVFF PBYTEIN,WREG
NOLIST
NOLIST
ENDIF


NOLIST
    ENDM

NOLIST
NUM_SFR MACRO PNUMIN,PSFROUT

NOLIST
NOLIST
IF(PNUMIN == 0)


    CLRF PSFROUT
NOLIST
NOLIST
ELSE


NOLIST
NOLIST
IF(PNUMIN == 255)


    SETF PSFROUT
NOLIST
NOLIST
ELSE


    MOVLW PNUMIN
    MOVWF PSFROUT
NOLIST
NOLIST
ENDIF


NOLIST
NOLIST
ENDIF


NOLIST
    ENDM

NOLIST
NUM_WREG MACRO PNUMIN

NOLIST
NOLIST
IF(PNUMIN < 256)


    MOVLW PNUMIN
NOLIST
NOLIST
ELSE


    MOVLW (PNUMIN & 255)
NOLIST
NOLIST
ENDIF


NOLIST
    ENDM

NOLIST
NUM_BYTE MACRO PNUMIN,PBYTEOUT


    MOVLW PNUMIN
NOLIST
NOLIST
IF(PBYTEOUT > (0X0FFF - BANKA_END))


    MOVWF PBYTEOUT
NOLIST
    EXITM
NOLIST
ENDIF


NOLIST
NOLIST
IF(PBYTEOUT > BANKA_END)


    MOVFF WREG,PBYTEOUT
NOLIST
NOLIST
ELSE

NOLIST
    S@B PBYTEOUT

    MOVWF PBYTEOUT
NOLIST
    R@B
NOLIST
NOLIST
ENDIF


NOLIST
    ENDM

NOLIST
NUM_BIT MACRO PNUMIN,PVAROUT,PBITOUT

NOLIST
    S@B PVAROUT
NOLIST
NOLIST
IF((PNUMIN & 1) == 1)


    BSF PVAROUT,PBITOUT
NOLIST
NOLIST
ELSE


    BCF PVAROUT,PBITOUT
NOLIST
NOLIST
ENDIF

NOLIST
    R@B

NOLIST
    ENDM

NOLIST
NUM_WORD MACRO PNUMIN,PWORDOUT

NOLIST

    MOVLW (PNUMIN & 255)
NOLIST
NOLIST
IF(PWORDOUT > BANKA_END)


    MOVFF WREG,PWORDOUT
NOLIST
NOLIST
ELSE

NOLIST
    S@B PWORDOUT

    MOVFF WREG,PWORDOUT
NOLIST
NOLIST
ENDIF

NOLIST

    MOVLW HIGH (PNUMIN)
NOLIST
NOLIST
IF(PWORDOUT+1 > BANKA_END)


    MOVFF WREG,PWORDOUT+1
NOLIST
NOLIST
ELSE

NOLIST
    S@B PWORDOUT+1

    MOVWF PWORDOUT+1
NOLIST
NOLIST
ENDIF

NOLIST
NOLIST
IF(PWORDOUT > BANKA_END)

NOLIST
    R@B
NOLIST
NOLIST
ENDIF


NOLIST
    ENDM

NOLIST
NUM_DWORD MACRO PNUMIN,PDWORDOUT

NOLIST
    S@B PDWORDOUT

    MOVLW LOW (PNUMIN)
    MOVWF PDWORDOUT
NOLIST
    S@B PDWORDOUT+1

    MOVLW HIGH (PNUMIN)
    MOVWF PDWORDOUT+1
NOLIST
    S@B PDWORDOUT+2

    MOVLW ((PNUMIN >> 16) & 255)
    MOVWF PDWORDOUT+2
NOLIST
    S@B PDWORDOUT+3

    MOVLW ((PNUMIN >> 24) & 255)
    MOVWF PDWORDOUT+3
NOLIST
    R@B

NOLIST
    ENDM

NOLIST
BIT_WREG MACRO PVARIN,PBITIN

NOLIST
    S@B PVARIN

    CLRF WREG
    BTFSC PVARIN,PBITIN
    MOVLW 1
NOLIST
    R@B

NOLIST
    ENDM

NOLIST
BIT_BYTE MACRO PVARIN,PBITIN,PBYTEOUT

NOLIST
    S@B PVARIN

    CLRF WREG
    BTFSC PVARIN,PBITIN
    MOVLW 1
NOLIST
    S@B PBYTEOUT

    MOVWF PBYTEOUT
NOLIST
    R@B

NOLIST
    ENDM

NOLIST
BIT_BIT MACRO PVARIN,PBITIN,PVAROUT,PBITOUT

NOLIST
NOLIST
IF ((PVARIN & 0X0F00) == (PVAROUT & 0X0F00))

NOLIST
    S@B PVARIN

    BTFSC PVARIN,PBITIN
    BSF PVAROUT,PBITOUT
    BTFSS PVARIN,PBITIN
    BCF PVAROUT,PBITOUT
NOLIST
NOLIST
ELSE

NOLIST
IF ((PVARIN <= BANKA_END) | (PVARIN >= 0X0F80))

NOLIST
    S@B PVAROUT

    BTFSC PVARIN,PBITIN
    BSF PVAROUT,PBITOUT
    BTFSS PVARIN,PBITIN
    BCF PVAROUT,PBITOUT
NOLIST
NOLIST
ELSE

NOLIST
NOLIST
IF ((PVAROUT <= BANKA_END) | (PVAROUT >= 0X0F80))

NOLIST
    S@B PVARIN

    BTFSC PVARIN,PBITIN
    BSF PVAROUT,PBITOUT
    BTFSS PVARIN,PBITIN
    BCF PVAROUT,PBITOUT
NOLIST
NOLIST
ELSE

NOLIST
    S@B PVARIN

    CLRDC
    BTFSC PVARIN,PBITIN
    SETDC
NOLIST
    S@B PVAROUT

    SKPNDC
    BSF PVAROUT,PBITOUT
    SKPDC
    BCF PVAROUT,PBITOUT
NOLIST
NOLIST
ENDIF

NOLIST
NOLIST
ENDIF

NOLIST
NOLIST
ENDIF

NOLIST
    R@B

NOLIST
    ENDM

NOLIST
BIT_WORD MACRO PVARIN,PBITIN,PWORDOUT

NOLIST
    S@B PWORDOUT+1

    CLRF PWORDOUT+1
NOLIST
    BIT_BYTE PVARIN,PBITIN,PWORDOUT

NOLIST
    ENDM

NOLIST
BIT_DWORD MACRO PVARIN,PBITIN,PDWORDOUT

NOLIST
    S@B PDWORDOUT+3

    CLRF PDWORDOUT+3
NOLIST
    S@B PDWORDOUT+2

    CLRF PDWORDOUT+2
NOLIST
    S@B PDWORDOUT+1

    CLRF PDWORDOUT+1
NOLIST
    BIT_BYTE PVARIN,PBITIN,PDWORDOUT

NOLIST
    ENDM

NOLIST
BYTE_BYTE MACRO PBYTEIN,PBYTEOUT


    MOVFF PBYTEIN,PBYTEOUT
NOLIST
    ENDM

NOLIST
BYTE_WORD MACRO PBYTEIN,PWORDOUT


    MOVLW 0
    MOVFF WREG,PWORDOUT+1
    MOVFF PBYTEIN,PWORDOUT
NOLIST
    ENDM

NOLIST
BYTE_DWORD MACRO PBYTEIN,PDWORDOUT


    MOVLW 0
    MOVFF WREG,PDWORDOUT+3
    MOVFF WREG,PDWORDOUT+2
    MOVFF WREG,PDWORDOUT+1
    MOVFF PBYTEIN,PDWORDOUT
NOLIST
    ENDM

NOLIST
BYTE_BIT MACRO PBYTEIN,PVAROUT,PBITOUT

NOLIST
NOLIST
IF ((PBYTEIN & 0X0F00) == (PVAROUT & 0X0F00))

NOLIST
    S@B PBYTEIN

    BTFSC PBYTEIN,0
    BSF PVAROUT,PBITOUT
    BTFSS PBYTEIN,0
    BCF PVAROUT,PBITOUT
NOLIST
NOLIST
ELSE

NOLIST
NOLIST
IF ((PBYTEIN <= BANKA_END) | (PBYTEIN >= 0X0F80))

NOLIST
    S@B PVAROUT

    BTFSC PBYTEIN,0
    BSF PVAROUT,PBITOUT
    BTFSS PBYTEIN,0
    BCF PVAROUT,PBITOUT
NOLIST
NOLIST
ELSE

NOLIST
NOLIST
IF ((PVAROUT <= BANKA_END) | (PVAROUT >= 0X0F80))

NOLIST
    S@B PBYTEIN

    BTFSC PBYTEIN,0
    BSF PVAROUT,PBITOUT
    BTFSS PBYTEIN,0
    BCF PVAROUT,PBITOUT
NOLIST
NOLIST
ELSE

NOLIST
    S@B PBYTEIN

    RRF PBYTEIN,W
NOLIST
    S@B PVAROUT

    SKPNC
    BSF PVAROUT,PBITOUT
    SKPC
    BCF PVAROUT,PBITOUT
NOLIST
NOLIST
ENDIF

NOLIST
NOLIST
ENDIF

NOLIST
NOLIST
ENDIF

NOLIST
    R@B

NOLIST
    ENDM

NOLIST
WORD_WREG MACRO PWORDIN

NOLIST
NOLIST
IF(PWORDIN <= BANKA_END)


    MOVF PWORDIN,W
NOLIST
NOLIST
ELSE


    MOVFF PWORDIN,WREG
NOLIST
NOLIST
ENDIF


NOLIST
    ENDM

NOLIST
WORD_BYTE MACRO PWORDIN,PBYTEOUT


    MOVFF PWORDIN,PBYTEOUT
NOLIST
    ENDM

NOLIST
WORD_BIT MACRO PWORDIN,PVAROUT,PBITOUT

NOLIST
    BYTE_BIT PWORDIN, PVAROUT, PBITOUT

NOLIST
    ENDM

NOLIST
WORD_WORD MACRO PWORDIN,PWORDOUT


    MOVFF PWORDIN+1,PWORDOUT+1
    MOVFF PWORDIN,PWORDOUT
NOLIST
    ENDM

NOLIST
WORD_DWORD MACRO PWORDIN,PDWORDOUT


    MOVLW 0
    MOVFF WREG,PDWORDOUT+3
    MOVFF WREG,PDWORDOUT+2
NOLIST
    WORD_WORD PWORDIN,PDWORDOUT

NOLIST
    ENDM

NOLIST
DWORD_WREG MACRO PDWORDIN

NOLIST
NOLIST
IF(PDWORDIN <= BANKA_END)


    MOVF PDWORDIN,W
NOLIST
NOLIST
ELSE


    MOVFF PDWORDIN,WREG
NOLIST
NOLIST
ENDIF


NOLIST
    ENDM

NOLIST
DWORD_BYTE MACRO PDWORDIN,PBYTEOUT


    MOVFF PDWORDIN,PBYTEOUT
NOLIST
    ENDM

NOLIST
DWORD_WORD MACRO PDWORDIN,PWORDOUT


    MOVFF PDWORDIN+1,PWORDOUT+1
    MOVFF PDWORDIN,PWORDOUT
NOLIST
    ENDM

NOLIST
DWORD_DWORD MACRO PDWORDIN,PDWORDOUT

NOLIST
NOLIST
IF(PDWORDIN != PDWORDOUT)


    MOVFF PDWORDIN+3,PDWORDOUT+3
    MOVFF PDWORDIN+2,PDWORDOUT+2
    MOVFF PDWORDIN+1,PDWORDOUT+1
    MOVFF PDWORDIN,PDWORDOUT
NOLIST
NOLIST
ENDIF


NOLIST
    ENDM

NOLIST
DWORD_BIT MACRO PDWORDIN,PVAROUT,PBITOUT

NOLIST
    BYTE_BIT PDWORDIN,PVAROUT,PBITOUT

NOLIST
    ENDM

NOLIST
NUM_FLOAT MACRO PNUMIN,PFLOATOUT

NOLIST
    NUM_BYTE PNUMIN,PFLOATOUT+3
    NUM_BYTE ((PNUMIN >> 8) & 255),PFLOATOUT+2
    NUM_BYTE ((PNUMIN >> 16) & 255),PFLOATOUT+1
    NUM_BYTE ((PNUMIN >> 24) & 255),PFLOATOUT

NOLIST
    ENDM

NOLIST
WREG_FLOAT MACRO PFLOATOUT


    CALL INT08@TOFL32
    MOVFF PP_AARG,PFLOATOUT
    MOVFF PP_AARGH,PFLOATOUT+1
    MOVFF PP_AARGHH,PFLOATOUT+2
    MOVFF PP_AARGHHH,PFLOATOUT+3
NOLIST
    ENDM

NOLIST
BIT_FLOAT MACRO PVARIN,PBITIN,PFLOATOUT

NOLIST
    BIT_WREG PVARIN,PBITIN

    CALL INT08@TOFL32
    MOVFF PP_AARG,PFLOATOUT
    MOVFF PP_AARGH,PFLOATOUT+1
    MOVFF PP_AARGHH,PFLOATOUT+2
    MOVFF PP_AARGHHH,PFLOATOUT+3
NOLIST
    ENDM

NOLIST
BYTE_FLOAT MACRO PBYTEIN,PFLOATOUT

NOLIST
NOLIST
IF(PBYTEIN <= BANKA_END)


    MOVF PBYTEIN,W
NOLIST
NOLIST
ELSE


    MOVFF PBYTEIN,WREG
NOLIST
NOLIST
ENDIF


    CALL INT08@TOFL32
    MOVFF PP_AARG,PFLOATOUT
    MOVFF PP_AARGH,PFLOATOUT+1
    MOVFF PP_AARGHH,PFLOATOUT+2
    MOVFF PP_AARGHHH,PFLOATOUT+3
NOLIST
    ENDM

NOLIST
WORD_FLOAT MACRO PWORDIN,PFLOATOUT


    MOVFF PWORDIN PP_AARG
    MOVFF PWORDIN+1 PP_AARGH
    CALL INT16@TOFL32
    MOVFF PP_AARG,PFLOATOUT
    MOVFF PP_AARGH,PFLOATOUT+1
    MOVFF PP_AARGHH,PFLOATOUT+2
    MOVFF PP_AARGHHH,PFLOATOUT+3
NOLIST
    ENDM

NOLIST
DWORD_FLOAT MACRO PDWORDIN,PFLOATOUT


    MOVFF PDWORDIN,PP_AARG
    MOVFF PDWORDIN+1,PP_AARGH
    MOVFF PDWORDIN+2,PP_AARGHH
    MOVFF PDWORDIN+3,PP_AARGHHH
    CALL INT32@TOFL32
    MOVFF PP_AARG,PFLOATOUT
    MOVFF PP_AARGH,PFLOATOUT+1
    MOVFF PP_AARGHH,PFLOATOUT+2
    MOVFF PP_AARGHHH,PFLOATOUT+3
NOLIST
    ENDM

NOLIST
FLOAT_FLOAT MACRO PFLOATIN,PFLOATOUT

NOLIST
NOLIST
IF(PFLOATIN != PFLOATOUT)


    MOVFF PFLOATIN,PFLOATOUT
    MOVFF PFLOATIN+1,PFLOATOUT+1
    MOVFF PFLOATIN+2,PFLOATOUT+2
    MOVFF PFLOATIN+3,PFLOATOUT+3
NOLIST
NOLIST
ENDIF


NOLIST
    ENDM

NOLIST
FLOAT_WREG MACRO PFLOATIN

NOLIST
    FLOAT_FLOAT PFLOATIN,PP_AARG

    CALL FL32@TOINT32
NOLIST
    ENDM

NOLIST
FLOAT_BIT MACRO PFLOATIN,PVAROUT,PBITOUT

NOLIST
    FLOAT_FLOAT PFLOATIN,PP_AARG

    CALL FL32@TOINT32
NOLIST
    WREG_BIT PVAROUT,PBITOUT

NOLIST
    ENDM

NOLIST
FLOAT_BYTE MACRO PFLOATIN,PBYTEOUT

NOLIST
    FLOAT_FLOAT PFLOATIN,PP_AARG

    CALL FL32@TOINT32
NOLIST
NOLIST
IF(PBYTEOUT <= BANKA_END)


    MOVWF PBYTEOUT
NOLIST
NOLIST
ELSE


    MOVFF WREG,PBYTEOUT
NOLIST
NOLIST
ENDIF


NOLIST
    ENDM

NOLIST
FLOAT_WORD MACRO PFLOATIN,PWORDOUT

NOLIST
    FLOAT_FLOAT PFLOATIN,PP_AARG

    CALL FL32@TOINT32
    MOVFF PP_AARGHHH,PWORDOUT
    MOVFF PP_AARGHH,PWORDOUT+1
NOLIST
    ENDM

NOLIST
FLOAT_DWORD MACRO PFLOATIN,PDWORDOUT

NOLIST
    FLOAT_FLOAT PFLOATIN,PP_AARG

    CALL FL32@TOINT32
    MOVFF PP_AARGHHH,PDWORDOUT
    MOVFF PP_AARGHH,PDWORDOUT+1
    MOVFF PP_AARGH,PDWORDOUT+2
    MOVFF PP_AARG,PDWORDOUT+3
NOLIST
    ENDM

NOLIST
NUM_FSR0 MACRO PNUMIN


    LFSR 0, PNUMIN
NOLIST
    ENDM

NOLIST
NUM_FSR1 MACRO PNUMIN


    LFSR 1, PNUMIN
NOLIST
    ENDM

NOLIST
NUM_FSR2 MACRO PNUMIN


    LFSR 2, PNUMIN
NOLIST
    ENDM

NOLIST
LABEL_WORD MACRO PLABELIN,PWORDOUT

NOLIST
NOLIST
IF(PWORDOUT >= (0X0FFF - BANKA_END))


    MOVLW LOW (PLABELIN)
    MOVWF PWORDOUT
    MOVLW HIGH (PLABELIN)
    MOVWF PWORDOUT+1
NOLIST
    EXITM
NOLIST
ELSE


    MOVLW LOW (PLABELIN)
    MOVFF WREG, PWORDOUT
    MOVLW HIGH (PLABELIN)
    MOVFF WREG, PWORDOUT+1
NOLIST
    EXITM
NOLIST
ENDIF


NOLIST
NOLIST
IF(PWORDOUT <= BANKA_END)


    MOVLW LOW (PLABELIN)
    MOVWF PWORDOUT
    MOVLW HIGH (PLABELIN)
    MOVWF PWORDOUT+1
NOLIST
NOLIST
ELSE


    MOVLW LOW (PLABELIN)
    MOVFF WREG, PWORDOUT
    MOVLW HIGH (PLABELIN)
    MOVFF WREG, PWORDOUT+1
NOLIST
NOLIST
ENDIF


NOLIST
    ENDM

LABEL_POINTER MACRO PLABELIN

    MOVLW LOW (PLABELIN)
    MOVWF TBLPTRL
    MOVLW HIGH (PLABELIN)
    MOVWF TBLPTRH
    MOVLW UPPER (PLABELIN)
    MOVWF TBLPTRU
NOLIST
    ENDM




GEN = 0
PBP#VAR0 = 1
PP0 = 2
PP0H = 3
PP1 = 4
PP1H = 5
PP2 = 6
INDEX1 = 7
INDEX2 = 8
PROMADDRESS = 9
PROMADDRESSH = 10
MEMORYPOINTER = 11
MEMORYPOINTERH = 12
TEMPB1 = 13
TEMPB2 = 14
_B#VR1 = 15
DELAYUSBVALUE = 16
DELAYCOUNT = 17
USBINBUFFER = 18
VARIABLE USBINBUFFER#0=18,USBINBUFFER#1=19,USBINBUFFER#2=20,USBINBUFFER#3=21
VARIABLE USBINBUFFER#4=22,USBINBUFFER#5=23,USBINBUFFER#6=24,USBINBUFFER#7=25
VARIABLE USBINBUFFER#8=26,USBINBUFFER#9=27,USBINBUFFER#10=28,USBINBUFFER#11=29
VARIABLE USBINBUFFER#12=30,USBINBUFFER#13=31,USBINBUFFER#14=32,USBINBUFFER#15=33
VARIABLE USBINBUFFER#16=34,USBINBUFFER#17=35,USBINBUFFER#18=36,USBINBUFFER#19=37
VARIABLE USBINBUFFER#20=38,USBINBUFFER#21=39,USBINBUFFER#22=40,USBINBUFFER#23=41
VARIABLE USBINBUFFER#24=42,USBINBUFFER#25=43,USBINBUFFER#26=44,USBINBUFFER#27=45
VARIABLE USBINBUFFER#28=46,USBINBUFFER#29=47,USBINBUFFER#30=48,USBINBUFFER#31=49
VARIABLE USBINBUFFER#32=50,USBINBUFFER#33=51,USBINBUFFER#34=52,USBINBUFFER#35=53
VARIABLE USBINBUFFER#36=54,USBINBUFFER#37=55,USBINBUFFER#38=56,USBINBUFFER#39=57
VARIABLE USBINBUFFER#40=58,USBINBUFFER#41=59,USBINBUFFER#42=60,USBINBUFFER#43=61
VARIABLE USBINBUFFER#44=62,USBINBUFFER#45=63,USBINBUFFER#46=64,USBINBUFFER#47=65
VARIABLE USBINBUFFER#48=66,USBINBUFFER#49=67,USBINBUFFER#50=68,USBINBUFFER#51=69
VARIABLE USBINBUFFER#52=70,USBINBUFFER#53=71,USBINBUFFER#54=72,USBINBUFFER#55=73
VARIABLE USBINBUFFER#56=74,USBINBUFFER#57=75,USBINBUFFER#58=76,USBINBUFFER#59=77
VARIABLE USBINBUFFER#60=78,USBINBUFFER#61=79,USBINBUFFER#62=80,USBINBUFFER#63=81
USBOUTBUFFER = 82
VARIABLE USBOUTBUFFER#0=82,USBOUTBUFFER#1=83,USBOUTBUFFER#2=84,USBOUTBUFFER#3=85
VARIABLE USBOUTBUFFER#4=86,USBOUTBUFFER#5=87,USBOUTBUFFER#6=88,USBOUTBUFFER#7=89
VARIABLE USBOUTBUFFER#8=90,USBOUTBUFFER#9=91,USBOUTBUFFER#10=92,USBOUTBUFFER#11=93
VARIABLE USBOUTBUFFER#12=94,USBOUTBUFFER#13=95,USBOUTBUFFER#14=96,USBOUTBUFFER#15=97
VARIABLE USBOUTBUFFER#16=98,USBOUTBUFFER#17=99,USBOUTBUFFER#18=100,USBOUTBUFFER#19=101
VARIABLE USBOUTBUFFER#20=102,USBOUTBUFFER#21=103,USBOUTBUFFER#22=104,USBOUTBUFFER#23=105
VARIABLE USBOUTBUFFER#24=106,USBOUTBUFFER#25=107,USBOUTBUFFER#26=108,USBOUTBUFFER#27=109
VARIABLE USBOUTBUFFER#28=110,USBOUTBUFFER#29=111,USBOUTBUFFER#30=112,USBOUTBUFFER#31=113
VARIABLE USBOUTBUFFER#32=114,USBOUTBUFFER#33=115,USBOUTBUFFER#34=116,USBOUTBUFFER#35=117
VARIABLE USBOUTBUFFER#36=118,USBOUTBUFFER#37=119,USBOUTBUFFER#38=120,USBOUTBUFFER#39=121
VARIABLE USBOUTBUFFER#40=122,USBOUTBUFFER#41=123,USBOUTBUFFER#42=124,USBOUTBUFFER#43=125
VARIABLE USBOUTBUFFER#44=126,USBOUTBUFFER#45=127,USBOUTBUFFER#46=128,USBOUTBUFFER#47=129
VARIABLE USBOUTBUFFER#48=130,USBOUTBUFFER#49=131,USBOUTBUFFER#50=132,USBOUTBUFFER#51=133
VARIABLE USBOUTBUFFER#52=134,USBOUTBUFFER#53=135,USBOUTBUFFER#54=136,USBOUTBUFFER#55=137
VARIABLE USBOUTBUFFER#56=138,USBOUTBUFFER#57=139,USBOUTBUFFER#58=140,USBOUTBUFFER#59=141
VARIABLE USBOUTBUFFER#60=142,USBOUTBUFFER#61=143,USBOUTBUFFER#62=144,USBOUTBUFFER#63=145
__EP0BO = 512
__EP0BOH = 513
__EP0BOHH = 514
__EP0BOHHH = 515
__EP0BI = 516
__EP0BIH = 517
__EP0BIHH = 518
__EP0BIHHH = 519
__EP1BO = 520
__EP1BOH = 521
__EP1BOHH = 522
__EP1BOHHH = 523
__EP1BI = 524
__EP1BIH = 525
__EP1BIHH = 526
__EP1BIHHH = 527
__USB_TEMP_VAR = 528
__USB_TEMP_VARH = 529
__PSRC = 530
__PSRCH = 531
__PDST = 532
__PDSTH = 533
__CTRL_TRF_STATE = 534
__CTRL_TRF_SESSION_OWNER = 535
__WCOUNT = 536
__WCOUNTH = 537
__SHORT_PKT_STATUS = 538
__TRNIFCLEARED = 539
__BTRNIFCOUNT = 540
__USB_DEVICE_STATE = 541
__USB_ACTIVE_CFG = 542
__USB_ALT_INTF = 543
__USB_STAT = 544
__SETUPPKT = 545
VARIABLE __SETUPPKT#0=545,__SETUPPKT#1=546,__SETUPPKT#2=547,__SETUPPKT#3=548
VARIABLE __SETUPPKT#4=549,__SETUPPKT#5=550,__SETUPPKT#6=551,__SETUPPKT#7=552
__CTRLTRFDATA = 553
VARIABLE __CTRLTRFDATA#0=553,__CTRLTRFDATA#1=554,__CTRLTRFDATA#2=555,__CTRLTRFDATA#3=556
VARIABLE __CTRLTRFDATA#4=557,__CTRLTRFDATA#5=558,__CTRLTRFDATA#6=559,__CTRLTRFDATA#7=560
__LINE_CODING = 561
VARIABLE __LINE_CODING#0=561,__LINE_CODING#1=562,__LINE_CODING#2=563,__LINE_CODING#3=564
VARIABLE __LINE_CODING#4=565,__LINE_CODING#5=566,__LINE_CODING#6=567
__CONTROL_SIGNAL_BITMAP = 568
__DUMMY_ENCAP_CMD_RESPONSE = 569
VARIABLE __DUMMY_ENCAP_CMD_RESPONSE#0=569,__DUMMY_ENCAP_CMD_RESPONSE#1=570,__DUMMY_ENCAP_CMD_RESPONSE#2=571,__DUMMY_ENCAP_CMD_RESPONSE#3=572
VARIABLE __DUMMY_ENCAP_CMD_RESPONSE#4=573,__DUMMY_ENCAP_CMD_RESPONSE#5=574,__DUMMY_ENCAP_CMD_RESPONSE#6=575,__DUMMY_ENCAP_CMD_RESPONSE#7=576
__CDC_NOTICE = 577
__CDC_DATA_TX = 586
__CDC_DATA_RX = 651
__USBOUT_BUFFER = 587
__USBOUT_BUFFER_D = 587
__USBOUT_BUFFERH = 588
__USBOUT_BUFFER_DH = 588
__USBOUT_BUFFERHH = 589
__USBOUT_BUFFER_DHH = 589
__USBOUT_BUFFERHHH = 590
__USBOUT_BUFFER_DHHH = 590
VARIABLE __USBOUT_BUFFER#0=587,__USBOUT_BUFFER#1=588,__USBOUT_BUFFER#2=589,__USBOUT_BUFFER#3=590
VARIABLE __USBOUT_BUFFER#4=591,__USBOUT_BUFFER#5=592,__USBOUT_BUFFER#6=593,__USBOUT_BUFFER#7=594
VARIABLE __USBOUT_BUFFER#8=595,__USBOUT_BUFFER#9=596,__USBOUT_BUFFER#10=597,__USBOUT_BUFFER#11=598
VARIABLE __USBOUT_BUFFER#12=599,__USBOUT_BUFFER#13=600,__USBOUT_BUFFER#14=601,__USBOUT_BUFFER#15=602
VARIABLE __USBOUT_BUFFER#16=603,__USBOUT_BUFFER#17=604,__USBOUT_BUFFER#18=605,__USBOUT_BUFFER#19=606
VARIABLE __USBOUT_BUFFER#20=607,__USBOUT_BUFFER#21=608,__USBOUT_BUFFER#22=609,__USBOUT_BUFFER#23=610
VARIABLE __USBOUT_BUFFER#24=611,__USBOUT_BUFFER#25=612,__USBOUT_BUFFER#26=613,__USBOUT_BUFFER#27=614
VARIABLE __USBOUT_BUFFER#28=615,__USBOUT_BUFFER#29=616,__USBOUT_BUFFER#30=617,__USBOUT_BUFFER#31=618
VARIABLE __USBOUT_BUFFER#32=619,__USBOUT_BUFFER#33=620,__USBOUT_BUFFER#34=621,__USBOUT_BUFFER#35=622
VARIABLE __USBOUT_BUFFER#36=623,__USBOUT_BUFFER#37=624,__USBOUT_BUFFER#38=625,__USBOUT_BUFFER#39=626
VARIABLE __USBOUT_BUFFER#40=627,__USBOUT_BUFFER#41=628,__USBOUT_BUFFER#42=629,__USBOUT_BUFFER#43=630
VARIABLE __USBOUT_BUFFER#44=631,__USBOUT_BUFFER#45=632,__USBOUT_BUFFER#46=633,__USBOUT_BUFFER#47=634
VARIABLE __USBOUT_BUFFER#48=635,__USBOUT_BUFFER#49=636,__USBOUT_BUFFER#50=637,__USBOUT_BUFFER#51=638
VARIABLE __USBOUT_BUFFER#52=639,__USBOUT_BUFFER#53=640,__USBOUT_BUFFER#54=641,__USBOUT_BUFFER#55=642
VARIABLE __USBOUT_BUFFER#56=643,__USBOUT_BUFFER#57=644,__USBOUT_BUFFER#58=645,__USBOUT_BUFFER#59=646
VARIABLE __USBOUT_BUFFER#60=647,__USBOUT_BUFFER#61=648,__USBOUT_BUFFER#62=649,__USBOUT_BUFFER#63=650
__USBIN_BUFFER = 652
VARIABLE __USBIN_BUFFER#0=652,__USBIN_BUFFER#1=653,__USBIN_BUFFER#2=654,__USBIN_BUFFER#3=655
VARIABLE __USBIN_BUFFER#4=656,__USBIN_BUFFER#5=657,__USBIN_BUFFER#6=658,__USBIN_BUFFER#7=659
VARIABLE __USBIN_BUFFER#8=660,__USBIN_BUFFER#9=661,__USBIN_BUFFER#10=662,__USBIN_BUFFER#11=663
VARIABLE __USBIN_BUFFER#12=664,__USBIN_BUFFER#13=665,__USBIN_BUFFER#14=666,__USBIN_BUFFER#15=667
VARIABLE __USBIN_BUFFER#16=668,__USBIN_BUFFER#17=669,__USBIN_BUFFER#18=670,__USBIN_BUFFER#19=671
VARIABLE __USBIN_BUFFER#20=672,__USBIN_BUFFER#21=673,__USBIN_BUFFER#22=674,__USBIN_BUFFER#23=675
VARIABLE __USBIN_BUFFER#24=676,__USBIN_BUFFER#25=677,__USBIN_BUFFER#26=678,__USBIN_BUFFER#27=679
VARIABLE __USBIN_BUFFER#28=680,__USBIN_BUFFER#29=681,__USBIN_BUFFER#30=682,__USBIN_BUFFER#31=683
VARIABLE __USBIN_BUFFER#32=684,__USBIN_BUFFER#33=685,__USBIN_BUFFER#34=686,__USBIN_BUFFER#35=687
VARIABLE __USBIN_BUFFER#36=688,__USBIN_BUFFER#37=689,__USBIN_BUFFER#38=690,__USBIN_BUFFER#39=691
VARIABLE __USBIN_BUFFER#40=692,__USBIN_BUFFER#41=693,__USBIN_BUFFER#42=694,__USBIN_BUFFER#43=695
VARIABLE __USBIN_BUFFER#44=696,__USBIN_BUFFER#45=697,__USBIN_BUFFER#46=698,__USBIN_BUFFER#47=699
VARIABLE __USBIN_BUFFER#48=700,__USBIN_BUFFER#49=701,__USBIN_BUFFER#50=702,__USBIN_BUFFER#51=703
VARIABLE __USBIN_BUFFER#52=704,__USBIN_BUFFER#53=705,__USBIN_BUFFER#54=706,__USBIN_BUFFER#55=707
VARIABLE __USBIN_BUFFER#56=708,__USBIN_BUFFER#57=709,__USBIN_BUFFER#58=710,__USBIN_BUFFER#59=711
VARIABLE __USBIN_BUFFER#60=712,__USBIN_BUFFER#61=713,__USBIN_BUFFER#62=714,__USBIN_BUFFER#63=715
USBCOMMANDIN = 18
OFFSETREADALIAS = 19
STARTADDRESSALIAS = 19
STARTADDRESSALIASH = 20
STARTADDRESSALIASHH = 21
STARTADDRESSALIASHHH = 22
BYTECOUNTALIAS = 23
DATASTARTALIAS = 24
#DEFINE NOT_RABPU INTCON2,7
#DEFINE RABIF INTCON,0
#DEFINE USBDPLUS PORTA,0
#DEFINE FSR_0 FSR0L
#DEFINE FSR_0H FSR0LH
#DEFINE BOOTOK _B#VR1,0
#DEFINE EEPROMADDRESSALIAS USBINBUFFER#1
#DEFINE CARRY_FLAG STATUS,0
#DEFINE TRNIF UIR,3
#DEFINE __XTAL 24
#DEFINE __OPTIMISER_LEVEL 3
#DEFINE FLASHCLEAREDSTATUS 255
#DEFINE MAINCODESTART 2944
#DEFINE MAINCODESTARTH 11
#DEFINE ENDOFCODESPACE 16384
#DEFINE ENDOFCODESPACEH 64
#DEFINE FLASHERASESEG 64
#DEFINE FLASHWRITEBLOCK 16
#DEFINE ERASEPROGRAM 1
#DEFINE WRITEFLASH 2
#DEFINE FINISHWRITE 3
#DEFINE RUNMAINCODE 4
#DEFINE USBBUFFERSIZETX 64
#DEFINE USBBUFFERSIZERX 64
#DEFINE ATTACHED_STATE 6
PROTON#CODE#START
	ORG 0
	GOTO PROTON#MAIN#START
	ORG 8
	Goto USER_HIGH_INTERRUPT_VECTOR
	ORG 24
	Goto USER_LOW_INTERRUPT_VECTOR
EE@RD
	MOVWF 4009
EE@RD@W
	CLRF 4006
	BSF 4006,PP_RD
	MOVF 4008,W
	INCF 4009,F
	RETURN
EE@WR
EE@WR@W
	MOVWF 4008
	CLRF 4006
	BSF 4006,PP_WREN
	MOVLW 85
	MOVWF 4007
	MOVLW 170
	MOVWF 4007
	BSF 4006,PP_WR
	BTFSC 4006,PP_WR
	BRA $ - 2
	BCF 4006,PP_WREN
	INCF 4009,F
	RETURN
C@WRITE
	MOVWF 4085
	TBLWT*
	INCF 4086,W
	ANDLW 15
	BNZ CR@EXIT
	MOVLW 132
	MOVWF 4006
	MOVLW 85
	MOVWF 4007
	MOVLW 170
	MOVWF 4007
	BSF 4006,PP_WR
	BRA $ + 2
	BCF 4006,PP_WREN
CR@EXIT
	INFSNZ 4086,F
	INCF 4087,F
	RETURN
C@ERASE
	MOVWF 4086
C@ERASE2
	MOVLW 148
	MOVWF 4006
	MOVLW 85
	MOVWF 4007
	MOVLW 170
	MOVWF 4007
	BSF 4006,PP_WR
	NOP
	BCF 4006,PP_WREN
	RETURN
DL@MS
	CLRF 5
DLY@W
	MOVWF 4
DLY@P
	MOVLW 255
	ADDWF 4,F
	ADDWFC 5,F
	BRA $ + 2
	BTFSS 4056,0
	RETURN
	MOVLW 3
	MOVWF 3
	MOVLW 230
	RCALL DLUS@W
	BRA DLY@P
DL@US
	CLRF 3
DLUS@W
	ADDLW 253
	MOVWF 2
	CLRF 4072
	SUBWFB 3,F
	BC $ + 6
	NOP
	RETURN
	DECF 2,F
	BRA $ - 10
#DEFINE    __MUID_NULL       0
#DEFINE    __MUID_USB9       1
#DEFINE    __MUID_HID        2
#DEFINE    __MUID_CDC        3
#DEFINE    __MUID_MSD        4
#DEFINE    _BSTALL           0X04    ; BUFFER STALL ENABLE
#DEFINE    _DTSEN            0X08    ; DATA TOGGLE SYNCH ENABLE
#DEFINE    _INCDIS           0X10    ; ADDRESS INCREMENT DISABLE
#DEFINE    _KEN              0X20    ; SIE KEEPS THE BUFF DESCRIPTORS ENABLED
#DEFINE    _DAT0             0X00    ; DATA0 PACKET EXPECTED NEXT
#DEFINE    _DAT1             0X40    ; DATA1 PACKET EXPECTED NEXT
#DEFINE    _DTSMASK          0X40    ; __DTS MASK
#DEFINE    _USIE             0X80    ; SIE OWNS THE BUFFER
#DEFINE    _UCPU             0X00    ; CPU OWNS THE BUFFER
#DEFINE    __DETACHED_STATE        0
#DEFINE    __ATTACHED_STATE        1
#DEFINE    __POWERED_STATE         2
#DEFINE    __DEFAULT_STATE         3
#DEFINE    __ADR_PENDING_STATE     4
#DEFINE    __ADDRESS_STATE         5
#DEFINE    __CONFIGURED_STATE      6
#DEFINE __DSC_DEV         1
#DEFINE __DSC_CFG         2
#DEFINE __DSC_STR         3
#DEFINE __DSC_INTF        4
#DEFINE __DSC_EP          5
#DEFINE _EP01_OUT       0X01
#DEFINE _EP01_IN        0X81
#DEFINE _EP02_OUT       0X02
#DEFINE _EP02_IN        0X82
#DEFINE _EP03_OUT       0X03
#DEFINE _EP03_IN        0X83
#DEFINE _EP04_OUT       0X04
#DEFINE _EP04_IN        0X84
#DEFINE _EP05_OUT       0X05
#DEFINE _EP05_IN        0X85
#DEFINE _EP06_OUT       0X06
#DEFINE _EP06_IN        0X86
#DEFINE _EP07_OUT       0X07
#DEFINE _EP07_IN        0X87
#DEFINE _EP08_OUT       0X08
#DEFINE _EP08_IN        0X88
#DEFINE _EP09_OUT       0X09
#DEFINE _EP09_IN        0X89
#DEFINE _EP10_OUT       0X0A
#DEFINE _EP10_IN        0X8A
#DEFINE _EP11_OUT       0X0B
#DEFINE _EP11_IN        0X8B
#DEFINE _EP12_OUT       0X0C
#DEFINE _EP12_IN        0X8C
#DEFINE _EP13_OUT       0X0D
#DEFINE _EP13_IN        0X8D
#DEFINE _EP14_OUT       0X0E
#DEFINE _EP14_IN        0X8E
#DEFINE _EP15_OUT       0X0F
#DEFINE _EP15_IN        0X8F
#DEFINE    __GET_STATUS            0
#DEFINE    __CLR_FEATURE           1
#DEFINE    __SET_FEATURE           3
#DEFINE    __SET_ADR               5
#DEFINE    __GET_DSC               6
#DEFINE    __SET_DSC               7
#DEFINE    __GET_CFG               8
#DEFINE    __SET_CFG               9
#DEFINE    __GET_INTF              10
#DEFINE    __SET_INTF              11
#DEFINE    __SYNCH_FRAME           12
#DEFINE    __DEVICE_REMOTE_WAKEUP  1
#DEFINE    __ENDPOINT_HALT         0
#DEFINE    __GET_REPORT            0X01
#DEFINE    __GET_IDLE              0X02
#DEFINE    __GET_PROTOCOL          0X03
#DEFINE    __SET_REPORT            0X09
#DEFINE    __SET_IDLE              0X0A
#DEFINE    __SET_PROTOCOL          0X0B
#DEFINE    __DSC_HID               0X21
#DEFINE    __DSC_RPT               0X22
#DEFINE    __DSC_PHY               0X23
#DEFINE    __BOOT_PROTOCOL         0X00
#DEFINE    __RPT_PROTOCOL          0X01
#DEFINE    __HID_INTF              0X03
#DEFINE    __BOOT_INTF_SUBCLASS    0X01
#DEFINE    __HID_PROTOCOL_NONE     0X00
#DEFINE    __HID_PROTOCOL_KEYBOAD  0X01
#DEFINE    __HID_PROTOCOL_MOUSE    0X02
#DEFINE    __HID_INPUT_REPORT      1
#DEFINE    __HID_OUTPUT_REPORT     2
#DEFINE    __HID_FEATURE_REPORT    3
#DEFINE    __SEND_ENCAPSULATED_COMMAND 0X00
#DEFINE    __GET_ENCAPSULATED_RESPONSE 0X01
#DEFINE    __SET_COMM_FEATURE          0X02
#DEFINE    __GET_COMM_FEATURE          0X03
#DEFINE    __CLEAR_COMM_FEATURE        0X04
#DEFINE    __SET_LINE_CODING           0X20
#DEFINE    __GET_LINE_CODING           0X21
#DEFINE    __SET_CONTROL_LINE_STATE    0X22
#DEFINE    __SEND_BREAK                0X23
#DEFINE    __NETWORK_CONNECTION    0X00
#DEFINE    __RESPONSE_AVAILABLE    0X01
#DEFINE    __SERIAL_STATE          0X20
#DEFINE    __CDC_DEVICE            0X02
#DEFINE    __COMM_INTF             0X02
#DEFINE    __ABSTRACT_CONTROL_MODEL  0X02
#DEFINE    __V25TER                0X01    ; COMMON AT COMMANDS ("HAYES(TM)")
#DEFINE    __DATA_INTF             0X0A
#DEFINE    __NO_PROTOCOL           0X00    ; NO CLASS SPECIFIC PROTOCOL REQUIRED
#DEFINE    __ABSTRACT_STATE        0X01
#DEFINE    __COUNTRY_SETTING       0X02
#DEFINE    __CS_INTERFACE          0X24
#DEFINE    __CS_ENDPOINT           0X25
#DEFINE    __DSC_FN_HEADER            0
#DEFINE    __DSC_FN_CALL_MGT          1
#DEFINE    __DSC_FN_ACM               2    ; ACM - ABSTRACT CONTROL MANAGEMENT
#DEFINE    __DSC_FN_DLM               3    ; DLM - DIRECT LINE MANAGMENT
#DEFINE    __DSC_FN_TELEPHONE_RINGER  4
#DEFINE    __DSC_FN_RPT_CAPABILITIES  5
#DEFINE    __DSC_FN_UNION             6
#DEFINE    __DSC_FN_COUNTRY_SELECTION 7
#DEFINE    __DSC_FN_TEL_OP_MODES      8
#DEFINE    __DSC_FN_USB_TERMINAL      9
#DEFINE    __CDC_TX_READY             0
#DEFINE    __CDC_TX_BUSY              1
#DEFINE    __CDC_TX_BUSY_ZLP          2    ; ZLP (ZERO LENGTH PACKET)
#DEFINE    __CDC_TX_COMPLETING        3
#DEFINE    __LINE_CODING_LENGTH       7
#DEFINE __DUMMY_LENGTH                8
#DEFINE    __WAIT_SETUP               0
#DEFINE    __CTRL_TRF_TX              1
#DEFINE    __CTRL_TRF_RX              2
#DEFINE __SHORT_PKT_NOT_USED          0
#DEFINE __SHORT_PKT_PENDING           1
#DEFINE __SHORT_PKT_SENT              2
#DEFINE    __SETUP_TOKEN     13
#DEFINE    __OUT_TOKEN       1
#DEFINE    __IN_TOKEN        9
#DEFINE    __HOST_TO_DEV     0
#DEFINE    __DEV_TO_HOST     1
#DEFINE    __STANDARD        0
#DEFINE    __CLASS           1
#DEFINE    __VENDOR          2
#DEFINE    __RCPT_DEV        0
#DEFINE    __RCPT_INTF       1
#DEFINE    __RCPT_EP         2
#DEFINE    __RCPT_OTH        3
#DEFINE    _PPBM0            0        ; PING-PONG BUFFER MODE 0
#DEFINE    _PPBM1            1        ; PING-PONG BUFFER MODE 1
#DEFINE    _PPBM2            2        ; PING-PONG BUFFER MODE 2
#DEFINE    _LS               0        ; USE LOW-SPEED USB MODE
#DEFINE    _FS               4        ; USE FULL-SPEED USB MODE
#DEFINE    _TRINT            0        ; USE THE INTERNAL TRANSCEIVER
#DEFINE    _TREXT            8        ; USE AN EXTERNAL TRANSCEIVER
#DEFINE    _PUEN             16       ; USE THE INTERNAL PULL-UP RESISTOR
#DEFINE    _OEMON            64       ; USE THE SIE OUTPUT INDICATOR
#DEFINE    _UTEYE            128      ; USE THE EYE-PATTERN TEST
#DEFINE    __EP_CTRL        0X06    ; CONFIGURE THE CONTROL PIPE FOR THIS EP
#DEFINE    __EP_OUT         0X0C    ; CONFIGURE THE OUT ONLY PIPE FOR THIS EP
#DEFINE    __EP_IN          0X0A    ; CONFIGURE THE IN ONLY PIPE FOR THIS EP
#DEFINE    __EP_OUT_IN      0X0E    ; CONFIGURE BOTH OUT & IN PIPES FOR THIS EP
#DEFINE    __HSHK_EN        0X10    ; ENABLE THE HANDSHAKE PACKET
#DEFINE    __OUT       0
#DEFINE    __IN        1
#DEFINE    __PIC_EP_NUM_MASK    0B01111000
#DEFINE    __PIC_EP_DIR_MASK    0B00000100
#DEFINE    __EP00_OUT       0   ; (0X00 << 3) | (__OUT << 2)
#DEFINE    __EP00_IN        4   ; (0X00 << 3) | (__IN << 2)
#DEFINE    __EP01_OUT       8   ; (0X01 << 3) | (__OUT << 2)
#DEFINE    __EP01_IN        12  ; (0X01 << 3) | (__IN << 2)
#DEFINE    __EP02_OUT       16  ; (0X02 << 3) | (__OUT << 2)
#DEFINE    __EP02_IN        20  ; (0X02 << 3) | (__IN << 2)
#DEFINE    __EP03_OUT       24  ; (0X03 << 3) | (__OUT << 2)
#DEFINE    __EP03_IN        28  ; (0X03 << 3) | (__IN << 2)
#DEFINE    __EP04_OUT       32  ; (0X04 << 3) | (__OUT << 2)
#DEFINE    __EP04_IN        36  ; (0X04 << 3) | (__IN << 2)
#DEFINE    __EP05_OUT       40  ; (0X05 << 3) | (__OUT << 2)
#DEFINE    __EP05_IN        44  ; (0X05 << 3) | (__IN << 2)
#DEFINE    __EP06_OUT       48  ; (0X06 << 3) | (__OUT << 2)
#DEFINE    __EP06_IN        52  ; (0X06 << 3) | (__IN << 2)
#DEFINE    __EP07_OUT       56  ; (0X07 << 3) | (__OUT << 2)
#DEFINE    __EP07_IN        60  ; (0X07 << 3) | (__IN << 2)
#DEFINE    __EP08_OUT       64  ; (0X08 << 3) | (__OUT << 2)
#DEFINE    __EP08_IN        68  ; (0X08 << 3) | (__IN << 2)
#DEFINE    __EP09_OUT       72  ; (0X09 << 3) | (__OUT << 2)
#DEFINE    __EP09_IN        76  ; (0X09 << 3) | (__IN << 2)
#DEFINE    __EP10_OUT       80  ; (0X0A << 3) | (__OUT << 2)
#DEFINE    __EP10_IN        84  ; (0X0A << 3) | (__IN << 2)
#DEFINE    __EP11_OUT       88  ; (0X0B << 3) | (__OUT << 2)
#DEFINE    __EP11_IN        92  ; (0X0B << 3) | (__IN << 2)
#DEFINE    __EP12_OUT       96  ; (0X0C << 3) | (__OUT << 2)
#DEFINE    __EP12_IN        100 ; (0X0C << 3) | (__IN << 2)
#DEFINE    __EP13_OUT       104 ; (0X0D << 3) | (__OUT << 2)
#DEFINE    __EP13_IN        108 ; (0X0D << 3) | (__IN << 2)
#DEFINE    __EP14_OUT       112 ; (0X0E << 3) | (__OUT << 2)
#DEFINE    __EP14_IN        116 ; (0X0E << 3) | (__IN << 2)
#DEFINE    __EP15_OUT       120 ; (0X0F << 3) | (__OUT << 2)
#DEFINE    __EP15_IN        124 ; (0X0F << 3) | (__IN << 2)


F2_SOF EQU $ ; CWRITE_TEST.PRP
F2_EOF EQU $ ; CWRITE_TEST.PRP
F1_SOF EQU $ ; CWRITE_TEST.BAS
F1_000193 EQU $ ; IN [CWRITE_TEST.BAS] GOTO PROTONCODESTART
	Goto PROTONCODESTART
PROTONCODESTART
F1_000208 EQU $ ; IN [CWRITE_TEST.BAS] OSCCON2.2 = 1
	BSF OSCCON2,2,0
F1_000209 EQU $ ; IN [CWRITE_TEST.BAS] OSCCON = %01010000
	MOVLW 80
	MOVWF OSCCON,0
F1_000212 EQU $ ; IN [CWRITE_TEST.BAS] ALL_DIGITAL = 1
	CLRF CM1CON0,0
	CLRF CM2CON0,0
	CLRF ANSEL,0
	CLRF ANSELH,0
	MOVLW 15
	MOVWF ADCON1,0
F1_000214 EQU $ ; IN [CWRITE_TEST.BAS] ANSELH = 0
	CLRF ANSELH,0
F1_000215 EQU $ ; IN [CWRITE_TEST.BAS] ANSEL =  %00001000
	MOVLW 8
	MOVWF ANSEL,0
F1_000219 EQU $ ; IN [CWRITE_TEST.BAS] CLEAR
	LFSR 0,768
	CLRF POSTDEC0,0
	MOVF FSR0L,W,0
	IORWF FSR0H,W,0
	Bnz $ - 6
	CLRF INDF0,0
F1_000222 EQU $ ; IN [CWRITE_TEST.BAS] IOCA = %00000011
	MOVLW 3
	MOVWF IOCA,0
F1_000224 EQU $ ; IN [CWRITE_TEST.BAS] NOT_RABPU = 0
	BCF INTCON2,7,0
F1_000225 EQU $ ; IN [CWRITE_TEST.BAS] WPUA = %00001000
	MOVLW 8
	MOVWF WPUA,0
F1_000226 EQU $ ; IN [CWRITE_TEST.BAS] WPUB = 0
	CLRF WPUB,0
F1_000228 EQU $ ; IN [CWRITE_TEST.BAS] DELAYMS 100
	MOVLW 100
	Call DL@MS
F1_000239 EQU $ ; IN [CWRITE_TEST.BAS] GOSUB ISBOOTOK
	Call ISBOOTOK
F1_000241 EQU $ ; IN [CWRITE_TEST.BAS] DELAYMS 100
	MOVLW 100
	Call DL@MS
F1_000243 EQU $ ; IN [CWRITE_TEST.BAS] IF USBDPLUS = 0 THEN GOTO USB_ENUMERATE
	Tgoto 1,PORTA,0,BC@LL2
	Goto USB_ENUMERATE
BC@LL2
F1_000244 EQU $ ; IN [CWRITE_TEST.BAS] IF BOOTOK = 0 THEN GOTO USB_ENUMERATE
	Tgoto 1,_B#VR1,0,BC@LL4
	Goto USB_ENUMERATE
BC@LL4
F1_000246 EQU $ ; IN [CWRITE_TEST.BAS] GOTO RUNMAIN
	Goto RUNMAIN
USB_ENUMERATE
F1_000251 EQU $ ; IN [CWRITE_TEST.BAS] IOCA = %00000000
	CLRF IOCA,0
F1_000254 EQU $ ; IN [CWRITE_TEST.BAS] WHILE 1 = 1
BC@LL5
F1_000255 EQU $ ; IN [CWRITE_TEST.BAS] REPEAT
BC@LL7
F1_000256 EQU $ ; IN [CWRITE_TEST.BAS] USBPOLL
	Call USB@POLL
F1_000257 EQU $ ; IN [CWRITE_TEST.BAS] UNTIL PP0 = %00000110
	MOVLW 6
	SUBWF PP0,W,0
	Tgoto 0,STATUS,2,BC@LL7
BC@LL8
F1_000258 EQU $ ; IN [CWRITE_TEST.BAS] GOTO USBMODE
	Goto USBMODE
F1_000259 EQU $ ; IN [CWRITE_TEST.BAS] WEND
	Goto BC@LL5
BC@LL6
F1_000262 EQU $ ; IN [CWRITE_TEST.BAS] GOTO USBMODE
	Goto USBMODE
RUNMAIN


      GOTO MAINCODESTART


DOUSBIN
F1_000272 EQU $ ; IN [CWRITE_TEST.BAS] REPEAT
BC@LL9
F1_000273 EQU $ ; IN [CWRITE_TEST.BAS] USBIN 1, USBINBUFFER, AUTO
	MOVLW 1
	MOVWF GEN,0
	LFSR 1,USBINBUFFER
	Call GET@USB@AUTO
F1_000274 EQU $ ; IN [CWRITE_TEST.BAS] UNTIL STATUS.0 = 0
	Tgoto 1,STATUS,0,BC@LL9
BC@LL10
F1_000275 EQU $ ; IN [CWRITE_TEST.BAS] RETURN
	RETURN 0
DOUSBOUT
USBLOOP
F1_000284 EQU $ ; IN [CWRITE_TEST.BAS] USBPOLL
	Call USB@POLL
F1_000285 EQU $ ; IN [CWRITE_TEST.BAS] IF TRNIF = 1 THEN GOTO USBLOOP
	Tgoto 0,UIR,3,BC@LL12
	Goto USBLOOP
BC@LL12
F1_000288 EQU $ ; IN [CWRITE_TEST.BAS] REPEAT
BC@LL13
F1_000289 EQU $ ; IN [CWRITE_TEST.BAS] USBOUT 1, USBOUTBUFFER, USBBUFFERSIZETX
	MOVLW 1
	MOVWF GEN,0
	LFSR 1,USBOUTBUFFER
	MOVLW 64
	Call PUTBUF@USB
F1_000290 EQU $ ; IN [CWRITE_TEST.BAS] UNTIL STATUS.0 = 0
	Tgoto 1,STATUS,0,BC@LL13
BC@LL14
F1_000292 EQU $ ; IN [CWRITE_TEST.BAS] RETURN
	RETURN 0
WRITEFLASHDATA
F1_000307 EQU $ ; IN [CWRITE_TEST.BAS] PROMADDRESS = STARTADDRESSALIAS
	MOVFF STARTADDRESSALIAS,PROMADDRESS
	MOVFF STARTADDRESSALIASH,PROMADDRESSH
F1_000308 EQU $ ; IN [CWRITE_TEST.BAS] INDEX2 = BYTECOUNTALIAS - 1
	DECF BYTECOUNTALIAS,W,0
	MOVWF INDEX2,0
F1_000310 EQU $ ; IN [CWRITE_TEST.BAS] IF STARTADDRESSALIAS.BYTE2 = $F0 THEN GOTO WRITEEEPROMVALUE
	MOVLW 240
	SUBWF STARTADDRESSALIASHH,W,0
	Tgoto 0,STATUS,2,BC@LL16
	Goto WRITEEEPROMVALUE
BC@LL16
F1_000312 EQU $ ; IN [CWRITE_TEST.BAS] IF PROMADDRESS < MAINCODESTART THEN
	MOVLW 11
	SUBWF PROMADDRESSH,W,0
	MOVLW 128
	BTFSC STATUS,2,0
	SUBWF PROMADDRESS,W,0
	Tgoto 1,STATUS,0,BC@LL18
F1_000313 EQU $ ; IN [CWRITE_TEST.BAS] GOTO RESULTOKEXIT
	Goto RESULTOKEXIT
F1_000314 EQU $ ; IN [CWRITE_TEST.BAS] ENDIF
BC@LL18
F1_000316 EQU $ ; IN [CWRITE_TEST.BAS] FSR_0 = VARPTR DATASTARTALIAS
	LFSR 0,DATASTARTALIAS
F1_000318 EQU $ ; IN [CWRITE_TEST.BAS] GOSUB WRITETOPROM
	Call WRITETOPROM
F1_000326 EQU $ ; IN [CWRITE_TEST.BAS] PROMADDRESS = STARTADDRESSALIAS
	MOVFF STARTADDRESSALIAS,PROMADDRESS
	MOVFF STARTADDRESSALIASH,PROMADDRESSH
F1_000327 EQU $ ; IN [CWRITE_TEST.BAS] INDEX2 = BYTECOUNTALIAS
	MOVFF BYTECOUNTALIAS,INDEX2
F1_000328 EQU $ ; IN [CWRITE_TEST.BAS] FSR_0 = VARPTR DATASTARTALIAS
	LFSR 0,DATASTARTALIAS
F1_000330 EQU $ ; IN [CWRITE_TEST.BAS] INDEX1 = 0
	CLRF INDEX1,0
F1_000331 EQU $ ; IN [CWRITE_TEST.BAS] REPEAT
BC@LL19
F1_000332 EQU $ ; IN [CWRITE_TEST.BAS] TEMPB1 = CREAD PROMADDRESS
	MOVFF PROMADDRESS,TBLPTRL
	MOVFF PROMADDRESSH,TBLPTRLH
	CLRF EECON1,0
	BSF EECON1,PP_EEPGD,0
	TBLRD*
	MOVFF TABLAT,TEMPB1
F1_000333 EQU $ ; IN [CWRITE_TEST.BAS] TEMPB2 = POSTINC0
	MOVFF POSTINC0,TEMPB2
F1_000334 EQU $ ; IN [CWRITE_TEST.BAS] IF TEMPB1 <> TEMPB2 THEN
	MOVF TEMPB1,W,0
	SUBWF TEMPB2,W,0
	Tgoto 1,STATUS,2,BC@LL22
F1_000335 EQU $ ; IN [CWRITE_TEST.BAS] GOTO SENDBADRESULTANDRETURN
	Goto SENDBADRESULTANDRETURN
F1_000336 EQU $ ; IN [CWRITE_TEST.BAS] ENDIF
BC@LL22
F1_000337 EQU $ ; IN [CWRITE_TEST.BAS] INC PROMADDRESS
	INFSNZ PROMADDRESS,F,0
	INCF PROMADDRESSH,F,0
F1_000338 EQU $ ; IN [CWRITE_TEST.BAS] INC INDEX1
	INCF INDEX1,F,0
F1_000339 EQU $ ; IN [CWRITE_TEST.BAS] UNTIL INDEX1 >= INDEX2
	MOVF INDEX2,W,0
	SUBWF INDEX1,W,0
	Tgoto 0,STATUS,0,BC@LL19
BC@LL20
RESULTOKEXIT
F1_000346 EQU $ ; IN [CWRITE_TEST.BAS] GOSUB USBOK_RESPONCE
	Goto USBOK_RESPONCE
SENDBADRESULTANDRETURN
F1_000350 EQU $ ; IN [CWRITE_TEST.BAS] GOSUB USBNOTOK_RESPONCE
	Goto USBNOTOK_RESPONCE
WRITETOPROM
F1_000369 EQU $ ; IN [CWRITE_TEST.BAS] MEMORYPOINTER = PROMADDRESS
	MOVFF PROMADDRESS,MEMORYPOINTER
	MOVFF PROMADDRESSH,MEMORYPOINTERH
F1_000372 EQU $ ; IN [CWRITE_TEST.BAS] INDEX1 = 0
	CLRF INDEX1,0
F1_000373 EQU $ ; IN [CWRITE_TEST.BAS] REPEAT
BC@LL23
F1_000374 EQU $ ; IN [CWRITE_TEST.BAS] TEMPB1 = POSTINC0
	MOVFF POSTINC0,TEMPB1
F1_000375 EQU $ ; IN [CWRITE_TEST.BAS] CWRITE MEMORYPOINTER,[TEMPB1]
	MOVFF MEMORYPOINTER,TBLPTRL
	MOVFF MEMORYPOINTERH,TBLPTRLH
	MOVF TEMPB1,W,0
	Call C@WRITE
F1_000376 EQU $ ; IN [CWRITE_TEST.BAS] INC INDEX1
	INCF INDEX1,F,0
F1_000377 EQU $ ; IN [CWRITE_TEST.BAS] INC MEMORYPOINTER
	INFSNZ MEMORYPOINTER,F,0
	INCF MEMORYPOINTERH,F,0
F1_000378 EQU $ ; IN [CWRITE_TEST.BAS] UNTIL INDEX1 >= FLASHWRITEBLOCK
	MOVLW 16
	SUBWF INDEX1,W,0
	Tgoto 0,STATUS,0,BC@LL23
BC@LL24
F1_000380 EQU $ ; IN [CWRITE_TEST.BAS] RETURN
	RETURN 0
ISBOOTOK
F1_000390 EQU $ ; IN [CWRITE_TEST.BAS] IF EREAD FLASHCLEAREDSTATUS = "W" THEN
	MOVLW 255
	Call EE@RD
	MOVWF PBP#VAR0,0
	MOVLW 87
	SUBWF PBP#VAR0,W,0
	Tgoto 0,STATUS,2,BC@LL26
F1_000391 EQU $ ; IN [CWRITE_TEST.BAS] BOOTOK = 1
	BSF _B#VR1,0,0
	Goto BC@LL27
BC@LL26
F1_000392 EQU $ ; IN [CWRITE_TEST.BAS] ELSE
F1_000393 EQU $ ; IN [CWRITE_TEST.BAS] BOOTOK = 0
	BCF _B#VR1,0,0
F1_000394 EQU $ ; IN [CWRITE_TEST.BAS] ENDIF
BC@LL27
F1_000396 EQU $ ; IN [CWRITE_TEST.BAS] RETURN
	RETURN 0
ERASEPROGRAMDATA
F1_000407 EQU $ ; IN [CWRITE_TEST.BAS] EWRITE FLASHCLEAREDSTATUS,["C"]
	SETF EEADR,0
	MOVLW 67
	Call EE@WR
F1_000411 EQU $ ; IN [CWRITE_TEST.BAS] PROMADDRESS = MAINCODESTART
	MOVLW 128
	MOVWF PROMADDRESS,0
	MOVLW 11
	MOVWF PROMADDRESSH,0
F1_000413 EQU $ ; IN [CWRITE_TEST.BAS] REPEAT
BC@LL28
F1_000414 EQU $ ; IN [CWRITE_TEST.BAS] CERASE PROMADDRESS
	MOVFF PROMADDRESSH,TBLPTRLH
	MOVF PROMADDRESS,W,0
	Call C@ERASE
F1_000415 EQU $ ; IN [CWRITE_TEST.BAS] PROMADDRESS = PROMADDRESS + FLASHERASESEG
	MOVLW 64
	ADDWF PROMADDRESS,F,0
	MOVLW 0
	ADDWFC PROMADDRESSH,F,0
F1_000416 EQU $ ; IN [CWRITE_TEST.BAS] USBPOLL
	Call USB@POLL
F1_000417 EQU $ ; IN [CWRITE_TEST.BAS] UNTIL PROMADDRESS >= ENDOFCODESPACE
	MOVLW 64
	SUBWF PROMADDRESSH,W,0
	Tgoto 0,STATUS,0,BC@LL28
	Tgoto 0,STATUS,2,CP@LB3
	MOVLW 0
	SUBWF PROMADDRESS,W,0
	Tgoto 0,STATUS,0,BC@LL28
CP@LB3
BC@LL29
F1_000420 EQU $ ; IN [CWRITE_TEST.BAS] CLEAR USBOUTBUFFER
	LFSR 0,USBOUTBUFFER
	MOVLW 64
	CLRF POSTINC0,0
	DECFSZ WREG,F,0
	Bra $ - 4
F1_000423 EQU $ ; IN [CWRITE_TEST.BAS] GOSUB USBOK_RESPONCE
	Goto USBOK_RESPONCE
WRITEEEPROMVALUE
F1_000431 EQU $ ; IN [CWRITE_TEST.BAS] INDEX2 = USBINBUFFER#5 - 1
	DECF USBINBUFFER#5,W,0
	MOVWF INDEX2,0
F1_000432 EQU $ ; IN [CWRITE_TEST.BAS] FSR_0 = VARPTR DATASTARTALIAS
	LFSR 0,DATASTARTALIAS
F1_000434 EQU $ ; IN [CWRITE_TEST.BAS] TEMPB1 = EEPROMADDRESSALIAS
	MOVFF USBINBUFFER#1,TEMPB1
F1_000435 EQU $ ; IN [CWRITE_TEST.BAS] INDEX1 = 0
	CLRF INDEX1,0
F1_000436 EQU $ ; IN [CWRITE_TEST.BAS] REPEAT
BC@LL30
F1_000437 EQU $ ; IN [CWRITE_TEST.BAS] EWRITE TEMPB1,[POSTINC0]
	MOVFF TEMPB1,EEADR
	MOVF POSTINC0,W,0
	Call EE@WR
F1_000438 EQU $ ; IN [CWRITE_TEST.BAS] DELAYUSBVALUE = 5
	MOVLW 5
	MOVWF DELAYUSBVALUE,0
F1_000439 EQU $ ; IN [CWRITE_TEST.BAS] GOSUB DELAYUSB
	Call DELAYUSB
F1_000440 EQU $ ; IN [CWRITE_TEST.BAS] INC INDEX1
	INCF INDEX1,F,0
F1_000441 EQU $ ; IN [CWRITE_TEST.BAS] INC TEMPB1
	INCF TEMPB1,F,0
F1_000442 EQU $ ; IN [CWRITE_TEST.BAS] UNTIL INDEX1 = INDEX2
	MOVF INDEX1,W,0
	SUBWF INDEX2,W,0
	Tgoto 0,STATUS,2,BC@LL30
BC@LL31
F1_000443 EQU $ ; IN [CWRITE_TEST.BAS] GOSUB USBOK_RESPONCE
	Goto USBOK_RESPONCE
DELAYUSB
F1_000453 EQU $ ; IN [CWRITE_TEST.BAS] DELAYCOUNT = 0
	CLRF DELAYCOUNT,0
F1_000454 EQU $ ; IN [CWRITE_TEST.BAS] REPEAT
BC@LL32
F1_000455 EQU $ ; IN [CWRITE_TEST.BAS] USBPOLL
	Call USB@POLL
F1_000456 EQU $ ; IN [CWRITE_TEST.BAS] DELAYMS 1
	MOVLW 1
	Call DL@MS
F1_000457 EQU $ ; IN [CWRITE_TEST.BAS] INC DELAYCOUNT
	INCF DELAYCOUNT,F,0
F1_000458 EQU $ ; IN [CWRITE_TEST.BAS] UNTIL DELAYCOUNT >= DELAYUSBVALUE
	MOVF DELAYUSBVALUE,W,0
	SUBWF DELAYCOUNT,W,0
	Tgoto 0,STATUS,0,BC@LL32
BC@LL33
F1_000459 EQU $ ; IN [CWRITE_TEST.BAS] RETURN
	RETURN 0
USBOK_RESPONCE
F1_000470 EQU $ ; IN [CWRITE_TEST.BAS] USBOUTBUFFER#0 = $55
	MOVLW 85
	MOVWF USBOUTBUFFER#0,0
F1_000471 EQU $ ; IN [CWRITE_TEST.BAS] GOSUB DOUSBOUT
	Goto DOUSBOUT
USBNOTOK_RESPONCE
F1_000477 EQU $ ; IN [CWRITE_TEST.BAS] USBOUTBUFFER#0 = $AA
	MOVLW 170
	MOVWF USBOUTBUFFER#0,0
F1_000478 EQU $ ; IN [CWRITE_TEST.BAS] GOSUB DOUSBOUT
	Goto DOUSBOUT
USBMODE
F1_000487 EQU $ ; IN [CWRITE_TEST.BAS] WHILE 1 = 1
BC@LL34
F1_000490 EQU $ ; IN [CWRITE_TEST.BAS] GOSUB DOUSBIN
	Call DOUSBIN
F1_000492 EQU $ ; IN [CWRITE_TEST.BAS] CLEAR USBOUTBUFFER
	LFSR 0,USBOUTBUFFER
	MOVLW 64
	CLRF POSTINC0,0
	DECFSZ WREG,F,0
	Bra $ - 4
F1_000494 EQU $ ; IN [CWRITE_TEST.BAS] SELECT USBCOMMANDIN
F1_000496 EQU $ ; IN [CWRITE_TEST.BAS] CASE ERASEPROGRAM
	MOVLW 1
	SUBWF USBCOMMANDIN,W,0
	Tgoto 0,STATUS,2,BC@LL37
F1_000497 EQU $ ; IN [CWRITE_TEST.BAS] GOSUB ERASEPROGRAMDATA
	Call ERASEPROGRAMDATA
F1_000498 EQU $ ; IN [CWRITE_TEST.BAS] GOSUB USBOK_RESPONCE
	Call USBOK_RESPONCE
	Goto BC@LL36
BC@LL37
F1_000500 EQU $ ; IN [CWRITE_TEST.BAS] CASE WRITEFLASH
	MOVLW 2
	SUBWF USBCOMMANDIN,W,0
	Tgoto 0,STATUS,2,BC@LL40
F1_000501 EQU $ ; IN [CWRITE_TEST.BAS] GOSUB WRITEFLASHDATA
	Call WRITEFLASHDATA
	Goto BC@LL36
BC@LL40
F1_000503 EQU $ ; IN [CWRITE_TEST.BAS] CASE FINISHWRITE
	MOVLW 3
	SUBWF USBCOMMANDIN,W,0
	Tgoto 0,STATUS,2,BC@LL42
F1_000504 EQU $ ; IN [CWRITE_TEST.BAS] EWRITE FLASHCLEAREDSTATUS,["W"]
	SETF EEADR,0
	MOVLW 87
	Call EE@WR
F1_000505 EQU $ ; IN [CWRITE_TEST.BAS] GOSUB USBOK_RESPONCE
	Call USBOK_RESPONCE
	Goto BC@LL36
BC@LL42
F1_000507 EQU $ ; IN [CWRITE_TEST.BAS] CASE RUNMAINCODE
	MOVLW 4
	SUBWF USBCOMMANDIN,W,0
	Tgoto 0,STATUS,2,BC@LL44
F1_000508 EQU $ ; IN [CWRITE_TEST.BAS] GOSUB USBOK_RESPONCE
	Call USBOK_RESPONCE


                  CALL MAINCODESTART


F1_000513 EQU $ ; IN [CWRITE_TEST.BAS] ENDSELECT
BC@LL44
BC@LL36
F1_000515 EQU $ ; IN [CWRITE_TEST.BAS] WEND
	Goto BC@LL34
BC@LL35
	ORG 2952
USER_HIGH_INTERRUPT_VECTOR
	ORG 2968
USER_LOW_INTERRUPT_VECTOR
F1_EOF EQU $ ; CWRITE_TEST.BAS
PB@LB46
	Bra PB@LB46

__EOF
CONFIG CPUDIV = CLKDIV2
CONFIG USBDIV = OFF
CONFIG FOSC = HS
CONFIG PLLEN = ON
CONFIG PCLKEN = OFF
CONFIG FCMEN = OFF
CONFIG IESO = ON
CONFIG PWRTEN = ON
CONFIG BOREN = ON
CONFIG BORV = 27
CONFIG WDTEN = OFF
CONFIG MCLRE = OFF
CONFIG HFOFST = ON
CONFIG STVREN = ON
CONFIG LVP = OFF
CONFIG XINST = OFF
CONFIG CP0 = OFF
CONFIG CP1 = OFF
CONFIG CPB = OFF
CONFIG CPD = OFF
CONFIG WRT0 = OFF
CONFIG WRT1 = OFF
CONFIG WRTB = OFF
CONFIG WRTC = OFF
CONFIG WRTD = OFF
CONFIG EBTR0 = OFF
CONFIG EBTR1 = OFF
CONFIG EBTRB = OFF

	END

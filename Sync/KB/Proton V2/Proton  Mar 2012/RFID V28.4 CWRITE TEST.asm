;----------------------------------------------------------
; Code Produced by the Proton 3.5.0.6
; Copyright Rosetta Technologies/Crownhill Associates Ltd
; Written by Les Johnson. June 2010
;----------------------------------------------------------
;
#DEFINE CONFIG_REQ 1
 LIST  P = 18F4525, F = INHX32, W = 2, X = ON, R = DEC, MM = ON, N = 0, C = 255, T=ON
PORTA EQU 0X0F80
PORTB EQU 0X0F81
PORTC EQU 0X0F82
PORTD EQU 0X0F83
PORTE EQU 0X0F84
LATA EQU 0X0F89
LATB EQU 0X0F8A
LATC EQU 0X0F8B
LATD EQU 0X0F8C
LATE EQU 0X0F8D
DDRA EQU 0X0F92
TRISA EQU 0X0F92
DDRB EQU 0X0F93
TRISB EQU 0X0F93
DDRC EQU 0X0F94
TRISC EQU 0X0F94
DDRD EQU 0X0F95
TRISD EQU 0X0F95
DDRE EQU 0X0F96
TRISE EQU 0X0F96
OSCTUNE EQU 0X0F9B
PIE1 EQU 0X0F9D
PIR1 EQU 0X0F9E
IPR1 EQU 0X0F9F
PIE2 EQU 0X0FA0
PIR2 EQU 0X0FA1
IPR2 EQU 0X0FA2
EECON1 EQU 0X0FA6
EECON2 EQU 0X0FA7
EEDATL EQU 0X0FA8
EEDATA EQU 0X0FA8
EEADR EQU 0X0FA9
EEADRH EQU 0X0FAA
RCSTA EQU 0X0FAB
TXSTA EQU 0X0FAC
TXREG EQU 0X0FAD
RCREG EQU 0X0FAE
SPBRG EQU 0X0FAF
SPBRGH EQU 0X0FB0
T3CON EQU 0X0FB1
TMR3L EQU 0X0FB2
TMR3LH EQU 0X0FB3
TMR3H EQU 0X0FB3
CMCON EQU 0X0FB4
CVRCON EQU 0X0FB5
ECCP1AS EQU 0X0FB6
ECCPAS EQU 0X0FB6
PWM1CON EQU 0X0FB7
BAUDCON EQU 0X0FB8
BAUDCTL EQU 0X0FB8
CCP2CON EQU 0X0FBA
CCPR2 EQU 0X0FBB
CCPR2L EQU 0X0FBB
CCPR2LH EQU 0X0FBC
CCPR2H EQU 0X0FBC
CCP1CON EQU 0X0FBD
CCPR1 EQU 0X0FBE
CCPR1L EQU 0X0FBE
CCPR1LH EQU 0X0FBF
CCPR1H EQU 0X0FBF
ADCON2 EQU 0X0FC0
ADCON1 EQU 0X0FC1
ADCON0 EQU 0X0FC2
ADRES EQU 0X0FC3
ADRESL EQU 0X0FC3
ADRESLH EQU 0X0FC4
ADRESH EQU 0X0FC4
SSPCON2 EQU 0X0FC5
SSPCON1 EQU 0X0FC6
SSPSTAT EQU 0X0FC7
SSPADD EQU 0X0FC8
SSPBUF EQU 0X0FC9
T2CON EQU 0X0FCA
PR2 EQU 0X0FCB
TMR2 EQU 0X0FCC
T1CON EQU 0X0FCD
TMR1L EQU 0X0FCE
TMR1LH EQU 0X0FCF
TMR1H EQU 0X0FCF
RCON EQU 0X0FD0
WDTCON EQU 0X0FD1
HLVDCON EQU 0X0FD2
LVDCON EQU 0X0FD2
OSCCON EQU 0X0FD3
DEBUG EQU 0X0FD4
T0CON EQU 0X0FD5
TMR0L EQU 0X0FD6
TMR0LH EQU 0X0FD7
TMR0H EQU 0X0FD7
STATUS EQU 0X0FD8
FSR2L EQU 0X0FD9
FSR2LH EQU 0X0FDA
FSR2H EQU 0X0FDA
PLUSW2 EQU 0X0FDB
PREINC2 EQU 0X0FDC
POSTDEC2 EQU 0X0FDD
POSTINC2 EQU 0X0FDE
INDF2 EQU 0X0FDF
BSR EQU 0X0FE0
FSR1L EQU 0X0FE1
FSR1LH EQU 0X0FE2
FSR1H EQU 0X0FE2
PLUSW1 EQU 0X0FE3
PREINC1 EQU 0X0FE4
POSTDEC1 EQU 0X0FE5
POSTINC1 EQU 0X0FE6
INDF1 EQU 0X0FE7
WREG EQU 0X0FE8
FSR0L EQU 0X0FE9
FSR0LH EQU 0X0FEA
FSR0H EQU 0X0FEA
PLUSW0 EQU 0X0FEB
PREINC0 EQU 0X0FEC
POSTDEC0 EQU 0X0FED
POSTINC0 EQU 0X0FEE
INDF0 EQU 0X0FEF
INTCON3 EQU 0X0FF0
INTCON2 EQU 0X0FF1
INTCON EQU 0X0FF2
PRODL EQU 0X0FF3
PRODLH EQU 0X0FF4
PRODH EQU 0X0FF4
TABLAT EQU 0X0FF5
TBLPTRL EQU 0X0FF6
TBLPTRLH EQU 0X0FF7
TBLPTRH EQU 0X0FF7
TBLPTRU EQU 0X0FF8
TBLPTRLHH EQU 0X0FF8
PC EQU 0X0FF9
PCL EQU 0X0FF9
PCLATH EQU 0X0FFA
PCLATU EQU 0X0FFB
STKPTR EQU 0X0FFC
TOS EQU 0X0FFD
TOSL EQU 0X0FFD
TOSLH EQU 0X0FFE
TOSH EQU 0X0FFE
TOSU EQU 0X0FFF
_I2C_SCL_PORT = TRISC
_I2C_SCL_PIN = 3
_I2C_SDA_PORT = TRISC
_I2C_SDA_PIN = 4
RA0=0
RA1=1
RA2=2
RA3=3
RA4=4
RA5=5
RA6=6
RA7=7
T0CKI=4
AN4=5
SS=5
NOT_SS=5
LVDIN=5
HLVDIN=5
RB0=0
RB1=1
RB2=2
RB3=3
RB4=4
RB5=5
RB6=6
RB7=7
INT0=0
INT1=1
INT2=2
CCP2_PORTB=3
KBI0=4
KBI1=5
KBI2=6
KBI3=7
AN12=0
AN10=1
AN8=2
AN9=3
AN11=4
PGM=5
PGC=6
PGD=7
RC0=0
RC1=1
RC2=2
RC3=3
RC4=4
RC5=5
RC6=6
RC7=7
T1OSO=0
T1OSI=1
CCP1=2
SCK=3
SDI=4
SDO=5
TX=6
RX=7
T13CKI=0
CCP2_PORTC=1
SCL=3
SDA=4
CK=6
T1CKI=0
RD0=0
RD1=1
RD2=2
RD3=3
RD4=4
RD5=5
RD6=6
RD7=7
PSP0=0
PSP1=1
PSP2=2
PSP3=3
PSP4=4
PSP5=5
PSP6=6
PSP7=7
P1B=5
P1C=6
P1D=7
RE0=0
RE1=1
RE2=2
RE3=3
RD=0
PP_RD=0
WR=1
PP_WR=1
CS=2
MCLR=3
NOT_RD=0
NOT_WR=1
NOT_CS=2
NOT_MCLR=3
AN5=0
AN6=1
AN7=2
VPP=3
LATA0=0
LATA1=1
LATA2=2
LATA3=3
LATA4=4
LATA5=5
LATA6=6
LATA7=7
LATB0=0
LATB1=1
LATB2=2
LATB3=3
LATB4=4
LATB5=5
LATB6=6
LATB7=7
LATC0=0
LATC1=1
LATC2=2
LATC3=3
LATC4=4
LATC5=5
LATC6=6
LATC7=7
LATD0=0
LATD1=1
LATD2=2
LATD3=3
LATD4=4
LATD5=5
LATD6=6
LATD7=7
LATE0=0
LATE1=1
LATE2=2
RA0=0
RA1=1
RA2=2
RA3=3
RA4=4
RA5=5
RA6=6
RA7=7
TRISA0=0
TRISA1=1
TRISA2=2
TRISA3=3
TRISA4=4
TRISA5=5
TRISA6=6
TRISA7=7
RB0=0
RB1=1
RB2=2
RB3=3
RB4=4
RB5=5
RB6=6
RB7=7
TRISB0=0
TRISB1=1
TRISB2=2
TRISB3=3
TRISB4=4
TRISB5=5
TRISB6=6
TRISB7=7
RC0=0
RC1=1
RC2=2
RC3=3
RC4=4
RC5=5
RC6=6
RC7=7
TRISC0=0
TRISC1=1
TRISC2=2
TRISC3=3
TRISC4=4
TRISC5=5
TRISC6=6
TRISC7=7
RD0=0
RD1=1
RD2=2
RD3=3
RD4=4
RD5=5
RD6=6
RD7=7
TRISD0=0
TRISD1=1
TRISD2=2
TRISD3=3
TRISD4=4
TRISD5=5
TRISD6=6
TRISD7=7
RE0=0
RE1=1
RE2=2
RE3=3
TRISE0=0
TRISE1=1
TRISE2=2
TRISE4=4
TRISE5=5
TRISE6=6
TRISE7=7
PSPMODE=4
IBOV=5
OBF=6
IBF=7
TUN0=0
TUN1=1
TUN2=2
TUN3=3
TUN4=4
PLLEN=6
INTSRC=7
TMR1IE=0
TMR2IE=1
CCP1IE=2
SSPIE=3
TXIE=4
RCIE=5
ADIE=6
PSPIE=7
TMR1IF=0
TMR2IF=1
CCP1IF=2
SSPIF=3
TXIF=4
PP_TXIF=4
RCIF=5
PP_RCIF=5
ADIF=6
PSPIF=7
TMR1IP=0
TMR2IP=1
CCP1IP=2
SSPIP=3
TXIP=4
RCIP=5
ADIP=6
PSPIP=7
CCP2IE=0
TMR3IE=1
LVDIE=2
BCLIE=3
EEIE=4
CMIE=6
OSCFIE=7
HLVDIE=2
CCP2IF=0
TMR3IF=1
LVDIF=2
BCLIF=3
EEIF=4
CMIF=6
OSCFIF=7
HLVDIF=2
CCP2IP=0
TMR3IP=1
LVDIP=2
BCLIP=3
EEIP=4
CMIP=6
OSCFIP=7
HLVDIP=2
RD=0
PP_RD=0
WR=1
PP_WR=1
WREN=2
PP_WREN=2
WRERR=3
FREE=4
CFGS=6
EEPGD=7
PP_EEPGD=7
RX9D=0
OERR=1
PP_OERR=1
FERR=2
ADEN=3
CREN=4
PP_CREN=4
SREN=5
RX9=6
SPEN=7
ADDEN=3
TX9D=0
TRMT=1
BRGH=2
SENDB=3
SYNC=4
TXEN=5
TX9=6
CSRC=7
TMR3ON=0
TMR3CS=1
T3SYNC=2
T3CCP1=3
T3CKPS0=4
T3CKPS1=5
T3CCP2=6
RD16=7
NOT_T3SYNC=2
CM0=0
CM1=1
CM2=2
CIS=3
C1INV=4
C2INV=5
C1OUT=6
C2OUT=7
CVR0=0
CVR1=1
CVR2=2
CVR3=3
CVRSS=4
CVRR=5
CVROE=6
CVREN=7
PSSBD0=0
PSSBD1=1
PSSAC0=2
PSSAC1=3
ECCPAS0=4
ECCPAS1=5
ECCPAS2=6
ECCPASE=7
PSSBD0=0
PSSBD1=1
PSSAC0=2
PSSAC1=3
ECCPAS0=4
ECCPAS1=5
ECCPAS2=6
ECCPASE=7
PDC0=0
PDC1=1
PDC2=2
PDC3=3
PDC4=4
PDC5=5
PDC6=6
PRSEN=7
ABDEN=0
WUE=1
BRG16=3
SCKP=4
RCIDL=6
ABDOVF=7
TXCKP=4
RXDTP=5
RCMT=6
ABDEN=0
WUE=1
BRG16=3
SCKP=4
RCIDL=6
ABDOVF=7
TXCKP=4
RXDTP=5
RCMT=6
CCP2M0=0
CCP2M1=1
CCP2M2=2
CCP2M3=3
CCP2Y=4
CCP2X=5
DC2B0=4
DC2B1=5
CCP1M0=0
CCP1M1=1
CCP1M2=2
CCP1M3=3
CCP1Y=4
CCP1X=5
DC1B0=4
DC1B1=5
P1M0=6
P1M1=7
ADCS0=0
ADCS1=1
ADCS2=2
ACQT0=3
ACQT1=4
ACQT2=5
ADFM=7
PCFG0=0
PCFG1=1
PCFG2=2
PCFG3=3
VCFG0=4
VCFG1=5
ADON=0
PP_ADON=0
GO=1
CHS0=2
CHS1=3
CHS2=4
CHS3=5
DONE=1
NOT_DONE=1
GO_DONE=1
PP_GO_DONE=1
SEN=0
PP_SEN=0
RSEN=1
PP_RSEN=1
PEN=2
PP_PEN=2
RCEN=3
PP_RCEN=3
ACKEN=4
PP_ACKEN=4
ACKDT=5
PP_ACKDT=5
ACKSTAT=6
GCEN=7
SSPM0=0
SSPM1=1
SSPM2=2
SSPM3=3
CKP=4
SSPEN=5
SSPOV=6
WCOL=7
BF=0
UA=1
R=2
S=3
P=4
D=5
CKE=6
SMP=7
NOT_W=2
NOT_A=5
R_W=2
PP_R_W=2
D_A=5
NOT_WRITE=2
NOT_ADDRESS=5
T2CKPS0=0
PP_T2CKPS0=0
T2CKPS1=1
PP_T2CKPS1=1
TMR2ON=2
PP_TMR2ON=2
T2OUTPS0=3
T2OUTPS1=4
T2OUTPS2=5
T2OUTPS3=6
TOUTPS0=3
TOUTPS1=4
TOUTPS2=5
TOUTPS3=6
TMR1ON=0
TMR1CS=1
T1SYNC=2
T1OSCEN=3
T1CKPS0=4
T1CKPS1=5
T1RUN=6
RD16=7
NOT_T1SYNC=2
BOR=0
POR=1
PD=2
TO=3
RI=4
SBOREN=6
IPEN=7
NOT_BOR=0
NOT_POR=1
NOT_PD=2
NOT_TO=3
NOT_RI=4
SWDTEN=0
SWDTE=0
LVDL0=0
LVDL1=1
LVDL2=2
LVDL3=3
LVDEN=4
IRVST=5
LVV0=0
LVV1=1
LVV2=2
LVV3=3
BGST=5
HLVDL0=0
HLVDL1=1
HLVDL2=2
HLVDL3=3
HLVDEN=4
VDIRMAG=7
IVRST=5
LVDL0=0
LVDL1=1
LVDL2=2
LVDL3=3
LVDEN=4
IRVST=5
LVV0=0
LVV1=1
LVV2=2
LVV3=3
BGST=5
HLVDL0=0
HLVDL1=1
HLVDL2=2
HLVDL3=3
HLVDEN=4
VDIRMAG=7
IVRST=5
SCS0=0
SCS1=1
IOFS=2
OSTS=3
IRCF0=4
IRCF1=5
IRCF2=6
IDLEN=7
FLTS=2
T0PS0=0
T0PS1=1
T0PS2=2
PSA=3
T0SE=4
T0CS=5
T016BIT=6
TMR0ON=7
T08BIT=6
C=0
DC=1
Z=2
OV=3
N=4
INT1F=0
INT2F=1
INT1E=3
INT2E=4
INT1P=6
INT2P=7
INT1IF=0
INT2IF=1
INT1IE=3
INT2IE=4
INT1IP=6
INT2IP=7
RBIP=0
TMR0IP=2
INTEDG2=4
INTEDG1=5
INTEDG0=6
RBPU=7
NOT_RBPU=7
RBIF=0
INT0F=1
TMR0IF=2
RBIE=3
INT0E=4
TMR0IE=5
PEIE=6
GIE=7
INT0IF=1
T0IF=2
INT0IE=4
T0IE=5
GIEL=6
GIEH=7
STKPTR0=0
STKPTR1=1
STKPTR2=2
STKPTR3=3
STKPTR4=4
STKUNF=6
STKOVF=7
SP0=0
SP1=1
SP2=2
SP3=3
SP4=4
STKFUL=7
  __MAXRAM  0X0FFF
  __BADRAM  0X0F85-0X0F88
  __BADRAM  0X0F8E-0X0F91
  __BADRAM  0X0F97-0X0F9A
  __BADRAM  0X0F9C
  __BADRAM  0X0FA3-0X0FA5
  __BADRAM  0X0FB9
CONFIG1H EQU 0X300001
CONFIG2L EQU 0X300002
CONFIG2H EQU 0X300003
CONFIG3H EQU 0X300005
CONFIG4L EQU 0X300006
CONFIG5L EQU 0X300008
CONFIG5H EQU 0X300009
CONFIG6L EQU 0X30000A
CONFIG6H EQU 0X30000B
CONFIG7L EQU 0X30000C
CONFIG7H EQU 0X30000D
OSC_LP_1 EQU 0XF0
OSC_XT_1 EQU 0XF1
OSC_HS_1 EQU 0XF2
OSC_RC_1 EQU 0XF3
OSC_EC_1 EQU 0XF4
OSC_ECIO6_1 EQU 0XF5
OSC_HSPLL_1 EQU 0XF6
OSC_RCIO6_1 EQU 0XF7
OSC_INTIO67_1 EQU 0XF8
OSC_INTIO7_1 EQU 0XF9
FCMEN_OFF_1 EQU 0XBF
FCMEN_ON_1 EQU 0XFF
IESO_OFF_1 EQU 0X7F
IESO_ON_1 EQU 0XFF
PWRT_ON_2 EQU 0XFE
PWRT_OFF_2 EQU 0XFF
BOREN_OFF_2 EQU 0XF9
BOREN_ON_2 EQU 0XFB
BOREN_NOSLP_2 EQU 0XFD
BOREN_SBORDIS_2 EQU 0XFF
BORV_0_2 EQU 0XE7
BORV_1_2 EQU 0XEF
BORV_2_2 EQU 0XF7
BORV_3_2 EQU 0XFF
WDT_OFF_2 EQU 0XFE
WDT_ON_2 EQU 0XFF
WDTPS_1_2 EQU 0XE1
WDTPS_2_2 EQU 0XE3
WDTPS_4_2 EQU 0XE5
WDTPS_8_2 EQU 0XE7
WDTPS_16_2 EQU 0XE9
WDTPS_32_2 EQU 0XEB
WDTPS_64_2 EQU 0XED
WDTPS_128_2 EQU 0XEF
WDTPS_256_2 EQU 0XF1
WDTPS_512_2 EQU 0XF3
WDTPS_1024_2 EQU 0XF5
WDTPS_2048_2 EQU 0XF7
WDTPS_4096_2 EQU 0XF9
WDTPS_8192_2 EQU 0XFB
WDTPS_16384_2 EQU 0XFD
WDTPS_32768_2 EQU 0XFF
MCLRE_OFF_3 EQU 0X7F
MCLRE_ON_3 EQU 0XFF
LPT1OSC_OFF_3 EQU 0XFB
LPT1OSC_ON_3 EQU 0XFF
PBADEN_OFF_3 EQU 0XFD
PBADEN_ON_3 EQU 0XFF
CCP2MX_PORTBE_3 EQU 0XFE
CCP2MX_PORTC_3 EQU 0XFF
STVREN_OFF_4 EQU 0XFE
STVREN_ON_4 EQU 0XFF
LVP_OFF_4 EQU 0XFB
LVP_ON_4 EQU 0XFF
XINST_OFF_4 EQU 0XBF
XINST_ON_4 EQU 0XFF
DEBUG_ON_4 EQU 0X7F
DEBUG_OFF_4 EQU 0XFF
CP0_ON_5 EQU 0XFE
CP0_OFF_5 EQU 0XFF
CP1_ON_5 EQU 0XFD
CP1_OFF_5 EQU 0XFF
CP2_ON_5 EQU 0XFB
CP2_OFF_5 EQU 0XFF
CPB_ON_5 EQU 0XBF
CPB_OFF_5 EQU 0XFF
CPD_ON_5 EQU 0X7F
CPD_OFF_5 EQU 0XFF
WRT0_ON_6 EQU 0XFE
WRT0_OFF_6 EQU 0XFF
WRT1_ON_6 EQU 0XFD
WRT1_OFF_6 EQU 0XFF
WRT2_ON_6 EQU 0XFB
WRT2_OFF_6 EQU 0XFF
WRTB_ON_6 EQU 0XBF
WRTB_OFF_6 EQU 0XFF
WRTC_ON_6 EQU 0XDF
WRTC_OFF_6 EQU 0XFF
WRTD_ON_6 EQU 0X7F
WRTD_OFF_6 EQU 0XFF
EBTR0_ON_7 EQU 0XFE
EBTR0_OFF_7 EQU 0XFF
EBTR1_ON_7 EQU 0XFD
EBTR1_OFF_7 EQU 0XFF
EBTR2_ON_7 EQU 0XFB
EBTR2_OFF_7 EQU 0XFF
EBTRB_ON_7 EQU 0XBF
EBTRB_OFF_7 EQU 0XFF
DEVID1 EQU 0X3FFFFE
DEVID2 EQU 0X3FFFFF
IDLOC0 EQU 0X200000
__IDLOC0 EQU 0X200000
IDLOC1 EQU 0X200001
__IDLOC1 EQU 0X200001
IDLOC2 EQU 0X200002
__IDLOC2 EQU 0X200002
IDLOC3 EQU 0X200003
__IDLOC3 EQU 0X200003
IDLOC4 EQU 0X200004
__IDLOC4 EQU 0X200004
IDLOC5 EQU 0X200005
__IDLOC5 EQU 0X200005
IDLOC6 EQU 0X200006
__IDLOC6 EQU 0X200006
IDLOC7 EQU 0X200007
__IDLOC7 EQU 0X200007
#DEFINE __18F4525 1
#DEFINE XTAL 4
#DEFINE _CORE 16
#DEFINE _MAXRAM 3968
#DEFINE _RAM_END 3968
#DEFINE _MAXMEM 49152
#DEFINE _ADC 13
#DEFINE _ADC_RES 10
#DEFINE _EEPROM 1024
#DEFINE RAM_BANKS 15
#DEFINE _USART 1
#DEFINE _USB 0
#DEFINE _USB#RAM_START 0
#DEFINE _FLASH 1
#DEFINE _CWRITE_BLOCK 64
#DEFINE BANK0_START 128
#DEFINE BANK0_END 255
#DEFINE BANK1_START 256
#DEFINE BANK1_END 511
#DEFINE BANK2_START 512
#DEFINE BANK2_END 767
#DEFINE BANK3_START 768
#DEFINE BANK3_END 1023
#DEFINE BANK4_START 1024
#DEFINE BANK4_END 1279
#DEFINE BANK5_START 1280
#DEFINE BANK5_END 1535
#DEFINE BANK6_START 1536
#DEFINE BANK6_END 1791
#DEFINE BANK7_START 1792
#DEFINE BANK7_END 2047
#DEFINE BANK8_START 2048
#DEFINE BANK8_END 2303
#DEFINE BANK9_START 2304
#DEFINE BANK9_END 2559
#DEFINE BANK10_START 2560
#DEFINE BANK10_END 2815
#DEFINE BANK11_START 2816
#DEFINE BANK11_END 3071
#DEFINE BANK12_START 3072
#DEFINE BANK12_END 3327
#DEFINE BANK13_START 3328
#DEFINE BANK13_END 3583
#DEFINE BANK14_START 3584
#DEFINE BANK14_END 3839
#DEFINE BANKA_START 0
#DEFINE BANKA_END 127
#DEFINE _SYSTEM_VARIABLE_COUNT 16
RAM_BANK = 0
#DEFINE LCD#DTPORT PORTD
#DEFINE LCD#DTPIN 0
#DEFINE LCD#RSPORT PORTD
#DEFINE LCD#RSPIN 7
#DEFINE LCD#ENPORT PORTD
#DEFINE LCD#ENPIN 6
#DEFINE LCD#INTERFACE 4
#DEFINE LCD#LINES 2
#DEFINE LCD#TYPE 0
#DEFINE CLRW CLRF WREG
#DEFINE NEGW NEGF WREG
#DEFINE SKPC BTFSS STATUS,0
#DEFINE SKPNC BTFSC STATUS,0
#DEFINE CLRC BCF STATUS,0
#DEFINE SETC BSF STATUS,0
#DEFINE SKPZ BTFSS STATUS,2
#DEFINE SKPNZ BTFSC STATUS,2
#DEFINE CLRZ BCF STATUS,2
#DEFINE SETZ BSF STATUS,2
MOVFW MACRO PVARIN
    MOVF PVARIN,W
    ENDM
RLF MACRO PVARIN,PDESTINATION
    RLCF PVARIN,PDESTINATION
    ENDM
RRF MACRO PVARIN,PDESTINATION
    RRCF PVARIN,PDESTINATION
    ENDM
JUMP MACRO PLABEL
    GOTO PLABEL
    ENDM
F@CALL MACRO PDESTINATION
IF (PDESTINATION < 1)
    CALL PDESTINATION
ELSE
IF (PDESTINATION > $)
    CALL PDESTINATION
ELSE
IF (PDESTINATION < ($ - 0X03FF))
    CALL PDESTINATION
ELSE
    RCALL PDESTINATION
ENDIF
ENDIF
ENDIF
    ENDM
F@JUMP MACRO PDESTINATION
IFDEF WATCHDOG_REQ
IF ($ == PDESTINATION)
    CLRWDT
ENDIF
ENDIF
IF (PDESTINATION < 1)
    GOTO PDESTINATION
ELSE
IF ((PDESTINATION) > $)
    GOTO PDESTINATION
ELSE
IF ((PDESTINATION) < ($ - 0X03FF))
    GOTO PDESTINATION
ELSE
    BRA PDESTINATION
ENDIF
ENDIF
ENDIF
    ENDM
IFDEF WATCHDOG_REQ
    CHK@SLF MACRO PDESTINATION
IF ($ == PDESTINATION)
    CLRWDT
ENDIF
    ENDM
ENDIF
G@OTO MACRO PDESTINATION
IF (PDESTINATION < 1)
    BTFSC STATUS,OV
    GOTO PDESTINATION
ELSE
IF (PDESTINATION > $)
    BTFSC STATUS,OV
    GOTO PDESTINATION
ELSE
IF (PDESTINATION < ($ - 127))
    BTFSC STATUS,OV
    GOTO PDESTINATION
ELSE
    BOV PDESTINATION
ENDIF
ENDIF
ENDIF
    ENDM
GO@TO MACRO PDESTINATION
IF (PDESTINATION < 1)
    GOTO PDESTINATION
ELSE
IF (PDESTINATION > $)
    GOTO PDESTINATION
ELSE
IF (PDESTINATION < ($ - 0X03FF))
    GOTO PDESTINATION
ELSE
    BRA PDESTINATION
ENDIF
ENDIF
ENDIF
    ENDM
S@B MACRO PVARIN
IF ((PVARIN > BANKA_END) & (PVARIN < 0X0F80))
IF ((PVARIN & 0X0F00) != (RAM_BANK << 8))
    MOVLB HIGH (PVARIN)
    RAM_BANK = (PVARIN >> 8)
ENDIF
ENDIF
    ENDM
R@B MACRO
IF(RAM_BANK != 0)
    MOVLB 0
    RAM_BANK = 0
ENDIF
    ENDM
WREG_BYTE MACRO PBYTEOUT
    MOVFF WREG,PBYTEOUT
    ENDM
WREG_BIT MACRO PVAROUT,PBITOUT
    S@B PVAROUT
    BTFSC WREG,0
    BSF PVAROUT,PBITOUT
    BTFSS WREG,0
    BCF PVAROUT,PBITOUT
    R@B
    ENDM
WREG_WORD MACRO PWORDOUT
    MOVFF WREG,PWORDOUT
    MOVLW 0
    MOVFF WREG,PWORDOUT+1
    ENDM
WREG_DWORD MACRO PDWORDOUT
    MOVFF WREG,PDWORDOUT
    MOVLW 0
    MOVFF WREG,PDWORDOUT+3
    MOVFF WREG,PDWORDOUT+2
    MOVFF WREG,PDWORDOUT+1
    ENDM
NUM_SFR MACRO PNUMIN,PSFROUT
    MOVLW PNUMIN
    MOVWF PSFROUT
    ENDM
BYTE_WREG MACRO PBYTEIN
    MOVFF PBYTEIN,WREG
    ENDM
NUM_WREG MACRO PNUMIN
    MOVLW (PNUMIN & 255)
    ENDM
NUM_BYTE MACRO PNUMIN,PBYTEOUT
    MOVLW (PNUMIN & 255)
    MOVFF WREG,PBYTEOUT
    ENDM
NUM_BIT MACRO PNUMIN,PVAROUT,PBITOUT
    S@B PVAROUT
IF((PNUMIN & 1) == 1)
    BSF PVAROUT,PBITOUT
ELSE
    BCF PVAROUT,PBITOUT
ENDIF
    R@B
    ENDM
NUM_WORD MACRO PNUMIN,PWORDOUT
IFDEF _USELFSR
IF(PWORDOUT == FSR0L)
    LFSR 0,PNUMIN
    EXITM
ENDIF
IF(PWORDOUT == FSR1L)
    LFSR 1,PNUMIN
    EXITM
ENDIF
IF(PWORDOUT == FSR2L)
    LFSR 2,PNUMIN
    EXITM
ENDIF
ENDIF
    S@B PWORDOUT
    MOVLW (PNUMIN & 255)
    MOVWF PWORDOUT
    S@B PWORDOUT+1
    MOVLW HIGH (PNUMIN)
    MOVWF PWORDOUT+1
    R@B
    ENDM
NUM_DWORD MACRO PNUMIN,PDWORDOUT
    S@B PDWORDOUT
    MOVLW LOW (PNUMIN)
    MOVWF PDWORDOUT
    S@B PDWORDOUT+1
    MOVLW HIGH (PNUMIN)
    MOVWF PDWORDOUT+1
    S@B PDWORDOUT+2
    MOVLW ((PNUMIN >> 16) & 255)
    MOVWF PDWORDOUT+2
    S@B PDWORDOUT+3
    MOVLW ((PNUMIN >> 24) & 255)
    MOVWF PDWORDOUT+3
    R@B
    ENDM
BIT_WREG MACRO PVARIN,PBITIN
    S@B PVARIN
    CLRW
    BTFSC PVARIN,PBITIN
    MOVLW 1
    R@B
    ENDM
BIT_BYTE MACRO PVARIN,PBITIN,PBYTEOUT
    S@B PVARIN
    CLRW
    BTFSC PVARIN,PBITIN
    MOVLW 1
    S@B PBYTEOUT
    MOVWF PBYTEOUT
    R@B
    ENDM
BIT_BIT MACRO PVARIN,PBITIN,PVAROUT,PBITOUT
IF ((PVARIN & 0X0F00) == (PVAROUT & 0X0F00))
    S@B PVARIN
    BTFSC PVARIN,PBITIN
    BSF PVAROUT,PBITOUT
    BTFSS PVARIN,PBITIN
    BCF PVAROUT,PBITOUT
ELSE
IF ((PVARIN <= BANKA_END) | (PVARIN >= 0X0F80))
    S@B PVAROUT
    BTFSC PVARIN,PBITIN
    BSF PVAROUT,PBITOUT
    BTFSS PVARIN,PBITIN
    BCF PVAROUT,PBITOUT
ELSE
IF ((PVAROUT <= BANKA_END) | (PVAROUT >= 0X0F80))
    S@B PVARIN
    BTFSC PVARIN,PBITIN
    BSF PVAROUT,PBITOUT
    BTFSS PVARIN,PBITIN
    BCF PVAROUT,PBITOUT
ELSE
    S@B PVARIN
    CLRDC
    BTFSC PVARIN,PBITIN
    SETDC
    S@B PVAROUT
    SKPNDC
    BSF PVAROUT,PBITOUT
    SKPDC
    BCF PVAROUT,PBITOUT
ENDIF
ENDIF
ENDIF
    R@B
    ENDM
BIT_WORD MACRO PVARIN,PBITIN,PWORDOUT
    S@B PWORDOUT+1
    CLRF PWORDOUT+1
    BIT_BYTE PVARIN,PBITIN,PWORDOUT
    ENDM
BIT_DWORD MACRO PVARIN,PBITIN,PDWORDOUT
    S@B PDWORDOUT+3
    CLRF PDWORDOUT+3
    S@B PDWORDOUT+2
    CLRF PDWORDOUT+2
    S@B PDWORDOUT+1
    CLRF PDWORDOUT+1
    BIT_BYTE PVARIN,PBITIN,PDWORDOUT
    ENDM
WORD_WREG MACRO PWORDIN
    BYTE_WREG PWORDIN
    ENDM
WORD_BYTE MACRO PWORDIN,PBYTEOUT
    BYTE_BYTE PWORDIN,PBYTEOUT
    ENDM
WORD_BIT MACRO PWORDIN,PVAROUT,PBITOUT
    BYTE_BIT PWORDIN, PVAROUT, PBITOUT
    ENDM
WORD_WORD MACRO PWORDIN,PWORDOUT
    MOVFF PWORDIN+1,PWORDOUT+1
    MOVFF PWORDIN,PWORDOUT
    ENDM
WORD_DWORD MACRO PWORDIN,PDWORDOUT
    MOVLW 0
    MOVFF WREG,PDWORDOUT+3
    MOVFF WREG,PDWORDOUT+2
    WORD_WORD PWORDIN,PDWORDOUT
    ENDM
BYTE_BYTE MACRO PBYTEIN,PBYTEOUT
    MOVFF PBYTEIN,PBYTEOUT
    ENDM
BYTE_WORD MACRO PBYTEIN,PWORDOUT
    MOVLW 0
    MOVFF WREG,PWORDOUT+1
    BYTE_BYTE PBYTEIN,PWORDOUT
    ENDM
BYTE_DWORD MACRO PBYTEIN,PDWORDOUT
    MOVLW 0
    MOVFF WREG,PDWORDOUT+3
    MOVFF WREG,PDWORDOUT+2
    MOVFF WREG,PDWORDOUT+1
    BYTE_BYTE PBYTEIN,PDWORDOUT
    ENDM
BYTE_BIT MACRO PBYTEIN,PVAROUT,PBITOUT
IF ((PBYTEIN & 0X0F00) == (PVAROUT & 0X0F00))
    S@B PBYTEIN
    BTFSC PBYTEIN,0
    BSF PVAROUT,PBITOUT
    BTFSS PBYTEIN,0
    BCF PVAROUT,PBITOUT
ELSE
IF ((PBYTEIN <= BANKA_END) | (PBYTEIN >= 0X0F80))
    S@B PVAROUT
    BTFSC PBYTEIN,0
    BSF PVAROUT,PBITOUT
    BTFSS PBYTEIN,0
    BCF PVAROUT,PBITOUT
ELSE
IF ((PVAROUT <= BANKA_END) | (PVAROUT >= 0X0F80))
    S@B PBYTEIN
    BTFSC PBYTEIN,0
    BSF PVAROUT,PBITOUT
    BTFSS PBYTEIN,0
    BCF PVAROUT,PBITOUT
ELSE
    S@B PBYTEIN
    RRF PBYTEIN,W
    S@B PVAROUT
    SKPNC
    BSF PVAROUT,PBITOUT
    SKPC
    BCF PVAROUT,PBITOUT
ENDIF
ENDIF
ENDIF
    R@B
    ENDM
DWORD_WREG MACRO PDWORDIN
    BYTE_WREG PDWORDIN
    ENDM
DWORD_BYTE MACRO PDWORDIN,PBYTEOUT
    BYTE_BYTE PDWORDIN,PBYTEOUT
    ENDM
DWORD_WORD MACRO PDWORDIN,PWORDOUT
    MOVFF PDWORDIN+1,PWORDOUT+1
    MOVFF PDWORDIN,PWORDOUT
    ENDM
DWORD_DWORD MACRO PDWORDIN,PDWORDOUT
    MOVFF PDWORDIN+3,PDWORDOUT+3
    MOVFF PDWORDIN+2,PDWORDOUT+2
    MOVFF PDWORDIN+1,PDWORDOUT+1
    MOVFF PDWORDIN,PDWORDOUT
    ENDM
DWORD_BIT MACRO PDWORDIN,PVAROUT,PBITOUT
    BYTE_BIT PDWORDIN,PVAROUT,PBITOUT
    ENDM
NUM_FLOAT MACRO PNUMIN,PFLOATOUT
    NUM_BYTE PNUMIN,PFLOATOUT+3
    NUM_BYTE ((PNUMIN >> 8) & 255),PFLOATOUT+2
    NUM_BYTE ((PNUMIN >> 16) & 255),PFLOATOUT+1
    NUM_BYTE ((PNUMIN >> 24) & 255),PFLOATOUT
    ENDM
WREG_FLOAT MACRO PFLOATOUT
    CALL INT08@TOFL32
    MOVFF PP_AARG,PFLOATOUT
    MOVFF PP_AARGH,PFLOATOUT+1
    MOVFF PP_AARGHH,PFLOATOUT+2
    MOVFF PP_AARGHHH,PFLOATOUT+3
    ENDM
BIT_FLOAT MACRO PVARIN,PBITIN,PFLOATOUT
    BIT_WREG PVARIN,PBITIN
    CALL INT08@TOFL32
    MOVFF PP_AARG,PFLOATOUT
    MOVFF PP_AARGH,PFLOATOUT+1
    MOVFF PP_AARGHH,PFLOATOUT+2
    MOVFF PP_AARGHHH,PFLOATOUT+3
    ENDM
BYTE_FLOAT MACRO PBYTEIN,PFLOATOUT
    BYTE_WREG PBYTEIN
    CALL INT08@TOFL32
    MOVFF PP_AARG,PFLOATOUT
    MOVFF PP_AARGH,PFLOATOUT+1
    MOVFF PP_AARGHH,PFLOATOUT+2
    MOVFF PP_AARGHHH,PFLOATOUT+3
    ENDM
WORD_FLOAT MACRO PWORDIN,PFLOATOUT
    BYTE_BYTE PWORDIN,PP_AARG
    BYTE_BYTE PWORDIN+1,PP_AARGH
    CALL INT16@TOFL32
    MOVFF PP_AARG,PFLOATOUT
    MOVFF PP_AARGH,PFLOATOUT+1
    MOVFF PP_AARGHH,PFLOATOUT+2
    MOVFF PP_AARGHHH,PFLOATOUT+3
    ENDM
DWORD_FLOAT MACRO PDWORDIN,PFLOATOUT
    MOVFF PDWORDIN,PP_AARG
    MOVFF PDWORDIN+1,PP_AARGH
    MOVFF PDWORDIN+2,PP_AARGHH
    MOVFF PDWORDIN+3,PP_AARGHHH
    CALL INT32@TOFL32
    MOVFF PP_AARG,PFLOATOUT
    MOVFF PP_AARGH,PFLOATOUT+1
    MOVFF PP_AARGHH,PFLOATOUT+2
    MOVFF PP_AARGHHH,PFLOATOUT+3
    ENDM
FLOAT_FLOAT MACRO PFLOATIN,PFLOATOUT
    MOVFF PFLOATIN,PFLOATOUT
    MOVFF PFLOATIN+1,PFLOATOUT+1
    MOVFF PFLOATIN+2,PFLOATOUT+2
    MOVFF PFLOATIN+3,PFLOATOUT+3
    ENDM
FLOAT_WREG MACRO PFLOATIN
    FLOAT_FLOAT PFLOATIN,PP_AARG
    CALL FL32@TOINT32
    ENDM
FLOAT_BIT MACRO PFLOATIN,PVAROUT,PBITOUT
    FLOAT_FLOAT PFLOATIN,PP_AARG
    CALL FL32@TOINT32
    WREG_BIT PVAROUT,PBITOUT
    ENDM
FLOAT_BYTE MACRO PFLOATIN,PBYTEOUT
    FLOAT_FLOAT PFLOATIN,PP_AARG
    CALL FL32@TOINT32
    WREG_BYTE PBYTEOUT
    ENDM
FLOAT_WORD MACRO PFLOATIN,PWORDOUT
    FLOAT_FLOAT PFLOATIN,PP_AARG
    CALL FL32@TOINT32
    MOVFF PP_AARGHHH,PWORDOUT
    MOVFF PP_AARGHH,PWORDOUT+1
    ENDM
FLOAT_DWORD MACRO PFLOATIN,PDWORDOUT
    FLOAT_FLOAT PFLOATIN,PP_AARG
    CALL FL32@TOINT32
    MOVFF PP_AARGHHH,PDWORDOUT
    MOVFF PP_AARGHH,PDWORDOUT+1
    MOVFF PP_AARGH,PDWORDOUT+2
    MOVFF PP_AARG,PDWORDOUT+3
    ENDM
NUM_FSR0 MACRO PNUMIN
    LFSR 0, PNUMIN
    ENDM
NUM_FSR1 MACRO PNUMIN
    LFSR 1, PNUMIN
    ENDM
NUM_FSR2 MACRO PNUMIN
    LFSR 2, PNUMIN
    ENDM
LABEL_WORD MACRO PLABELIN,PWORDOUT
    MOVLW LOW (PLABELIN)
    MOVFF WREG, PWORDOUT
    MOVLW HIGH (PLABELIN)
    MOVFF WREG, PWORDOUT+1
    ENDM
LABEL_POINTER MACRO PLABELIN
    MOVLW LOW (PLABELIN)
    MOVWF TBLPTRL
    MOVLW HIGH (PLABELIN)
    MOVWF TBLPTRH
    MOVLW UPPER (PLABELIN)
    MOVWF TBLPTRU
    ENDM
BPF = 0
BPFH = 1
GEN = 2
GENH = 3
GENL = 4
PBP#RND = 5
PBP#RNDH = 6
PP0 = 7
PP0H = 8
PP1 = 9
PP1H = 10
PP2 = 11
PP2H = 12
PP3 = 13
PP3H = 14
PP4 = 15
TAGIN = 16
VARIABLE TAGIN#0=16,TAGIN#1=17,TAGIN#2=18,TAGIN#3=19
VARIABLE TAGIN#4=20,TAGIN#5=21,TAGIN#6=22,TAGIN#7=23
VARIABLE TAGIN#8=24,TAGIN#9=25
TAGBYTE = 26
VARIABLE TAGBYTE#0=26,TAGBYTE#1=27,TAGBYTE#2=28,TAGBYTE#3=29
VARIABLE TAGBYTE#4=30,TAGBYTE#5=31,TAGBYTE#6=32,TAGBYTE#7=33
VARIABLE TAGBYTE#8=34,TAGBYTE#9=35
MODNUM = 36
VARIABLE MODNUM#0=36,MODNUM#1=37,MODNUM#2=38,MODNUM#3=39
VARIABLE MODNUM#4=40,MODNUM#5=41,MODNUM#6=42
M_U_CODE = 43
VARIABLE M_U_CODE#0=43,M_U_CODE#1=44,M_U_CODE#2=45,M_U_CODE#3=46
BBOOT_CNT = 47
BRESET_TYPE = 48
ETX = 49
CHECKSUM = 50
RESPONSE = 51
MYCOUNT = 52
INDEX = 53
INDEX2 = 54
BYTE_VAR = 55
WORD_VAR = 56
WORD_VARH = 57
MYNUM = 58
VARIABLE MYNUM#0=58,MYNUM#1=59,MYNUM#2=60,MYNUM#3=61
RESET_CAUSE = 62
VARIABLE RESET_CAUSE#0=62,RESET_CAUSE#1=63,RESET_CAUSE#2=64,RESET_CAUSE#3=65
VARIABLE RESET_CAUSE#4=66,RESET_CAUSE#5=67,RESET_CAUSE#6=68,RESET_CAUSE#7=69
VARIABLE RESET_CAUSE#8=70,RESET_CAUSE#9=71,RESET_CAUSE#10=72
#DEFINE SD_CS PORTC,2
#DEFINE SD_DI PORTC,5
#DEFINE SD_CLK PORTC,3
#DEFINE SD_DO PORTC,4
#DEFINE __LCD_DTPORT PORTD
#DEFINE __LCD_ENPORT PORTD
#DEFINE __LCD_RSPORT PORTD
#DEFINE SD_DETECT PORTC,1
#DEFINE RFIDENABLE PORTD,4
#DEFINE STARTENABLE PORTE,1
#DEFINE SP1 PORTC,0
#DEFINE RED PORTA,0
#DEFINE GREEN PORTA,1
#DEFINE VC PORTA,3
#DEFINE SDC PORTD,5
#DEFINE __XTAL 4
#DEFINE __LCD_TYPE 0
#DEFINE __LCD_DTPIN 0
#DEFINE __LCD_ENPIN 6
#DEFINE __LCD_RSPIN 7
#DEFINE __LCD_INTERFACE 4
#DEFINE __LCD_LINES 2
#DEFINE __HSERIAL_BAUD 9600
#DEFINE __HSERIAL_RCSTA 144
#DEFINE __HSERIAL_TXSTA 32
#DEFINE BUA 40064
#DEFINE BUAH 156
#DEFINE FLASHERASESEG 64
#DEFINE ENDOFCODESPACE 42614
#DEFINE ENDOFCODESPACEH 166
#DEFINE FLASHWRITEBLOCK 16
#DEFINE NUM_USERS 1
#DEFINE NUM_UHE 2
#DEFINE NUM_MHE 3
#DEFINE DBO 4
#DEFINE TOP 5
#DEFINE SOO 6
#DEFINE MOP 7
#DEFINE EBOOT_CNT_LOCATION 16
#DEFINE UHA 26
#DEFINE MHA 912
#DEFINE MHAH 3
#DEFINE MAX_UH 50
#DEFINE MAX_MH 10
PROTON#CODE#START
        ORG 0
        GOTO PROTON#MAIN#START
        ORG 8
LCD@CLS
        MOVLW 128
        MOVWF 1
CLS
        MOVLW 254
        CALL CH@SND
        MOVLW 1
        CALL CH@SND
        MOVLW 117
        MOVWF 8
        MOVLW 48
        GOTO DLUS@W
PRINT@MSTR
PRINT@MSTRL
        CLRF 4006
        BSF 4006,PP_EEPGD
PRT@MTL1
        TBLRD*+
        MOVF 4085,W
        BZ PRT@MTEXT
        RCALL PRINT
        BRA PRT@MTL1
PRT@MTEXT
        RETURN
PRINT
        MOVWF 14
        BCF LATD,6
        NOP
        BCF LATD,7
        BCF TRISD,6
        BCF TRISD,7
        MOVLW 240
        ANDWF TRISD,F
        MOVF 14,W
        BTFSC 0,1
        GOTO PRT@1
        MOVLW 58
        MOVWF 8
        MOVLW 152
        CALL DLUS@W
        MOVLW 51
        MOVWF 13
        RCALL PR@LP
        MOVLW 19
        MOVWF 8
        MOVLW 136
        CALL DLUS@W
        RCALL PR@LP
        MOVLW 100
        CALL DL@US
        RCALL PR@LP
        MOVLW 100
        CALL DL@US
        MOVLW 34
        MOVWF 13
        RCALL PR@LP
        MOVLW 40
        RCALL PR@CM
        MOVLW 12
        RCALL PR@CM
        MOVLW 6
        RCALL PR@CM
        BSF 0,1
        MOVF 14,W
        BRA PRT@1
PR@CM
        BSF 0,0
PRT@1
        MOVWF 13
        BTFSS 0,0
        BRA PR@CC
        BCF LATD,7
        SUBLW 3
        BNC PR@SD
        RCALL PR@SD
        MOVLW 7
        MOVWF 8
        MOVLW 208
        CALL DLUS@W
        BSF 4056,0
        RETURN
PR@CC
        BSF 0,0
        SUBLW 254
        BZ PR@EX
        BSF LATD,7
PR@SD
        SWAPF 13,F
        BTFSS 0,0
PR@LP
        BCF 0,0
        BSF LATD,6
        MOVLW 240
        ANDWF PORTD,F
        MOVF 13,W
        ANDLW 15
        IORWF PORTD,F
        BCF LATD,6
        SWAPF 13,F
        BTFSC 0,0
        BRA PR@LP
        MOVLW 50
        CALL DL@US
        BSF 4056,0
PR@EX
        MOVF 14,W
        RETURN
CH@SND
        BTFSC 1,7
        GOTO PRINT
EE@RD
        CLRF 4010
        MOVWF 4009
EE@RD@W
        CLRF 4006
        BSF 4006,PP_RD
        MOVF 4008,W
        INFSNZ 4009,F
        INCF 4010,F
        RETURN
EE@WR
        CLRF 4010
EE@WR@W
        MOVWF 4008
        CLRF 4006
        BSF 4006,PP_WREN
        MOVLW 85
        MOVWF 4007
        MOVLW 170
        MOVWF 4007
        BSF 4006,PP_WR
        BTFSC 4006,PP_WR
        BRA $ - 2
        BCF 4006,PP_WREN
        INFSNZ 4009,F
        INCF 4010,F
        RETURN
C@WRITE
        MOVWF 4085
        TBLWT*
        INCF 4086,W
        ANDLW 63
        BNZ CR@EXIT
        MOVLW 132
        MOVWF 4006
        MOVLW 85
        MOVWF 4007
        MOVLW 170
        MOVWF 4007
        BSF 4006,PP_WR
        BRA $ + 2
        BCF 4006,PP_WREN
CR@EXIT
        INFSNZ 4086,F
        INCF 4087,F
        RETURN
C@ERASE
        MOVWF 4086
C@ERASE2
        MOVLW 148
        MOVWF 4006
        MOVLW 85
        MOVWF 4007
        MOVLW 170
        MOVWF 4007
        BSF 4006,PP_WR
        NOP
        BCF 4006,PP_WREN
        RETURN
NOISE
        MOVWF 10
        MOVLW 15
        MOVWF 4074
        MOVFF 2,4073
        COMF 3,W
        BSF 4073,4
        INCF 4073,F
        ANDWF 4076,F
        MOVFF 2,4073
        MOVF 10,W
        BTFSC 4056,2
        BRA SND@EXIT
        MOVLW 240
        MOVWF 12
SND@LP
        MOVF 9,W
        IORLW 128
        MOVWF 11
SND@LP1
        MOVLW 240
        DECF 12,F
        BTFSC 4056,2
        MOVWF 12
        BTFSC 4056,2
        DECF 10,F
        BTFSC 4056,2
        BRA SND@EXIT
        BRA $ + 2
        RCALL RN@DM
        BRA $ + 2
        CLRF 4072
        BTFSC 5,0
        MOVF 3,W
        BTFSS 9,7
        MOVF 3,W
        MOVF 9,F
        BTFSC 4056,2
        CLRF 4072
        INCFSZ 11,F
        BRA $ + 6
        XORWF 4079,F
        BRA SND@LP
        BRA $ + 2
        NOP
        BRA SND@LP1
SND@EXIT
        MOVF 3,W
        BSF 4073,4
        INCF 4073,F
        IORWF 4076,F
        RETURN
RN@DM
        MOVF 6,W
        IORWF 5,W
        BTFSC 4056,2
        INCF 5,F
        RLCF 6,W
        XORWF 6,W
        RLCF 4072,F
        SWAPF 6,F
        SWAPF 5,W
        RLNCF 4072,F
        XORWF 6,W
        SWAPF 6,F
        ANDLW 1
        RLCF 5,F
        XORWF 5,F
        RLCF 6,F
        MOVF 5,W
        RETURN
DL@MS
        CLRF 10
DLY@W
        MOVWF 9
DLY@P
        MOVLW 255
        ADDWF 9,F
        ADDWFC 10,F
        BRA $ + 2
        BTFSS 4056,0
        RETURN
        MOVLW 3
        MOVWF 8
        MOVLW 223
        RCALL DLUS@W
        BRA DLY@P
DL@US
        CLRF 8
DLUS@W
        ADDLW 233
        MOVWF 7
        MOVLW 252
        BNC $ + 12
        NOP
        NOP
        ADDWF 7,F
        BC $ - 4
        NOP
        ADDWF 7,F
        DECF 8,F
        BC $ - 12
        BTFSC 7,0
        BRA $ + 2
        BTFSS 7,1
        BRA $ + 6
        BRA $ + 2
        NOP
        RETURN
STR@LB1
        DB 68,111,110,101,32,70,108,97,115,104,0
PROTON#MAIN#START
        CLRF 4088
        CLRF 0
        CLRF 4011
        MOVLB 0
F2_SOF EQU $ ; RFID V28.4 CWRITE TEST.PRP
F3_SOF EQU $ ; RFID V28.4 CWRITE TEST_FWD.PBP
F3_EOF EQU $ ; RFID V28.4 CWRITE TEST_FWD.PBP
F2_EOF EQU $ ; RFID V28.4 CWRITE TEST.PRP
F1_SOF EQU $ ; RFID V28.4 CWRITE TEST.BAS
F4_SOF EQU $ ; INITIALIZE.INC
F4_000047 EQU $ ; IN [INITIALIZE.INC] ALL_DIGITAL = TRUE
        MOVLW 7
        MOVWF CMCON,0
        MOVLW 15
        MOVWF ADCON1,0
F4_000137 EQU $ ; IN [INITIALIZE.INC] DELAYMS 200
        MOVLW 200
        F@CALL DL@MS
F4_000138 EQU $ ; IN [INITIALIZE.INC] HIGH SDC
        BCF TRISD,5,0
        BSF LATD,5,0
F4_000139 EQU $ ; IN [INITIALIZE.INC] INPUT SD_DETECT
        BSF TRISC,1,0
F4_000140 EQU $ ; IN [INITIALIZE.INC] GOSUB HIGH_V
        F@CALL HIGH_V
F4_000141 EQU $ ; IN [INITIALIZE.INC] LOW RFIDENABLE
        BCF TRISD,4,0
        BCF LATD,4,0
F4_000142 EQU $ ; IN [INITIALIZE.INC] LOW STARTENABLE
        BCF TRISE,1,0
        BCF LATE,1,0
F4_000143 EQU $ ; IN [INITIALIZE.INC] LOW RED
        BCF TRISA,0,0
        BCF LATA,0,0
F4_000144 EQU $ ; IN [INITIALIZE.INC] LOW GREEN
        BCF TRISA,1,0
        BCF LATA,1,0
F4_000148 EQU $ ; IN [INITIALIZE.INC] BYTE_VAR = EREAD NUM_UHE
        MOVLW 2
        F@CALL EE@RD
        MOVWF BYTE_VAR,0
F4_000149 EQU $ ; IN [INITIALIZE.INC] IF BYTE_VAR = 0XFF THEN
        INCFSZ BYTE_VAR,W,0
        F@JUMP BC@LL2
F4_000150 EQU $ ; IN [INITIALIZE.INC] EWRITE NUM_USERS,[0X00]
        MOVLW 1
        MOVWF EEADR,0
        CLRF EEADRH,0
        MOVLW 0
        F@CALL EE@WR@W
F4_000151 EQU $ ; IN [INITIALIZE.INC] EWRITE NUM_UHE,[0X00]
        MOVLW 2
        MOVWF EEADR,0
        CLRF EEADRH,0
        MOVLW 0
        F@CALL EE@WR@W
F4_000152 EQU $ ; IN [INITIALIZE.INC] EWRITE NUM_MHE,[0X00]
        MOVLW 3
        MOVWF EEADR,0
        CLRF EEADRH,0
        MOVLW 0
        F@CALL EE@WR@W
F4_000153 EQU $ ; IN [INITIALIZE.INC] EWRITE DBO,[0X00]
        MOVLW 4
        MOVWF EEADR,0
        CLRF EEADRH,0
        MOVLW 0
        F@CALL EE@WR@W
F4_000154 EQU $ ; IN [INITIALIZE.INC] EWRITE TOP,[0X1E]
        MOVLW 5
        MOVWF EEADR,0
        CLRF EEADRH,0
        MOVLW 30
        F@CALL EE@WR@W
F4_000155 EQU $ ; IN [INITIALIZE.INC] EWRITE SOO,[0X01]
        MOVLW 6
        MOVWF EEADR,0
        CLRF EEADRH,0
        MOVLW 1
        F@CALL EE@WR@W
F4_000156 EQU $ ; IN [INITIALIZE.INC] EWRITE MOP,[0X00]
        MOVLW 7
        MOVWF EEADR,0
        CLRF EEADRH,0
        MOVLW 0
        F@CALL EE@WR@W
F4_000157 EQU $ ; IN [INITIALIZE.INC] ENDIF
BC@LL2
F4_EOF EQU $ ; INITIALIZE.INC
F1_000012 EQU $ ; IN [RFID V28.4 CWRITE TEST.BAS] CLS
        F@CALL LCD@CLS
F1_000013 EQU $ ; IN [RFID V28.4 CWRITE TEST.BAS] PRINT "START"
        MOVLW 83
        F@CALL PRINT
        MOVLW 116
        F@CALL PRINT
        MOVLW 97
        F@CALL PRINT
        MOVLW 114
        F@CALL PRINT
        MOVLW 116
        F@CALL PRINT
F1_000014 EQU $ ; IN [RFID V28.4 CWRITE TEST.BAS] GOSUB BEEP
        F@CALL BEEP
F1_000015 EQU $ ; IN [RFID V28.4 CWRITE TEST.BAS] PAUSE 2000
        MOVLW 7
        MOVWF PP1H,0
        MOVLW 208
        F@CALL DLY@W
F1_000016 EQU $ ; IN [RFID V28.4 CWRITE TEST.BAS] GOSUB RESET_DIAGNOSTIC_LOGGER
        F@CALL RESET_DIAGNOSTIC_LOGGER
F1_000017 EQU $ ; IN [RFID V28.4 CWRITE TEST.BAS] GOSUB ERASEPROGRAMDATA
        F@CALL ERASEPROGRAMDATA
F1_000018 EQU $ ; IN [RFID V28.4 CWRITE TEST.BAS] GOSUB WRITETOPROM
        F@CALL WRITETOPROM
F1_000019 EQU $ ; IN [RFID V28.4 CWRITE TEST.BAS] CLS
        F@CALL LCD@CLS
F1_000020 EQU $ ; IN [RFID V28.4 CWRITE TEST.BAS] PRINT "DONE FLASH"
        MOVLW HIGH (STR@LB1)
        MOVWF TBLPTRLH,0
        MOVLW LOW (STR@LB1)
        MOVWF TBLPTRL,0
        F@CALL PRINT@MSTR
F1_000021 EQU $ ; IN [RFID V28.4 CWRITE TEST.BAS] END
PB@LB4
        SLEEP
        BRA PB@LB4
ERASEPROGRAMDATA
F1_000029 EQU $ ; IN [RFID V28.4 CWRITE TEST.BAS] WORD_VAR = BUA
        MOVLW 128
        MOVWF WORD_VAR,0
        MOVLW 156
        MOVWF WORD_VARH,0
F1_000031 EQU $ ; IN [RFID V28.4 CWRITE TEST.BAS] REPEAT
BC@LL4
F1_000032 EQU $ ; IN [RFID V28.4 CWRITE TEST.BAS] CERASE WORD_VAR
        MOVFF WORD_VARH,TBLPTRLH
        MOVF WORD_VAR,W,0
        F@CALL C@ERASE
F1_000033 EQU $ ; IN [RFID V28.4 CWRITE TEST.BAS] WORD_VAR = WORD_VAR + FLASHERASESEG
        MOVLW 64
        ADDWF WORD_VAR,F,0
        MOVLW 0
        ADDWFC WORD_VARH,F,0
F1_000034 EQU $ ; IN [RFID V28.4 CWRITE TEST.BAS] UNTIL WORD_VAR >= ENDOFCODESPACE
        MOVLW 118
        SUBWF WORD_VAR,W,0
        MOVLW 166
        SUBWFB WORD_VARH,W,0
        BTFSS STATUS,0,0
        GO@TO BC@LL4
BC@LL5
F1_000035 EQU $ ; IN [RFID V28.4 CWRITE TEST.BAS] RESPONSE = 0
        CLRF RESPONSE,0
F1_000036 EQU $ ; IN [RFID V28.4 CWRITE TEST.BAS] RETURN
        RETURN 0
WRITETOPROM
F1_000045 EQU $ ; IN [RFID V28.4 CWRITE TEST.BAS] WORD_VAR = BUA
        MOVLW 128
        MOVWF WORD_VAR,0
        MOVLW 156
        MOVWF WORD_VARH,0
F1_000048 EQU $ ; IN [RFID V28.4 CWRITE TEST.BAS] INDEX = 0
        CLRF INDEX,0
F1_000049 EQU $ ; IN [RFID V28.4 CWRITE TEST.BAS] REPEAT
BC@LL6
F1_000050 EQU $ ; IN [RFID V28.4 CWRITE TEST.BAS] BYTE_VAR = RANDOM
        F@CALL RN@DM
        MOVWF BYTE_VAR,0
F1_000051 EQU $ ; IN [RFID V28.4 CWRITE TEST.BAS] PRINT BYTE_VAR
        MOVF BYTE_VAR,W,0
        F@CALL PRINT
F1_000052 EQU $ ; IN [RFID V28.4 CWRITE TEST.BAS] PAUSE 1000
        MOVLW 3
        MOVWF PP1H,0
        MOVLW 232
        F@CALL DLY@W
F1_000053 EQU $ ; IN [RFID V28.4 CWRITE TEST.BAS] CWRITE WORD_VAR,[BYTE_VAR  ]
        MOVFF WORD_VAR,TBLPTRL
        MOVFF WORD_VARH,TBLPTRLH
        MOVF BYTE_VAR,W,0
        F@CALL C@WRITE
F1_000054 EQU $ ; IN [RFID V28.4 CWRITE TEST.BAS] INC INDEX
        INCF INDEX,F,0
F1_000055 EQU $ ; IN [RFID V28.4 CWRITE TEST.BAS] INC WORD_VAR
        INFSNZ WORD_VAR,F,0
        INCF WORD_VARH,F,0
F1_000056 EQU $ ; IN [RFID V28.4 CWRITE TEST.BAS] UNTIL INDEX >= FLASHWRITEBLOCK
        MOVLW 15
        CPFSGT INDEX,0
        F@JUMP BC@LL6
BC@LL7
F1_000058 EQU $ ; IN [RFID V28.4 CWRITE TEST.BAS] RETURN
        RETURN 0
F5_SOF EQU $ ; SOUND.INC
BEEP
F5_000023 EQU $ ; IN [SOUND.INC] GOSUB HIGH_V
        F@CALL HIGH_V
F5_000024 EQU $ ; IN [SOUND.INC] SOUND SP1,[110,50]
        MOVLW PORTC
        MOVWF GEN,0
        MOVLW 1
        MOVWF GENH,0
        MOVLW 110
        MOVWF PP1,0
        MOVLW 50
        F@CALL NOISE
F5_000025 EQU $ ; IN [SOUND.INC] RETURN
        RETURN 0
ERROR_BEEP
F5_000028 EQU $ ; IN [SOUND.INC] GOSUB HIGH_V
        F@CALL HIGH_V
F5_000029 EQU $ ; IN [SOUND.INC] SOUND SP1,[110,30,118,30]
        MOVLW PORTC
        MOVWF GEN,0
        MOVLW 1
        MOVWF GENH,0
        MOVLW 110
        MOVWF PP1,0
        MOVLW 30
        F@CALL NOISE
        MOVLW 118
        MOVWF PP1,0
        MOVLW 30
        F@CALL NOISE
F5_000030 EQU $ ; IN [SOUND.INC] RETURN
        RETURN 0
F5_EOF EQU $ ; SOUND.INC
F6_SOF EQU $ ; VOLTAGE_CONTROL.INC
LOW_V
F6_000012 EQU $ ; IN [VOLTAGE_CONTROL.INC] INPUT VC
        BSF TRISA,3,0
F6_000013 EQU $ ; IN [VOLTAGE_CONTROL.INC] LOW SDC
        BCF TRISD,5,0
        BCF LATD,5,0
F6_000014 EQU $ ; IN [VOLTAGE_CONTROL.INC] RETURN
        RETURN 0
HIGH_V
F6_000017 EQU $ ; IN [VOLTAGE_CONTROL.INC] HIGH SDC
        BCF TRISD,5,0
        BSF LATD,5,0
F6_000018 EQU $ ; IN [VOLTAGE_CONTROL.INC] LOW VC
        BCF TRISA,3,0
        BCF LATA,3,0
F6_000019 EQU $ ; IN [VOLTAGE_CONTROL.INC] RETURN
        RETURN 0
F6_EOF EQU $ ; VOLTAGE_CONTROL.INC
F7_SOF EQU $ ; RESET_LOGGER.INC
RESET_DIAGNOSTIC_LOGGER
F7_000012 EQU $ ; IN [RESET_LOGGER.INC] BBOOT_CNT = EREAD EBOOT_CNT_LOCATION
        MOVLW 16
        F@CALL EE@RD
        MOVWF BBOOT_CNT,0
F7_000013 EQU $ ; IN [RESET_LOGGER.INC] IF BBOOT_CNT = 255 THEN
        INCFSZ BBOOT_CNT,W,0
        F@JUMP BC@LL9
RESET_COUNT
F7_000014 EQU $ ; IN [RESET_LOGGER.INC] RESET_COUNT:       BBOOT_CNT = 1
        MOVLW 1
        MOVWF BBOOT_CNT,0
F7_000015 EQU $ ; IN [RESET_LOGGER.INC] EWRITE EBOOT_CNT_LOCATION,[BBOOT_CNT]
        MOVLW 16
        MOVWF EEADR,0
        CLRF EEADRH,0
        MOVF BBOOT_CNT,W,0
        F@CALL EE@WR@W
F7_000016 EQU $ ; IN [RESET_LOGGER.INC] GOTO WRITE_PCON_DATA
        F@JUMP WRITE_PCON_DATA
F7_000017 EQU $ ; IN [RESET_LOGGER.INC] ENDIF
BC@LL9
F7_000018 EQU $ ; IN [RESET_LOGGER.INC] IF BBOOT_CNT > 10 THEN GOTO RESET_COUNT
        MOVLW 11
        SUBWF BBOOT_CNT,W,0
        BTFSS STATUS,0,0
        GO@TO BC@LL11
        F@JUMP RESET_COUNT
BC@LL11
F7_000019 EQU $ ; IN [RESET_LOGGER.INC] INC BBOOT_CNT
        INCF BBOOT_CNT,F,0
F7_000020 EQU $ ; IN [RESET_LOGGER.INC] EWRITE EBOOT_CNT_LOCATION,[BBOOT_CNT]
        MOVLW 16
        MOVWF EEADR,0
        CLRF EEADRH,0
        MOVF BBOOT_CNT,W,0
        F@CALL EE@WR@W
WRITE_PCON_DATA
F7_000024 EQU $ ; IN [RESET_LOGGER.INC] SELECT RCON
F7_000025 EQU $ ; IN [RESET_LOGGER.INC] CASE 12,13
        MOVLW 12
        SUBWF RCON,W,0
        BTFSC STATUS,2,0
        GO@TO BC@LL14
        MOVLW 13
        CPFSEQ RCON,0
        F@JUMP BC@LL13
BC@LL14
F7_000026 EQU $ ; IN [RESET_LOGGER.INC] BRESET_TYPE = 1
        MOVLW 1
        MOVWF BRESET_TYPE,0
        F@JUMP BC@LL12
BC@LL13
F7_000027 EQU $ ; IN [RESET_LOGGER.INC] CASE 7
        MOVLW 7
        CPFSEQ RCON,0
        F@JUMP BC@LL16
F7_000028 EQU $ ; IN [RESET_LOGGER.INC] BRESET_TYPE = 2
        MOVLW 2
        MOVWF BRESET_TYPE,0
        F@JUMP BC@LL12
BC@LL16
F7_000029 EQU $ ; IN [RESET_LOGGER.INC] CASE 15
        MOVLW 15
        CPFSEQ RCON,0
        F@JUMP BC@LL18
F7_000030 EQU $ ; IN [RESET_LOGGER.INC] BRESET_TYPE = 3
        MOVLW 3
        MOVWF BRESET_TYPE,0
        F@JUMP BC@LL12
BC@LL18
F7_000031 EQU $ ; IN [RESET_LOGGER.INC] CASE 14
        MOVLW 14
        CPFSEQ RCON,0
        F@JUMP BC@LL20
F7_000032 EQU $ ; IN [RESET_LOGGER.INC] BRESET_TYPE = 4
        MOVLW 4
        MOVWF BRESET_TYPE,0
        F@JUMP BC@LL12
BC@LL20
F7_000033 EQU $ ; IN [RESET_LOGGER.INC] CASE 11
        MOVLW 11
        CPFSEQ RCON,0
        F@JUMP BC@LL22
F7_000034 EQU $ ; IN [RESET_LOGGER.INC] BRESET_TYPE = 5
        MOVLW 5
        MOVWF BRESET_TYPE,0
        F@JUMP BC@LL12
BC@LL22
F7_000035 EQU $ ; IN [RESET_LOGGER.INC] CASE 143
        MOVLW 143
        CPFSEQ RCON,0
        F@JUMP BC@LL24
F7_000036 EQU $ ; IN [RESET_LOGGER.INC] BRESET_TYPE = 6
        MOVLW 6
        MOVWF BRESET_TYPE,0
        F@JUMP BC@LL12
BC@LL24
F7_000037 EQU $ ; IN [RESET_LOGGER.INC] CASE 79
        MOVLW 79
        CPFSEQ RCON,0
        F@JUMP BC@LL26
F7_000038 EQU $ ; IN [RESET_LOGGER.INC] BRESET_TYPE = 7
        MOVLW 7
        MOVWF BRESET_TYPE,0
F7_000039 EQU $ ; IN [RESET_LOGGER.INC] CASE ELSE
        F@JUMP BC@LL28
BC@LL26
F7_000040 EQU $ ; IN [RESET_LOGGER.INC] BRESET_TYPE = RCON
        MOVFF RCON,BRESET_TYPE
F7_000041 EQU $ ; IN [RESET_LOGGER.INC] END SELECT
BC@LL28
BC@LL12
F7_000043 EQU $ ; IN [RESET_LOGGER.INC] EWRITE EBOOT_CNT_LOCATION + BBOOT_CNT,[BRESET_TYPE]
        MOVLW 16
        ADDWF BBOOT_CNT,W,0
        MOVWF EEADR,0
        CLRF EEADRH,0
        RLCF EEADRH,F,0
        MOVF BRESET_TYPE,W,0
        F@CALL EE@WR@W
OVER_BOOT_LOGGER
F7_000045 EQU $ ; IN [RESET_LOGGER.INC] RCON = 001111
        MOVLW 1111
        MOVWF RCON,0
F7_000082 EQU $ ; IN [RESET_LOGGER.INC] RETURN
        RETURN 0
F7_EOF EQU $ ; RESET_LOGGER.INC
        ORG 40000
        DB 65,50,55,66,56,51
        DB 66,0
F1_EOF EQU $ ; RFID V28.4 CWRITE TEST.BAS
PB@LB30
        BRA PB@LB30
__EOF
CONFIG OSC = XT
CONFIG PWRT = ON
CONFIG BOREN = OFF
CONFIG MCLRE = ON
CONFIG PBADEN = OFF
CONFIG STVREN = OFF
CONFIG WDT = OFF
CONFIG LVP = ON
CONFIG XINST = OFF
CONFIG CP0 = OFF
CONFIG CP1 = OFF
CONFIG CPB = OFF
CONFIG CPD = OFF
CONFIG WRT0 = OFF
CONFIG WRT1 = OFF
CONFIG WRTB = OFF
CONFIG WRTC = OFF
CONFIG WRTD = OFF
CONFIG EBTR0 = OFF
CONFIG EBTR1 = OFF
CONFIG EBTRB = OFF
        END

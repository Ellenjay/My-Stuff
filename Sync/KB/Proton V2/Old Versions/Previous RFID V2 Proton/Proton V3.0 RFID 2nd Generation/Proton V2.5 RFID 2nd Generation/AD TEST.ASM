;----------------------------------------------------------
; Code Produced by the Proton+ 3.3.4.8
; Copyright Rosetta Technologies/Crownhill Associates Ltd
; Written by Les Johnson. July 2008
;----------------------------------------------------------
;
#DEFINE CONFIG_REQ 1
 LIST  P = 18F4525, F = INHX32, W = 2, X = ON, R = DEC, MM = ON, N = 0, C = 255
PORTA EQU 0X0F80
PORTB EQU 0X0F81
PORTC EQU 0X0F82
PORTD EQU 0X0F83
PORTE EQU 0X0F84
LATA EQU 0X0F89
LATB EQU 0X0F8A
LATC EQU 0X0F8B
LATD EQU 0X0F8C
LATE EQU 0X0F8D
DDRA EQU 0X0F92
TRISA EQU 0X0F92
DDRB EQU 0X0F93
TRISB EQU 0X0F93
DDRC EQU 0X0F94
TRISC EQU 0X0F94
DDRD EQU 0X0F95
TRISD EQU 0X0F95
DDRE EQU 0X0F96
TRISE EQU 0X0F96
OSCTUNE EQU 0X0F9B
PIE1 EQU 0X0F9D
PIR1 EQU 0X0F9E
IPR1 EQU 0X0F9F
PIE2 EQU 0X0FA0
PIR2 EQU 0X0FA1
IPR2 EQU 0X0FA2
EECON1 EQU 0X0FA6
EECON2 EQU 0X0FA7
EEDATL EQU 0X0FA8
EEDATA EQU 0X0FA8
EEADR EQU 0X0FA9
EEADRH EQU 0X0FAA
RCSTA EQU 0X0FAB
TXSTA EQU 0X0FAC
TXREG EQU 0X0FAD
RCREG EQU 0X0FAE
SPBRG EQU 0X0FAF
SPBRGH EQU 0X0FB0
T3CON EQU 0X0FB1
TMR3L EQU 0X0FB2
TMR3LH EQU 0X0FB3
TMR3H EQU 0X0FB3
CMCON EQU 0X0FB4
CVRCON EQU 0X0FB5
ECCP1AS EQU 0X0FB6
ECCPAS EQU 0X0FB6
PWM1CON EQU 0X0FB7
BAUDCON EQU 0X0FB8
BAUDCTL EQU 0X0FB8
CCP2CON EQU 0X0FBA
CCPR2 EQU 0X0FBB
CCPR2L EQU 0X0FBB
CCPR2LH EQU 0X0FBC
CCPR2H EQU 0X0FBC
CCP1CON EQU 0X0FBD
CCPR1 EQU 0X0FBE
CCPR1L EQU 0X0FBE
CCPR1LH EQU 0X0FBF
CCPR1H EQU 0X0FBF
ADCON2 EQU 0X0FC0
ADCON1 EQU 0X0FC1
ADCON0 EQU 0X0FC2
ADRES EQU 0X0FC3
ADRESL EQU 0X0FC3
ADRESLH EQU 0X0FC4
ADRESH EQU 0X0FC4
SSPCON2 EQU 0X0FC5
SSPCON1 EQU 0X0FC6
SSPSTAT EQU 0X0FC7
SSPADD EQU 0X0FC8
SSPBUF EQU 0X0FC9
T2CON EQU 0X0FCA
PR2 EQU 0X0FCB
TMR2 EQU 0X0FCC
T1CON EQU 0X0FCD
TMR1L EQU 0X0FCE
TMR1LH EQU 0X0FCF
TMR1H EQU 0X0FCF
RCON EQU 0X0FD0
WDTCON EQU 0X0FD1
HLVDCON EQU 0X0FD2
LVDCON EQU 0X0FD2
OSCCON EQU 0X0FD3
DEBUG EQU 0X0FD4
T0CON EQU 0X0FD5
TMR0L EQU 0X0FD6
TMR0LH EQU 0X0FD7
TMR0H EQU 0X0FD7
STATUS EQU 0X0FD8
FSR2L EQU 0X0FD9
FSR2LH EQU 0X0FDA
FSR2H EQU 0X0FDA
PLUSW2 EQU 0X0FDB
PREINC2 EQU 0X0FDC
POSTDEC2 EQU 0X0FDD
POSTINC2 EQU 0X0FDE
INDF2 EQU 0X0FDF
BSR EQU 0X0FE0
FSR1L EQU 0X0FE1
FSR1LH EQU 0X0FE2
FSR1H EQU 0X0FE2
PLUSW1 EQU 0X0FE3
PREINC1 EQU 0X0FE4
POSTDEC1 EQU 0X0FE5
POSTINC1 EQU 0X0FE6
INDF1 EQU 0X0FE7
WREG EQU 0X0FE8
FSR0L EQU 0X0FE9
FSR0LH EQU 0X0FEA
FSR0H EQU 0X0FEA
PLUSW0 EQU 0X0FEB
PREINC0 EQU 0X0FEC
POSTDEC0 EQU 0X0FED
POSTINC0 EQU 0X0FEE
INDF0 EQU 0X0FEF
INTCON3 EQU 0X0FF0
INTCON2 EQU 0X0FF1
INTCON EQU 0X0FF2
PRODL EQU 0X0FF3
PRODLH EQU 0X0FF4
PRODH EQU 0X0FF4
TABLAT EQU 0X0FF5
TBLPTRL EQU 0X0FF6
TBLPTRLH EQU 0X0FF7
TBLPTRH EQU 0X0FF7
TBLPTRU EQU 0X0FF8
TBLPTRLHH EQU 0X0FF8
PC EQU 0X0FF9
PCL EQU 0X0FF9
PCLATH EQU 0X0FFA
PCLATU EQU 0X0FFB
STKPTR EQU 0X0FFC
TOS EQU 0X0FFD
TOSL EQU 0X0FFD
TOSLH EQU 0X0FFE
TOSH EQU 0X0FFE
TOSU EQU 0X0FFF
_I2C_SCL_PORT = TRISC
_I2C_SCL_PIN = 3
_I2C_SDA_PORT = TRISC
_I2C_SDA_PIN = 4
RA0=0
RA1=1
RA2=2
RA3=3
RA4=4
RA5=5
RA6=6
RA7=7
T0CKI=4
AN4=5
SS=5
NOT_SS=5
LVDIN=5
HLVDIN=5
RB0=0
RB1=1
RB2=2
RB3=3
RB4=4
RB5=5
RB6=6
RB7=7
INT0=0
INT1=1
INT2=2
CCP2_PORTB=3
KBI0=4
KBI1=5
KBI2=6
KBI3=7
AN12=0
AN10=1
AN8=2
AN9=3
AN11=4
PGM=5
PGC=6
PGD=7
RC0=0
RC1=1
RC2=2
RC3=3
RC4=4
RC5=5
RC6=6
RC7=7
T1OSO=0
T1OSI=1
CCP1=2
SCK=3
SDI=4
SDO=5
TX=6
RX=7
T13CKI=0
CCP2_PORTC=1
SCL=3
SDA=4
CK=6
T1CKI=0
RD0=0
RD1=1
RD2=2
RD3=3
RD4=4
RD5=5
RD6=6
RD7=7
PSP0=0
PSP1=1
PSP2=2
PSP3=3
PSP4=4
PSP5=5
PSP6=6
PSP7=7
P1B=5
P1C=6
P1D=7
RE0=0
RE1=1
RE2=2
RE3=3
RD=0
PP_RD=0
WR=1
PP_WR=1
CS=2
MCLR=3
NOT_RD=0
NOT_WR=1
NOT_CS=2
NOT_MCLR=3
AN5=0
AN6=1
AN7=2
VPP=3
LATA0=0
LATA1=1
LATA2=2
LATA3=3
LATA4=4
LATA5=5
LATA6=6
LATA7=7
LATB0=0
LATB1=1
LATB2=2
LATB3=3
LATB4=4
LATB5=5
LATB6=6
LATB7=7
LATC0=0
LATC1=1
LATC2=2
LATC3=3
LATC4=4
LATC5=5
LATC6=6
LATC7=7
LATD0=0
LATD1=1
LATD2=2
LATD3=3
LATD4=4
LATD5=5
LATD6=6
LATD7=7
LATE0=0
LATE1=1
LATE2=2
RA0=0
RA1=1
RA2=2
RA3=3
RA4=4
RA5=5
RA6=6
RA7=7
TRISA0=0
TRISA1=1
TRISA2=2
TRISA3=3
TRISA4=4
TRISA5=5
TRISA6=6
TRISA7=7
RB0=0
RB1=1
RB2=2
RB3=3
RB4=4
RB5=5
RB6=6
RB7=7
TRISB0=0
TRISB1=1
TRISB2=2
TRISB3=3
TRISB4=4
TRISB5=5
TRISB6=6
TRISB7=7
RC0=0
RC1=1
RC2=2
RC3=3
RC4=4
RC5=5
RC6=6
RC7=7
TRISC0=0
TRISC1=1
TRISC2=2
TRISC3=3
TRISC4=4
TRISC5=5
TRISC6=6
TRISC7=7
RD0=0
RD1=1
RD2=2
RD3=3
RD4=4
RD5=5
RD6=6
RD7=7
TRISD0=0
TRISD1=1
TRISD2=2
TRISD3=3
TRISD4=4
TRISD5=5
TRISD6=6
TRISD7=7
RE0=0
RE1=1
RE2=2
RE3=3
TRISE0=0
TRISE1=1
TRISE2=2
TRISE4=4
TRISE5=5
TRISE6=6
TRISE7=7
PSPMODE=4
IBOV=5
OBF=6
IBF=7
TUN0=0
TUN1=1
TUN2=2
TUN3=3
TUN4=4
PLLEN=6
INTSRC=7
TMR1IE=0
TMR2IE=1
CCP1IE=2
SSPIE=3
TXIE=4
RCIE=5
ADIE=6
PSPIE=7
TMR1IF=0
TMR2IF=1
CCP1IF=2
SSPIF=3
TXIF=4
PP_TXIF=4
RCIF=5
PP_RCIF=5
ADIF=6
PSPIF=7
TMR1IP=0
TMR2IP=1
CCP1IP=2
SSPIP=3
TXIP=4
RCIP=5
ADIP=6
PSPIP=7
CCP2IE=0
TMR3IE=1
LVDIE=2
BCLIE=3
EEIE=4
CMIE=6
OSCFIE=7
HLVDIE=2
CCP2IF=0
TMR3IF=1
LVDIF=2
BCLIF=3
EEIF=4
CMIF=6
OSCFIF=7
HLVDIF=2
CCP2IP=0
TMR3IP=1
LVDIP=2
BCLIP=3
EEIP=4
CMIP=6
OSCFIP=7
HLVDIP=2
RD=0
PP_RD=0
WR=1
PP_WR=1
WREN=2
PP_WREN=2
WRERR=3
FREE=4
CFGS=6
EEPGD=7
PP_EEPGD=7
RX9D=0
OERR=1
PP_OERR=1
FERR=2
ADEN=3
CREN=4
PP_CREN=4
SREN=5
RX9=6
SPEN=7
ADDEN=3
TX9D=0
TRMT=1
BRGH=2
SENDB=3
SYNC=4
TXEN=5
TX9=6
CSRC=7
TMR3ON=0
TMR3CS=1
T3SYNC=2
T3CCP1=3
T3CKPS0=4
T3CKPS1=5
T3CCP2=6
RD16=7
NOT_T3SYNC=2
CM0=0
CM1=1
CM2=2
CIS=3
C1INV=4
C2INV=5
C1OUT=6
C2OUT=7
CVR0=0
CVR1=1
CVR2=2
CVR3=3
CVRSS=4
CVRR=5
CVROE=6
CVREN=7
PSSBD0=0
PSSBD1=1
PSSAC0=2
PSSAC1=3
ECCPAS0=4
ECCPAS1=5
ECCPAS2=6
ECCPASE=7
PSSBD0=0
PSSBD1=1
PSSAC0=2
PSSAC1=3
ECCPAS0=4
ECCPAS1=5
ECCPAS2=6
ECCPASE=7
PDC0=0
PDC1=1
PDC2=2
PDC3=3
PDC4=4
PDC5=5
PDC6=6
PRSEN=7
ABDEN=0
WUE=1
BRG16=3
SCKP=4
RCIDL=6
ABDOVF=7
RCMT=6
ABDEN=0
WUE=1
BRG16=3
SCKP=4
RCIDL=6
ABDOVF=7
RCMT=6
CCP2M0=0
CCP2M1=1
CCP2M2=2
CCP2M3=3
CCP2Y=4
CCP2X=5
DC2B0=4
DC2B1=5
CCP1M0=0
CCP1M1=1
CCP1M2=2
CCP1M3=3
CCP1Y=4
CCP1X=5
DC1B0=4
DC1B1=5
P1M0=6
P1M1=7
ADCS0=0
ADCS1=1
ADCS2=2
ACQT0=3
ACQT1=4
ACQT2=5
ADFM=7
PCFG0=0
PCFG1=1
PCFG2=2
PCFG3=3
VCFG0=4
VCFG1=5
ADON=0
PP_ADON=0
GO=1
CHS0=2
CHS1=3
CHS2=4
CHS3=5
DONE=1
NOT_DONE=1
GO_DONE=1
PP_GO_DONE=1
SEN=0
PP_SEN=0
RSEN=1
PP_RSEN=1
PEN=2
PP_PEN=2
RCEN=3
PP_RCEN=3
ACKEN=4
PP_ACKEN=4
ACKDT=5
ACKSTAT=6
GCEN=7
SSPM0=0
SSPM1=1
SSPM2=2
SSPM3=3
CKP=4
SSPEN=5
SSPOV=6
WCOL=7
BF=0
UA=1
R=2
S=3
P=4
D=5
CKE=6
SMP=7
NOT_W=2
NOT_A=5
R_W=2
PP_R_W=2
D_A=5
NOT_WRITE=2
NOT_ADDRESS=5
T2CKPS0=0
PP_T2CKPS0=0
T2CKPS1=1
PP_T2CKPS1=1
TMR2ON=2
PP_TMR2ON=2
T2OUTPS0=3
T2OUTPS1=4
T2OUTPS2=5
T2OUTPS3=6
TOUTPS0=3
TOUTPS1=4
TOUTPS2=5
TOUTPS3=6
TMR1ON=0
TMR1CS=1
T1SYNC=2
T1OSCEN=3
T1CKPS0=4
T1CKPS1=5
T1RUN=6
RD16=7
NOT_T1SYNC=2
BOR=0
POR=1
PD=2
TO=3
RI=4
SBOREN=6
IPEN=7
NOT_BOR=0
NOT_POR=1
NOT_PD=2
NOT_TO=3
NOT_RI=4
SWDTEN=0
SWDTE=0
LVDL0=0
LVDL1=1
LVDL2=2
LVDL3=3
LVDEN=4
IRVST=5
LVV0=0
LVV1=1
LVV2=2
LVV3=3
BGST=5
HLVDL0=0
HLVDL1=1
HLVDL2=2
HLVDL3=3
HLVDEN=4
VDIRMAG=7
IVRST=5
SCS0=0
SCS1=1
IOFS=2
OSTS=3
IRCF0=4
IRCF1=5
IRCF2=6
IDLEN=7
FLTS=2
T0PS0=0
T0PS1=1
T0PS2=2
PSA=3
T0SE=4
T0CS=5
T016BIT=6
TMR0ON=7
T08BIT=6
C=0
DC=1
Z=2
OV=3
N=4
INT1F=0
INT2F=1
INT1E=3
INT2E=4
INT1P=6
INT2P=7
INT1IF=0
INT2IF=1
INT1IE=3
INT2IE=4
INT1IP=6
INT2IP=7
RBIP=0
TMR0IP=2
INTEDG2=4
INTEDG1=5
INTEDG0=6
RBPU=7
NOT_RBPU=7
RBIF=0
INT0F=1
TMR0IF=2
RBIE=3
INT0E=4
TMR0IE=5
PEIE=6
GIE=7
INT0IF=1
T0IF=2
INT0IE=4
T0IE=5
GIEL=6
GIEH=7
STKPTR0=0
STKPTR1=1
STKPTR2=2
STKPTR3=3
STKPTR4=4
STKUNF=6
STKOVF=7
SP0=0
SP1=1
SP2=2
SP3=3
SP4=4
STKFUL=7
  __MAXRAM  0X0FFF
  __BADRAM  0X0F85-0X0F88
  __BADRAM  0X0F8E-0X0F91
  __BADRAM  0X0F97-0X0F9A
  __BADRAM  0X0F9C
  __BADRAM  0X0FA3-0X0FA5
  __BADRAM  0X0FB9
CONFIG1H EQU 0X300001
CONFIG2L EQU 0X300002
CONFIG2H EQU 0X300003
CONFIG3H EQU 0X300005
CONFIG4L EQU 0X300006
CONFIG5L EQU 0X300008
CONFIG5H EQU 0X300009
CONFIG6L EQU 0X30000A
CONFIG6H EQU 0X30000B
CONFIG7L EQU 0X30000C
CONFIG7H EQU 0X30000D
OSC_LP_1 EQU 0XF0
OSC_XT_1 EQU 0XF1
OSC_HS_1 EQU 0XF2
OSC_RC_1 EQU 0XF3
OSC_EC_1 EQU 0XF4
OSC_ECIO6_1 EQU 0XF5
OSC_HSPLL_1 EQU 0XF6
OSC_RCIO6_1 EQU 0XF7
OSC_INTIO67_1 EQU 0XF8
OSC_INTIO7_1 EQU 0XF9
FCMEN_OFF_1 EQU 0XBF
FCMEN_ON_1 EQU 0XFF
IESO_OFF_1 EQU 0X7F
IESO_ON_1 EQU 0XFF
PWRT_ON_2 EQU 0XFE
PWRT_OFF_2 EQU 0XFF
BOREN_OFF_2 EQU 0XF9
BOREN_ON_2 EQU 0XFB
BOREN_NOSLP_2 EQU 0XFD
BOREN_SBORDIS_2 EQU 0XFF
BORV_0_2 EQU 0XE7
BORV_1_2 EQU 0XEF
BORV_2_2 EQU 0XF7
BORV_3_2 EQU 0XFF
WDT_OFF_2 EQU 0XFE
WDT_ON_2 EQU 0XFF
WDTPS_1_2 EQU 0XE1
WDTPS_2_2 EQU 0XE3
WDTPS_4_2 EQU 0XE5
WDTPS_8_2 EQU 0XE7
WDTPS_16_2 EQU 0XE9
WDTPS_32_2 EQU 0XEB
WDTPS_64_2 EQU 0XED
WDTPS_128_2 EQU 0XEF
WDTPS_256_2 EQU 0XF1
WDTPS_512_2 EQU 0XF3
WDTPS_1024_2 EQU 0XF5
WDTPS_2048_2 EQU 0XF7
WDTPS_4096_2 EQU 0XF9
WDTPS_8192_2 EQU 0XFB
WDTPS_16384_2 EQU 0XFD
WDTPS_32768_2 EQU 0XFF
MCLRE_OFF_3 EQU 0X7F
MCLRE_ON_3 EQU 0XFF
LPT1OSC_OFF_3 EQU 0XFB
LPT1OSC_ON_3 EQU 0XFF
PBADEN_OFF_3 EQU 0XFD
PBADEN_ON_3 EQU 0XFF
CCP2MX_PORTBE_3 EQU 0XFE
CCP2MX_PORTC_3 EQU 0XFF
STVREN_OFF_4 EQU 0XFE
STVREN_ON_4 EQU 0XFF
LVP_OFF_4 EQU 0XFB
LVP_ON_4 EQU 0XFF
XINST_OFF_4 EQU 0XBF
XINST_ON_4 EQU 0XFF
DEBUG_ON_4 EQU 0X7F
DEBUG_OFF_4 EQU 0XFF
CP0_ON_5 EQU 0XFE
CP0_OFF_5 EQU 0XFF
CP1_ON_5 EQU 0XFD
CP1_OFF_5 EQU 0XFF
CP2_ON_5 EQU 0XFB
CP2_OFF_5 EQU 0XFF
CPB_ON_5 EQU 0XBF
CPB_OFF_5 EQU 0XFF
CPD_ON_5 EQU 0X7F
CPD_OFF_5 EQU 0XFF
WRT0_ON_6 EQU 0XFE
WRT0_OFF_6 EQU 0XFF
WRT1_ON_6 EQU 0XFD
WRT1_OFF_6 EQU 0XFF
WRT2_ON_6 EQU 0XFB
WRT2_OFF_6 EQU 0XFF
WRTB_ON_6 EQU 0XBF
WRTB_OFF_6 EQU 0XFF
WRTC_ON_6 EQU 0XDF
WRTC_OFF_6 EQU 0XFF
WRTD_ON_6 EQU 0X7F
WRTD_OFF_6 EQU 0XFF
EBTR0_ON_7 EQU 0XFE
EBTR0_OFF_7 EQU 0XFF
EBTR1_ON_7 EQU 0XFD
EBTR1_OFF_7 EQU 0XFF
EBTR2_ON_7 EQU 0XFB
EBTR2_OFF_7 EQU 0XFF
EBTRB_ON_7 EQU 0XBF
EBTRB_OFF_7 EQU 0XFF
DEVID1 EQU 0X3FFFFE
DEVID2 EQU 0X3FFFFF
IDLOC0 EQU 0X200000
__IDLOC0 EQU 0X200000
IDLOC1 EQU 0X200001
__IDLOC1 EQU 0X200001
IDLOC2 EQU 0X200002
__IDLOC2 EQU 0X200002
IDLOC3 EQU 0X200003
__IDLOC3 EQU 0X200003
IDLOC4 EQU 0X200004
__IDLOC4 EQU 0X200004
IDLOC5 EQU 0X200005
__IDLOC5 EQU 0X200005
IDLOC6 EQU 0X200006
__IDLOC6 EQU 0X200006
IDLOC7 EQU 0X200007
__IDLOC7 EQU 0X200007
#DEFINE __18F4525 1
#DEFINE XTAL 4
#DEFINE _CORE 16
#DEFINE _MAXRAM 3968
#DEFINE _RAM_END 3968
#DEFINE _MAXMEM 49152
#DEFINE _ADC 13
#DEFINE _ADC_RES 10
#DEFINE _EEPROM 1024
#DEFINE RAM_BANKS 15
#DEFINE _USART 1
#DEFINE _USB 0
#DEFINE _FLASH 1
#DEFINE _CWRITE_BLOCK 8
#DEFINE BANK0_START 128
#DEFINE BANK0_END 255
#DEFINE BANK1_START 256
#DEFINE BANK1_END 511
#DEFINE BANK2_START 512
#DEFINE BANK2_END 767
#DEFINE BANK3_START 768
#DEFINE BANK3_END 1023
#DEFINE BANK4_START 1024
#DEFINE BANK4_END 1279
#DEFINE BANK5_START 1280
#DEFINE BANK5_END 1535
#DEFINE BANK6_START 1536
#DEFINE BANK6_END 1791
#DEFINE BANK7_START 1792
#DEFINE BANK7_END 2047
#DEFINE BANK8_START 2048
#DEFINE BANK8_END 2303
#DEFINE BANK9_START 2304
#DEFINE BANK9_END 2559
#DEFINE BANK10_START 2560
#DEFINE BANK10_END 2815
#DEFINE BANK11_START 2816
#DEFINE BANK11_END 3071
#DEFINE BANK12_START 3072
#DEFINE BANK12_END 3327
#DEFINE BANK13_START 3328
#DEFINE BANK13_END 3583
#DEFINE BANK14_START 3584
#DEFINE BANK14_END 3839
#DEFINE BANKA_START 0
#DEFINE BANKA_END 127
#DEFINE _SYSTEM_VARIABLE_COUNT 17
RAM_BANK = 0
#DEFINE LCD#DTPORT PORTD
#DEFINE LCD#DTPIN 0
#DEFINE LCD#RSPORT PORTD
#DEFINE LCD#RSPIN 7
#DEFINE LCD#ENPORT PORTD
#DEFINE LCD#ENPIN 6
#DEFINE LCD#INTERFACE 4
#DEFINE LCD#LINES 2
#DEFINE LCD#TYPE 0
#DEFINE CLRW CLRF WREG
#DEFINE NEGW NEGF WREG
#DEFINE SKPC BTFSS STATUS,0
#DEFINE SKPNC BTFSC STATUS,0
#DEFINE CLRC BCF STATUS,0
#DEFINE SETC BSF STATUS,0
#DEFINE SKPZ BTFSS STATUS,2
#DEFINE SKPNZ BTFSC STATUS,2
#DEFINE CLRZ BCF STATUS,2
#DEFINE SETZ BSF STATUS,2
MOVFW MACRO M#VARIN
        MOVF M#VARIN,W
        ENDM
RLF MACRO M#VARIN,M#DEST
        RLCF M#VARIN,M#DEST
        ENDM
RRF MACRO M#VARIN,M#DEST
        RRCF M#VARIN,M#DEST
        ENDM
JUMP MACRO LABEL
        GOTO LABEL
        ENDM
F@CALL MACRO M#DEST
IF (M#DEST < 1)
        CALL M#DEST
ELSE
IF (M#DEST > $)
        CALL M#DEST
ELSE
IF (M#DEST < ($ - 0X03FF))
        CALL M#DEST
ELSE
        RCALL M#DEST
ENDIF
ENDIF
ENDIF
        ENDM
F@JUMP MACRO M#DEST
IFDEF WATCHDOG_REQ
IF ($ == M#DEST)
        CLRWDT
ENDIF
ENDIF
IF (M#DEST < 1)
        GOTO M#DEST
ELSE
IF ((M#DEST) > $)
        GOTO M#DEST
ELSE
IF ((M#DEST) < ($ - 0X03FF))
        GOTO M#DEST
ELSE
        BRA M#DEST
ENDIF
ENDIF
ENDIF
        ENDM
IFDEF WATCHDOG_REQ
        CHK@SLF MACRO M#DEST
IF ($ == M#DEST)
        CLRWDT
ENDIF
        ENDM
ENDIF
G@OTO MACRO M#DEST
IF (M#DEST < 1)
        BTFSC STATUS,OV
        GOTO M#DEST
ELSE
IF (M#DEST > $)
        BTFSC STATUS,OV
        GOTO M#DEST
ELSE
IF (M#DEST < ($ - 127))
        BTFSC STATUS,OV
        GOTO M#DEST
ELSE
        BOV M#DEST
ENDIF
ENDIF
ENDIF
        ENDM
GO@TO MACRO M#DEST
IF (M#DEST < 1)
        GOTO M#DEST
ELSE
IF (M#DEST > $)
        GOTO M#DEST
ELSE
IF (M#DEST < ($ - 0X03FF))
        GOTO M#DEST
ELSE
        BRA M#DEST
ENDIF
ENDIF
ENDIF
        ENDM
S@B MACRO M#VARIN
IF ((M#VARIN > BANKA_END) & (M#VARIN < 0X0F80))
IF ((M#VARIN & 0X0F00) != (RAM_BANK << 8))
        MOVLB HIGH (M#VARIN)
        RAM_BANK = (M#VARIN >> 8)
ENDIF
ENDIF
        ENDM
R@B MACRO
IF(RAM_BANK != 0)
        MOVLB 0
        RAM_BANK = 0
ENDIF
        ENDM
WREG_BYTE MACRO M#BYTEOUT
        MOVFF WREG,M#BYTEOUT
        ENDM
WREG_BIT MACRO M#VAROUT,M#BITOUT
        S@B M#VAROUT
        BTFSC WREG,0
        BSF M#VAROUT,M#BITOUT
        BTFSS WREG,0
        BCF M#VAROUT,M#BITOUT
        R@B
        ENDM
WREG_WORD MACRO M#WORDOUT
        MOVFF WREG,M#WORDOUT
        MOVLW 0
        MOVFF WREG,M#WORDOUT + 1
        ENDM
WREG_DWORD MACRO M#DWORDOUT
        MOVFF WREG,M#DWORDOUT
        MOVLW 0
        MOVFF WREG,M#DWORDOUT + 3
        MOVFF WREG,M#DWORDOUT + 2
        MOVFF WREG,M#DWORDOUT + 1
        ENDM
BYTE_WREG MACRO M#BYTEIN
        MOVFF M#BYTEIN,WREG
        ENDM
NUM_WREG MACRO M#NUMIN
        MOVLW (M#NUMIN & 255)
        ENDM
NUM_BYTE MACRO M#NUMIN,M#BYTEOUT
        MOVLW (M#NUMIN & 255)
        MOVFF WREG,M#BYTEOUT
        ENDM
NUM_BIT MACRO M#NUMIN,M#VAROUT,M#BITOUT
        S@B M#VAROUT
IF((M#NUMIN & 1) == 1)
        BSF M#VAROUT,M#BITOUT
ELSE
        BCF M#VAROUT,M#BITOUT
ENDIF
        R@B
        ENDM
NUM_WORD MACRO M#NUMIN,M#WORDOUT
IFDEF _USELFSR
IF(M#WORDOUT == FSR0L)
        LFSR 0,M#NUMIN
        EXITM
ENDIF
IF(M#WORDOUT == FSR1L)
        LFSR 1,M#NUMIN
        EXITM
ENDIF
IF(M#WORDOUT == FSR2L)
        LFSR 2,M#NUMIN
        EXITM
ENDIF
ENDIF
        S@B M#WORDOUT
        MOVLW (M#NUMIN & 255)
        MOVWF M#WORDOUT
        S@B M#WORDOUT + 1
        MOVLW HIGH (M#NUMIN)
        MOVWF M#WORDOUT + 1
        R@B
        ENDM
NUM_DWORD MACRO M#NUMIN,M#DWORDOUT
        S@B M#DWORDOUT
        MOVLW LOW (M#NUMIN)
        MOVWF M#DWORDOUT
        S@B M#DWORDOUT + 1
        MOVLW HIGH (M#NUMIN)
        MOVWF M#DWORDOUT + 1
        S@B M#DWORDOUT + 2
        MOVLW ((M#NUMIN >> 16) & 255)
        MOVWF M#DWORDOUT + 2
        S@B M#DWORDOUT + 3
        MOVLW ((M#NUMIN >> 24) & 255)
        MOVWF M#DWORDOUT + 3
        R@B
        ENDM
BIT_WREG MACRO M#VARIN,M#BITIN
        S@B M#VARIN
        CLRW
        BTFSC M#VARIN,M#BITIN
        MOVLW 1
        R@B
        ENDM
BIT_BYTE MACRO M#VARIN,M#BITIN,M#BYTEOUT
        S@B M#VARIN
        CLRW
        BTFSC M#VARIN,M#BITIN
        MOVLW 1
        S@B M#BYTEOUT
        MOVWF M#BYTEOUT
        R@B
        ENDM
BIT_BIT MACRO M#VARIN,M#BITIN,M#VAROUT,M#BITOUT
IF ((M#VARIN & 0X0F00) == (M#VAROUT & 0X0F00))
        S@B M#VARIN
        BTFSC M#VARIN,M#BITIN
        BSF M#VAROUT,M#BITOUT
        BTFSS M#VARIN,M#BITIN
        BCF M#VAROUT,M#BITOUT
ELSE
IF ((M#VARIN <= BANKA_END) | (M#VARIN >= 0X0F80))
        S@B M#VAROUT
        BTFSC M#VARIN,M#BITIN
        BSF M#VAROUT,M#BITOUT
        BTFSS M#VARIN,M#BITIN
        BCF M#VAROUT,M#BITOUT
ELSE
IF ((M#VAROUT <= BANKA_END) | (M#VAROUT >= 0X0F80))
        S@B M#VARIN
        BTFSC M#VARIN,M#BITIN
        BSF M#VAROUT,M#BITOUT
        BTFSS M#VARIN,M#BITIN
        BCF M#VAROUT,M#BITOUT
ELSE
        S@B M#VARIN
        CLRDC
        BTFSC M#VARIN,M#BITIN
        SETDC
        S@B M#VAROUT
        SKPNDC
        BSF M#VAROUT,M#BITOUT
        SKPDC
        BCF M#VAROUT,M#BITOUT
ENDIF
ENDIF
ENDIF
        R@B
        ENDM
BIT_WORD MACRO M#VARIN,M#BITIN,M#WORDOUT
        S@B M#WORDOUT + 1
        CLRF M#WORDOUT + 1
        BIT_BYTE M#VARIN,M#BITIN,M#WORDOUT
        ENDM
BIT_DWORD MACRO M#VARIN,M#BITIN,M#DWORDOUT
        S@B M#DWORDOUT + 3
        CLRF M#DWORDOUT + 3
        S@B M#DWORDOUT + 2
        CLRF M#DWORDOUT + 2
        S@B M#DWORDOUT + 1
        CLRF M#DWORDOUT + 1
        BIT_BYTE M#VARIN,M#BITIN,M#DWORDOUT
        ENDM
WORD_WREG MACRO M#WORDIN
        BYTE_WREG M#WORDIN
        ENDM
WORD_BYTE MACRO M#WORDIN,M#BYTEOUT
        BYTE_BYTE M#WORDIN,M#BYTEOUT
        ENDM
WORD_BIT MACRO M#WORDIN,M#VAROUT,M#BITOUT
        BYTE_BIT M#WORDIN, M#VAROUT, M#BITOUT
        ENDM
WORD_WORD MACRO M#WORDIN,M#WORDOUT
        MOVFF M#WORDIN + 1,M#WORDOUT + 1
        MOVFF M#WORDIN,M#WORDOUT
        ENDM
WORD_DWORD MACRO M#WORDIN,M#DWORDOUT
        MOVLW 0
        MOVFF WREG,M#DWORDOUT + 3
        MOVFF WREG,M#DWORDOUT + 2
        WORD_WORD M#WORDIN,M#DWORDOUT
        ENDM
BYTE_BYTE MACRO M#BYTEIN,M#BYTEOUT
        MOVFF M#BYTEIN,M#BYTEOUT
        ENDM
BYTE_WORD MACRO M#BYTEIN,M#WORDOUT
        MOVLW 0
        MOVFF WREG,M#WORDOUT + 1
        BYTE_BYTE M#BYTEIN,M#WORDOUT
        ENDM
BYTE_DWORD MACRO M#BYTEIN,M#DWORDOUT
        MOVLW 0
        MOVFF WREG,M#DWORDOUT + 3
        MOVFF WREG,M#DWORDOUT + 2
        MOVFF WREG,M#DWORDOUT + 1
        BYTE_BYTE M#BYTEIN,M#DWORDOUT
        ENDM
BYTE_BIT MACRO M#BYTEIN,M#VAROUT,M#BITOUT
IF ((M#BYTEIN & 0X0F00) == (M#VAROUT & 0X0F00))
        S@B M#BYTEIN
        BTFSC M#BYTEIN,0
        BSF M#VAROUT,M#BITOUT
        BTFSS M#BYTEIN,0
        BCF M#VAROUT,M#BITOUT
ELSE
IF ((M#BYTEIN <= BANKA_END) | (M#BYTEIN >= 0X0F80))
        S@B M#VAROUT
        BTFSC M#BYTEIN,0
        BSF M#VAROUT,M#BITOUT
        BTFSS M#BYTEIN,0
        BCF M#VAROUT,M#BITOUT
ELSE
IF ((M#VAROUT <= BANKA_END) | (M#VAROUT >= 0X0F80))
        S@B M#BYTEIN
        BTFSC M#BYTEIN,0
        BSF M#VAROUT,M#BITOUT
        BTFSS M#BYTEIN,0
        BCF M#VAROUT,M#BITOUT
ELSE
        S@B M#BYTEIN
        RRF M#BYTEIN,W
        S@B M#VAROUT
        SKPNC
        BSF M#VAROUT,M#BITOUT
        SKPC
        BCF M#VAROUT,M#BITOUT
ENDIF
ENDIF
ENDIF
        R@B
        ENDM
DWORD_WREG MACRO M#DWORDIN
        BYTE_WREG M#DWORDIN
        ENDM
DWORD_BYTE MACRO M#DWORDIN,M#BYTEOUT
        BYTE_BYTE M#DWORDIN,M#BYTEOUT
        ENDM
DWORD_WORD MACRO M#DWORDIN,M#WORDOUT
        MOVFF M#DWORDIN + 1,M#WORDOUT + 1
        MOVFF M#DWORDIN,M#WORDOUT
        ENDM
DWORD_DWORD MACRO M#DWORDIN,M#DWORDOUT
        MOVFF M#DWORDIN + 3,M#DWORDOUT + 3
        MOVFF M#DWORDIN + 2,M#DWORDOUT + 2
        MOVFF M#DWORDIN + 1,M#DWORDOUT + 1
        MOVFF M#DWORDIN,M#DWORDOUT
        ENDM
DWORD_BIT MACRO M#DWORDIN,M#VAROUT,M#BITOUT
        BYTE_BIT M#DWORDIN,M#VAROUT,M#BITOUT
        ENDM
NUM_FLOAT MACRO M#NUMIN,FLOATOUT
        NUM_BYTE M#NUMIN,FLOATOUT + 3
        NUM_BYTE ((M#NUMIN >> 8) & 255),FLOATOUT + 2
        NUM_BYTE ((M#NUMIN >> 16) & 255),FLOATOUT + 1
        NUM_BYTE ((M#NUMIN >> 24) & 255),FLOATOUT
        ENDM
WREG_FLOAT MACRO FLOATOUT
        CALL FLO@0832U
        MOVFF PBP_AARG,FLOATOUT
        MOVFF PBP_AARGH,FLOATOUT + 1
        MOVFF PBP_AARGHH,FLOATOUT + 2
        MOVFF PBP_AARGHHH,FLOATOUT + 3
        ENDM
BIT_FLOAT MACRO M#VARIN,M#BITIN,FLOATOUT
        BIT_WREG M#VARIN,M#BITIN
        CALL FLO@0832U
        MOVFF PBP_AARG,FLOATOUT
        MOVFF PBP_AARGH,FLOATOUT + 1
        MOVFF PBP_AARGHH,FLOATOUT + 2
        MOVFF PBP_AARGHHH,FLOATOUT + 3
        ENDM
BYTE_FLOAT MACRO M#BYTEIN,FLOATOUT
        BYTE_WREG M#BYTEIN
        CALL FLO@0832U
        MOVFF PBP_AARG,FLOATOUT
        MOVFF PBP_AARGH,FLOATOUT + 1
        MOVFF PBP_AARGHH,FLOATOUT + 2
        MOVFF PBP_AARGHHH,FLOATOUT + 3
        ENDM
WORD_FLOAT MACRO M#WORDIN,FLOATOUT
        BYTE_BYTE M#WORDIN,PBP_AARG
        BYTE_BYTE M#WORDIN + 1,PBP_AARGH
        CALL FLO@1632U
        MOVFF PBP_AARG,FLOATOUT
        MOVFF PBP_AARGH,FLOATOUT + 1
        MOVFF PBP_AARGHH,FLOATOUT + 2
        MOVFF PBP_AARGHHH,FLOATOUT + 3
        ENDM
DWORD_FLOAT MACRO M#DWORDIN,FLOATOUT
        MOVFF M#DWORDIN,PBP_AARG
        MOVFF M#DWORDIN + 1,PBP_AARGH
        MOVFF M#DWORDIN + 2,PBP_AARGHH
        MOVFF M#DWORDIN + 3,PBP_AARGHHH
        CALL FLO@3232S
        MOVFF PBP_AARG,FLOATOUT
        MOVFF PBP_AARGH,FLOATOUT + 1
        MOVFF PBP_AARGHH,FLOATOUT + 2
        MOVFF PBP_AARGHHH,FLOATOUT + 3
        ENDM
FLOAT_FLOAT MACRO FLOATIN,FLOATOUT
        MOVFF FLOATIN,FLOATOUT
        MOVFF FLOATIN + 1,FLOATOUT + 1
        MOVFF FLOATIN + 2,FLOATOUT + 2
        MOVFF FLOATIN + 3,FLOATOUT + 3
        ENDM
FLOAT_WREG MACRO FLOATIN
        FLOAT_FLOAT FLOATIN,PBP_AARG
        CALL INT@3232
        ENDM
FLOAT_BIT MACRO FLOATIN,M#VAROUT,M#BITOUT
        FLOAT_FLOAT FLOATIN,PBP_AARG
        CALL INT@3232
        WREG_BIT M#VAROUT,M#BITOUT
        ENDM
FLOAT_BYTE MACRO FLOATIN,M#BYTEOUT
        FLOAT_FLOAT FLOATIN,PBP_AARG
        CALL INT@3232
        WREG_BYTE M#BYTEOUT
        ENDM
FLOAT_WORD MACRO FLOATIN,M#WORDOUT
        FLOAT_FLOAT FLOATIN,PBP_AARG
        CALL INT@3232
        MOVFF PBP_AARGHHH,M#WORDOUT
        MOVFF PBP_AARGHH,M#WORDOUT + 1
        ENDM
FLOAT_DWORD MACRO FLOATIN,M#DWORDOUT
        FLOAT_FLOAT FLOATIN,PBP_AARG
        CALL INT@3232
        MOVFF PBP_AARGHHH,M#DWORDOUT
        MOVFF PBP_AARGHH,M#DWORDOUT + 1
        MOVFF PBP_AARGH,M#DWORDOUT + 2
        MOVFF PBP_AARG,M#DWORDOUT + 3
        ENDM
NUM_FSR0 MACRO M#NUMIN
        LFSR 0, M#NUMIN
        ENDM
NUM_FSR1 MACRO M#NUMIN
        LFSR 1, M#NUMIN
        ENDM
NUM_FSR2 MACRO M#NUMIN
        LFSR 2, M#NUMIN
        ENDM
LABEL_WORD MACRO LABELIN,M#WORDOUT
        MOVLW LOW (LABELIN)
        MOVFF WREG, M#WORDOUT
        MOVLW HIGH (LABELIN)
        MOVFF WREG, M#WORDOUT + 1
        ENDM
BPF = 0
BPFH = 1
GEN = 2
GEN4 = 3
GEN4H = 4
PP0 = 5
PP0H = 6
PP1 = 7
PP1H = 8
PP2 = 9
PP2H = 10
PP3 = 11
PP3H = 12
PP4 = 13
PP5 = 14
PP7 = 15
PP7H = 16
VAR1 = 17
VAR1H = 18
#DEFINE SD_CS PORTC,2
#DEFINE SD_DI PORTC,5
#DEFINE SD_CLK PORTC,3
#DEFINE SD_DO PORTC,4
#DEFINE __KEYPAD_PORT PORTB
#DEFINE __LCD_DTPORT PORTD
#DEFINE __LCD_ENPORT PORTD
#DEFINE __LCD_RSPORT PORTD
#DEFINE SD_DETECT PORTA,1
#DEFINE RFIDENABLE PORTD,4
#DEFINE GIE INTCON,7
#DEFINE __XTAL 4
#DEFINE __LCD_TYPE 0
#DEFINE __LCD_DTPIN 0
#DEFINE __LCD_ENPIN 6
#DEFINE __LCD_RSPIN 7
#DEFINE __LCD_INTERFACE 4
#DEFINE __LCD_LINES 2
#DEFINE __HSERIAL_BAUD 9600
#DEFINE __HSERIAL_RCSTA 144
#DEFINE __HSERIAL_TXSTA 32
#DEFINE __ADIN_RES 10
#DEFINE __ADIN_DELAY 50
PROTON#CODE#START
        ORG 0
        GOTO PROTON#MAIN#START
        ORG 8
LCD@CLS
        MOVLW 128
        MOVWF 1
CLS
        MOVLW 254
        CALL CH@SND
        MOVLW 1
        CALL CH@SND
        MOVLW 117
        MOVWF 6
        MOVLW 48
        GOTO DLUS@W
LCD@CRS
        CLRF 1
        BSF 1,7
CURS@
        MOVWF 14
        MOVLW 254
        CALL CH@SND
        MOVF 14,W
        GOTO CH@SND
OUT@DEC
        BCF 0,3
        MOVF 4,W
        BTFSC 4056,2
        BSF 0,3
        MOVLW 5
        MOVWF 3
        MOVLW 39
        MOVWF 8
        MOVLW 16
        RCALL D@DIG
        MOVLW 3
        MOVWF 8
        MOVLW 232
        RCALL D@DIG
        CLRF 8
        MOVLW 100
        RCALL D@DIG
        CLRF 8
        MOVLW 10
        RCALL D@DIG
        MOVF 9,W
        BRA SEND@IT
D@DIG
        MOVWF 7
        MOVF 10,W
        MOVWF 6
        MOVF 9,W
        MOVWF 5
        CALL D@VD
        MOVF 5,W
SEND@IT
        MOVWF 5
        DCFSNZ 3,F
        BCF 0,3
        MOVF 4,W
        BZ $ + 8
        SUBWF 3,W
        BTFSC 4056,0
        BRA EX@SEND@IT
        MOVF 5,W
        BTFSS 4056,2
        BCF 0,3
        BTFSC 0,3
        BRA EX@SEND@IT
        ADDLW 48
        GOTO CH@SND
EX@SEND@IT
        RETURN
PRINT@MSTR
PRINT@MSTRL
        CLRF 4006
        BSF 4006,PP_EEPGD
PRT@MTL1
        TBLRD*+
        MOVF 4085,W
        BZ PRT@MTEXT
        RCALL PRINT
        BRA PRT@MTL1
PRT@MTEXT
        RETURN
PRINT
        MOVWF 12
        BCF LATD,6
        NOP
        BCF LATD,7
        BCF TRISD,6
        BCF TRISD,7
        MOVLW 240
        ANDWF TRISD,F
        MOVF 12,W
        BTFSC 0,1
        GOTO PRT@1
        MOVLW 58
        MOVWF 6
        MOVLW 152
        CALL DLUS@W
        MOVLW 51
        MOVWF 11
        RCALL PR@LP
        MOVLW 19
        MOVWF 6
        MOVLW 136
        CALL DLUS@W
        RCALL PR@LP
        MOVLW 100
        CALL DL@US
        RCALL PR@LP
        MOVLW 100
        CALL DL@US
        MOVLW 34
        MOVWF 11
        RCALL PR@LP
        MOVLW 40
        RCALL PR@CM
        MOVLW 12
        RCALL PR@CM
        MOVLW 6
        RCALL PR@CM
        BSF 0,1
        MOVF 12,W
        BRA PRT@1
PR@CM
        BSF 0,0
PRT@1
        MOVWF 11
        BTFSS 0,0
        BRA PR@CC
        BCF LATD,7
        SUBLW 3
        BNC PR@SD
        RCALL PR@SD
        MOVLW 7
        MOVWF 6
        MOVLW 208
        CALL DLUS@W
        BSF 4056,0
        RETURN
PR@CC
        BSF 0,0
        SUBLW 254
        BZ PR@EX
        BSF LATD,7
PR@SD
        SWAPF 11,F
        BTFSS 0,0
PR@LP
        BCF 0,0
        BSF LATD,6
        MOVLW 240
        ANDWF PORTD,F
        MOVF 11,W
        ANDLW 15
        IORWF PORTD,F
        BCF LATD,6
        SWAPF 11,F
        BTFSC 0,0
        BRA PR@LP
        MOVLW 50
        CALL DL@US
        BSF 4056,0
PR@EX
        MOVF 12,W
        RETURN
CH@SND
        BTFSC 1,7
        GOTO PRINT
ADIN_STIME = 50
ADIN_TAD = 3
ADIN_RES = 10
RD@AD
        RLCF 4072,F
        RLCF 4072,F
        ANDLW 60
        IORLW 1
        IORWF 4034,F
        IORLW 192
        ANDWF 4034,F
        MOVF 4032,W
        ANDLW 248
        IORLW 3
        MOVWF 4032
        MOVLW 50
        CALL DL@US
        BSF 4034,PP_GO_DONE
        BTFSC 4034,PP_GO_DONE
        BRA $ - 2
        MOVFF 4036,16
        MOVF 4035,W
        MOVWF 15
        RETURN
DL@MS
        CLRF 8
DLY@W
        MOVWF 7
DLY@P
        MOVLW 255
        ADDWF 7,F
        ADDWFC 8,F
        BRA $ + 2
        BTFSS 4056,0
        RETURN
        MOVLW 3
        MOVWF 6
        MOVLW 223
        RCALL DLUS@W
        BRA DLY@P
DL@US
        CLRF 6
DLUS@W
        ADDLW 233
        MOVWF 5
        MOVLW 252
        BNC $ + 12
        NOP
        NOP
        ADDWF 5,F
        BC $ - 4
        NOP
        ADDWF 5,F
        DECF 6,F
        BC $ - 12
        BTFSC 5,0
        BRA $ + 2
        BTFSS 5,1
        BRA $ + 6
        BRA $ + 2
        NOP
        RETURN
D@VD
        CLRF 10
        CLRF 9
D@VD2
        MOVLW 16
        MOVWF 4083
DV@LP
        RLCF 6,W
        RLCF 9,F
        RLCF 10,F
        MOVF 7,W
        SUBWF 9,W
        MOVF 8,W
        SUBWFB 10,W
        BNC D@K
        MOVF 7,W
        SUBWF 9,F
        MOVF 8,W
        SUBWFB 10,F
        BSF 4056,0
D@K
        RLCF 5,F
        RLCF 6,F
        DECFSZ 4083,F
        BRA DV@LP
        MOVF 5,W
        RETURN
STR@LB1
        DB 71,111,105,110,103,32,116,111,32,115,108,101,101,112,46,46,0
STR@LB2
        DB 73,32,106,117,115,116,32,119,111,107,101,32,117,112,33,33,0
PROTON#MAIN#START
        CLRF 4088
        CLRF 0
        CLRF 4011
F2_SOF EQU $ ; AD TEST.PRP
F3_SOF EQU $ ; AD TEST_FWD.PBP
F3_EOF EQU $ ; AD TEST_FWD.PBP
F2_EOF EQU $ ; AD TEST.PRP
F1_SOF EQU $ ; AD TEST.BAS
F1_000036 EQU $ ; IN [AD TEST.BAS] ALL_DIGITAL = TRUE
        MOVLW 7
        MOVWF CMCON,0
        MOVLW 15
        MOVWF ADCON1,0
F1_000054 EQU $ ; IN [AD TEST.BAS] INTCON2.6 = 1        'SET TO ALLOW PORTB.0 TO DETECT A LOW TO HIGH PULSE
        BSF INTCON2,6,0
F1_000056 EQU $ ; IN [AD TEST.BAS] PORTB_PULLUPS = TRUE           ' ENABLE PORTB PULLUPS
        BCF INTCON2,7,0
F1_000057 EQU $ ; IN [AD TEST.BAS] INTCON.4 = 0             'SET WAKEUP ON PORTB.0 TO OFF
        BCF INTCON,4,0
F1_000058 EQU $ ; IN [AD TEST.BAS] INTCON.1 = 0  'CLEAR THE INTERRUPT FLAG FOR PORTB.0
        BCF INTCON,1,0
F1_000065 EQU $ ; IN [AD TEST.BAS] TRISA = %00000011         ' CONFIGURE AN0 AND AN1(PORTA.0 AND PORTA.1) AS AN INPUT
        MOVLW 3
        MOVWF TRISA,0
F1_000066 EQU $ ; IN [AD TEST.BAS] ADCON1 = %10001110        ' SET ANALOGUE INPUT ON PORTA.0
        MOVLW 142
        MOVWF ADCON1,0
START
F1_000070 EQU $ ; IN [AD TEST.BAS] GIE = 0      ' TURN OFF GLOBAL INTERRUPTS
        BCF INTCON,7,0
F1_000071 EQU $ ; IN [AD TEST.BAS] WHILE GIE = 1 : GIE = 0 : WEND  ' AND MAKE SURE THEY ARE OFF
BC@LL1
        BTFSS INTCON,7,0
        GO@TO BC@LL2
        BCF INTCON,7,0
        F@JUMP BC@LL1
BC@LL2
F1_000073 EQU $ ; IN [AD TEST.BAS] GOTO GOSLEEP
        F@JUMP GOSLEEP
AGAIN
F1_000075 EQU $ ; IN [AD TEST.BAS] VAR1 = ADIN 0             ' PLACE THE CONVERSION INTO VARIABLE VAR1
        MOVLW 0
        F@CALL RD@AD
        MOVWF VAR1,0
        MOVFF PP7H,VAR1H
F1_000076 EQU $ ; IN [AD TEST.BAS] PAUSE 100
        MOVLW 100
        F@CALL DL@MS
F1_000077 EQU $ ; IN [AD TEST.BAS] PRINT AT 1,1, DEC VAR1
        MOVLW 128
        MOVWF BPFH,0
        F@CALL LCD@CRS
        CLRF GEN4H,0
        MOVFF VAR1H,PP2H
        MOVFF VAR1,PP2
        F@CALL OUT@DEC
F1_000078 EQU $ ; IN [AD TEST.BAS] GOTO AGAIN
        F@JUMP AGAIN
F4_SOF EQU $ ; GOSLEEP.INC
GOSLEEP
F4_000003 EQU $ ; IN [GOSLEEP.INC] CLS
        F@CALL LCD@CLS
F4_000004 EQU $ ; IN [GOSLEEP.INC] PRINT AT 1,1, "GOING TO SLEEP.."
        MOVLW 128
        MOVWF BPFH,0
        F@CALL LCD@CRS
        MOVLW HIGH (STR@LB1)
        MOVWF TBLPTRLH,0
        MOVLW LOW (STR@LB1)
        MOVWF TBLPTRL,0
        F@CALL PRINT@MSTR
F4_000005 EQU $ ; IN [GOSLEEP.INC] PAUSE 2000
        MOVLW 7
        MOVWF PP1H,0
        MOVLW 208
        F@CALL DLY@W
F4_000006 EQU $ ; IN [GOSLEEP.INC] INTCON.4 = 1 'ALLOW A THE PULSE ON PORTB.0 TO WAKE PROGRAM FROM SLEEP
        BSF INTCON,4,0
F4_000007 EQU $ ; IN [GOSLEEP.INC] INTCON.1 = 0  'CLEAR THE INTERRUPT FLAG FOR PORTB.0
        BCF INTCON,1,0
F4_000010 EQU $ ; IN [GOSLEEP.INC] SLEEP    'CHIP GOES INTO LOW POWER UNTIL IT IS TRIGGERED BY A HIGH TO LOW PULSE ON PORTB.0
        SLEEP
F4_000011 EQU $ ; IN [GOSLEEP.INC] INTCON.4 = 0 'STOP ANY PULSE FROM WAKING UP PROGRAM CAUSE WE JUST WOKE UP
        BCF INTCON,4,0
F4_000012 EQU $ ; IN [GOSLEEP.INC] CLS
        F@CALL LCD@CLS
F4_000013 EQU $ ; IN [GOSLEEP.INC] PRINT AT 1,1, "I JUST WOKE UP!!"
        MOVLW 128
        MOVWF BPFH,0
        F@CALL LCD@CRS
        MOVLW HIGH (STR@LB2)
        MOVWF TBLPTRLH,0
        MOVLW LOW (STR@LB2)
        MOVWF TBLPTRL,0
        F@CALL PRINT@MSTR
F4_000018 EQU $ ; IN [GOSLEEP.INC] PAUSE 2000
        MOVLW 7
        MOVWF PP1H,0
        MOVLW 208
        F@CALL DLY@W
F4_000026 EQU $ ; IN [GOSLEEP.INC] GOTO GOSLEEP      'GO BACK TO SLEEP
        F@JUMP GOSLEEP
F4_EOF EQU $ ; GOSLEEP.INC
F1_EOF EQU $ ; AD TEST.BAS
PB@LB4
        BRA PB@LB4
__EOF
CONFIG OSC = XT
CONFIG PWRT = ON
CONFIG BOREN = OFF
CONFIG MCLRE = ON
CONFIG PBADEN = OFF
CONFIG STVREN = OFF
CONFIG LVP = ON
        END

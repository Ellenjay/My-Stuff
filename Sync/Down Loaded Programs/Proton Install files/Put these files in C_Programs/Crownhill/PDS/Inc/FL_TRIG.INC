 NOLIST
; 32-bit floating point TRIG subroutines
;----------------------------------------------------------
; POW subroutine
;
; Value to Raise: PBP_AARG. Pointed to by the contents of FSR1
; Value for the power of: PP2
; Value returned in PBP_AARG

; SYSTEM VARIABLES USED
; PBP_AARG,PBP_AARGH,PBP_AARGHH,PBP_AARGHHH
; PBP_BARG,PBP_BARGH,PBP_BARGHH,PBP_BARGHHH
; _FP_FLAGS
; PP0, PP0H, PP0HH, PP0HHH
; PP1, PP1H, PP1HH, PP1HHH
; PP2, PP2H, PP2HH, PP2HHH
; PP7, PP7H, PP7HH, PP7HHH
; PP3, PP3H, PP4
; PP4

; SUBROUTINES CALLED
; ADD, SUB, MUL, DIV, INT to FLOAT, LOG, EXP

ifdef FP@POW_REQ
 LIST
	FP@EXP_REQ = 1		; Enable EXP
	FP@LOG_REQ = 1		; Enable LOG
	FPS@32_REQ = 1		; Enable SUBTRACT
	FPA@32_REQ = 1		; Enable ADDITION
	FPM@32_REQ = 1		; Enable MULTIPLY
	FPD@32_REQ = 1		; Enable DIVIDE
	
FPPOW@32
	MOVFF POSTINC1,PBP_AARG
	MOVFF POSTINC1,PBP_AARGH
	MOVFF POSTINC1,PBP_AARGHH
	MOVFF POSTINC1,PBP_AARGHHH
	BCF GEN,0
	MOVF PBP_AARG,W
	BTFSC STATUS,2
	BRA FPPOW@LP1
	BTFSS PBP_AARGH,7
	BRA FPPOW@LP1
	MOVLW 128
	XORWF PBP_AARGH,F
    BSF GEN,0
FPPOW@LP1
	CALL FPLOG@32
	MOVFF PBP_AARGHHH,PBP_BARGHHH
	MOVFF PBP_AARGHH,PBP_BARGHH
	MOVFF PBP_AARGH,PBP_BARGH
	MOVFF PBP_AARG,PBP_BARG
	MOVFF PP2HHH,PBP_AARGHHH
	MOVFF PP2HH,PBP_AARGHH
	MOVFF PP2H,PBP_AARGH
	MOVFF PP2,PBP_AARG
	CALL FPM@32
	CALL FPEXP@32
	BTFSS GEN,0
	RETURN
	MOVLW 128
	XORWF PBP_AARGH,F
	RETURN
 NOLIST
endif
 
 NOLIST
ifdef FP@LOG10_REQ
;----------------------------------------------------------
; LOG 10 subroutine

; SYSTEM VARIABLES USED
; PBP_AARG,PBP_AARGH,PBP_AARGHH,PBP_AARGHHH
; PBP_BARG,PBP_BARGH,PBP_BARGHH,PBP_BARGHHH
; _FP_FLAGS
; PP0, PP0H, PP0HH, PP0HHH
; PP1, PP1H, PP1HH, PP1HHH
; PP7, PP7H, PP7HH, PP7HHH
; PP3, PP3H
; PP4

; SUBROUTINES CALLED
; ADD, SUB, MUL, DIV, INT to FLOAT, LOG

 LIST
	FP@LOG_REQ = 1
FPLOG10@32

	MOVFF _FP_FLAGS,PP4	; Save condition of _FP_FLAGS
	BSF   _FP_FLAGS,6		; Rounding ON
	RCALL FPLOG@32
	MOVLW 217
	MOVWF PBP_BARGHHH
	MOVLW 91
	MOVWF PBP_BARGHH
	MOVLW 94
	MOVWF PBP_BARGH
	MOVLW 125
	MOVWF PBP_BARG
	CALL FPM@32
	BTFSS PP4,6,0			; Restore condition of _FP_FLAGS
	BCF   _FP_FLAGS,6
	MOVF  PBP_AARGHHH,W
	RETURN
 NOLIST
endif

 NOLIST
ifdef FP@LOG_REQ
;----------------------------------------------------------
; Natural LOG

; SYSTEM VARIABLES USED
; PBP_AARG,PBP_AARGH,PBP_AARGHH,PBP_AARGHHH
; PBP_BARG,PBP_BARGH,PBP_BARGHH,PBP_BARGHHH
; _FP_FLAGS
; PP0, PP0H, PP0HH, PP0HHH
; PP1, PP1H, PP1HH, PP1HHH
; PP7, PP7H, PP7HH, PP7HHH
; PP3, PP3H

; SUBROUTINES CALLED
; ADD, SUB, MUL, DIV, INT to FLOAT

 LIST
	FPS@32_REQ = 1		; Enable SUBTRACT
	FPA@32_REQ = 1		; Enable ADDITION
	FPM@32_REQ = 1		; Enable MULTIPLY
	FPD@32_REQ = 1		; Enable DIVIDE
	FLO@3232S_REQ = 1	; Enable INT to FLOAT
	
FPLOG@32
	BTFSC PBP_AARGH,7,0
	BRA   LOG@32_4
	MOVF  PBP_AARG,1,0
	BTFSC STATUS,Z,0
	BRA   LOG@32_4
	MOVFF _FP_FLAGS,PP3
	BSF   _FP_FLAGS,6,0
	MOVLW 126
	SUBWF PBP_AARG,W,0
	MOVWF PP3H,0
	MOVLW 126
	MOVWF PBP_AARG,0
	CLRF  PBP_BARGHHH,0
	CLRF  PBP_BARGHH,0
	CLRF  PBP_BARGH,0
	MOVLW 127
	MOVWF PBP_BARG,0
	MOVLW 243
	SUBWF PBP_AARGHHH,W,0
	MOVLW 4
	BTFSS STATUS,C,0 ;<<
	MOVLW 5
	SUBWF PBP_AARGHH,W,0
	MOVLW 53
	BTFSS STATUS,C,0 ;<<
	MOVLW 54
	SUBWF PBP_AARGH,W,0
	BNC   LOG@32_2
	CALL FPS@32
	BRA   LOG@32_3
LOG@32_2	
	INCF  PBP_AARG,1,0
	CALL FPS@32
	DECF  PP3H,1,0
LOG@32_3	
	MOVFF PBP_AARGHHH,PP0
	MOVFF PBP_AARGHH,PP0H
	MOVFF PBP_AARGH,PP0HH
	MOVFF PBP_AARG,PP0HHH
	MOVLW 113
	MOVWF PBP_BARGHHH,0
	MOVLW 95
	MOVWF PBP_BARGHH,0
	MOVLW 85
	MOVWF PBP_BARGH,0
	MOVLW 128
	MOVWF PBP_BARG,0
	CALL FPA@32
	MOVFF PP0,PBP_BARGHHH
	MOVFF PP0H,PBP_BARGHH
	MOVFF PP0HH,PBP_BARGH
	MOVFF PP0HHH,PBP_BARG
	CALL FPM@32
	MOVLW 198
	MOVWF PBP_BARGHHH,0
	MOVLW 245
	MOVWF PBP_BARGHH,0
	MOVLW 31
	MOVWF PBP_BARGH,0
	MOVLW 128
	MOVWF PBP_BARG,0
	CALL FPA@32
	MOVFF PBP_AARGHHH,PP1
	MOVFF PBP_AARGHH,PP1H
	MOVFF PBP_AARGH,PP1HH
	MOVFF PBP_AARG,PP1HHH
	MOVFF PP0,PBP_AARGHHH
	MOVFF PP0H,PBP_AARGHH
	MOVFF PP0HH,PBP_AARGH
	MOVFF PP0HHH,PBP_AARG
	MOVLW 138
	MOVWF PBP_BARGHHH,0
	MOVLW 18
	MOVWF PBP_BARGHH,0
	MOVLW 121
	MOVWF PBP_BARGH,0
	MOVLW 125
	MOVWF PBP_BARG,0
	CALL FPM@32
	MOVLW 246
	MOVWF PBP_BARGHHH,0
	MOVLW 70
	MOVWF PBP_BARGHH,0
	MOVLW 85
	MOVWF PBP_BARGH,0
	MOVLW 126
	MOVWF PBP_BARG,0
	CALL FPA@32
	MOVFF PP1,PBP_BARGHHH
	MOVFF PP1H,PBP_BARGHH
	MOVFF PP1HH,PBP_BARGH
	MOVFF PP1HHH,PBP_BARG
	CALL FPD@32
	MOVFF PBP_AARGHHH,PP1
	MOVFF PBP_AARGHH,PP1H
	MOVFF PBP_AARGH,PP1HH
	MOVFF PBP_AARG,PP1HHH
	MOVF  PP0HHH,W,0
	MOVWF PBP_AARG,0
	MOVWF PBP_BARG,0
	MOVF  PP0HH,W,0
	MOVWF PBP_AARGH,0
	MOVWF PBP_BARGH,0
	MOVF  PP0H,W,0
	MOVWF PBP_AARGHH,0
	MOVWF PBP_BARGHH,0
	MOVF  PP0,W,0
	MOVWF PBP_AARGHHH,0
	MOVWF PBP_BARGHHH,0
	CALL FPM@32
	MOVFF PBP_AARGHHH,PP7
	MOVFF PBP_AARGHH,PP7H
	MOVFF PBP_AARGH,PP7HH
	MOVFF PBP_AARG,PP7HHH
	MOVFF PP1,PBP_BARGHHH
	MOVFF PP1H,PBP_BARGHH
	MOVFF PP1HH,PBP_BARGH
	MOVFF PP1HHH,PBP_BARG
	CALL FPM@32
	MOVFF PP0,PBP_BARGHHH
	MOVFF PP0H,PBP_BARGHH
	MOVFF PP0HH,PBP_BARGH
	MOVFF PP0HHH,PBP_BARG
	CALL FPM@32
	MOVFF PP7,PBP_BARGHHH
	MOVFF PP7H,PBP_BARGHH
	MOVFF PP7HH,PBP_BARGH
	MOVFF PP7HHH,PBP_BARG
	TSTFSZ PBP_BARG,0
	DECF  PBP_BARG,1,0
	CALL FPS@32
	MOVFF PP0,PBP_BARGHHH
	MOVFF PP0H,PBP_BARGHH
	MOVFF PP0HH,PBP_BARGH
	MOVFF PP0HHH,PBP_BARG
	CALL FPA@32
	MOVF  PP3H,1,0
	BZ    LOG@32_5
	MOVFF PBP_AARGHHH,PP7
	MOVFF PBP_AARGHH,PP7H
	MOVFF PBP_AARGH,PP7HH
	MOVFF PBP_AARG,PP7HHH
	MOVFF PP3H,PBP_AARGHHH
	MOVLW 0
	BTFSC PBP_AARGHHH,7,0
	MOVLW 255
	MOVWF PBP_AARGHH,0
	MOVWF PBP_AARGH,0
	MOVWF PBP_AARG,0
	CALL INT32@TOFLOAT32
	MOVFF PBP_AARGHHH,PP0
	MOVFF PBP_AARGHH,PP0H
	MOVFF PBP_AARGH,PP0HH
	MOVFF PBP_AARG,PP0HHH
	MOVLW 131
	MOVWF PBP_BARGHHH,0
	MOVLW 128
	MOVWF PBP_BARGHH,0
	MOVLW 222
	MOVWF PBP_BARGH,0
	MOVLW 114
	MOVWF PBP_BARG,0
	CALL FPM@32
	MOVFF PP7,PBP_BARGHHH
	MOVFF PP7H,PBP_BARGHH
	MOVFF PP7HH,PBP_BARGH
	MOVFF PP7HHH,PBP_BARG
	CALL FPA@32
	MOVFF PBP_AARGHHH,PP7
	MOVFF PBP_AARGHH,PP7H
	MOVFF PBP_AARGH,PP7HH
	MOVFF PBP_AARG,PP7HHH
	MOVFF PP0,PBP_AARGHHH
	MOVFF PP0H,PBP_AARGHH
	MOVFF PP0HH,PBP_AARGH
	MOVFF PP0HHH,PBP_AARG
	CLRF  PBP_BARGHHH,0
	MOVLW 128
	MOVWF PBP_BARGHH,0
	MOVLW 49
	MOVWF PBP_BARGH,0
	MOVLW 126
	MOVWF PBP_BARG,0
	CALL FPM@32
	MOVFF PP7,PBP_BARGHHH
	MOVFF PP7H,PBP_BARGHH
	MOVFF PP7HH,PBP_BARGH
	MOVFF PP7HHH,PBP_BARG
	CALL FPA@32
	BTFSC PP3,6,0
	BRA   LOG@32_5
	BCF   _FP_FLAGS,6,0
	BRA   LOG@32_5
LOG@32_4	
	BSF   _FP_FLAGS,5,0
LOG@32_5	
	MOVF  PBP_AARGHHH,W,0
	RETURN
 NOLIST
endif

 NOLIST
ifdef FP@ACOS_REQ
;-------------------------------------------------------------------------
; ACOS
; Value to ACOS held in PBP_AARG, PBP_AARGH, PBP_AARGHH, PBP_AARGHHH
; Result of ACOS returned in PBP_AARG, PBP_AARGH, PBP_AARGHH, PBP_AARGHHH
; Stores temporary value in PBP_CARG, PBP_CARGH, PBP_CARGHH, PBP_CARGHHH
;
; SYSTEM VARIABLES USED
; PBP_BARG,PBP_BARGH,PBP_BARGHH,PBP_BARGHHH
;
; SUBROUTINES CALLED
; ASIN, ADD

  LIST
	FP@ASIN_REQ = 1		; Enable ASIN
	FPA@32_REQ = 1		; Enable ADDITION

FPACOS@32
	RCALL FPASIN@32       
; PBP_AARG = PBP_AARG + -1.5708	
	MOVLW 248
	MOVWF PBP_BARGHHH
	MOVLW 15
	MOVWF PBP_BARGHH
	MOVLW 201
	MOVWF PBP_BARGH
	MOVLW 127
	MOVWF PBP_BARG
	CALL FPA@32
; PBP_AARG = ABS PBP_AARG 
	BCF PBP_AARGH,7
    RETURN
 NOLIST
endif

 NOLIST
ifdef FP@ASIN_REQ
;-------------------------------------------------------------------------
; ASIN
; Value to ASIN held in PBP_AARG, PBP_AARGH, PBP_AARGHH, PBP_AARGHHH
; Result of ASIN returned in PBP_AARG, PBP_AARGH, PBP_AARGHH, PBP_AARGHHH
; 
; SYSTEM VARIABLES USED
; PBP_AARG,PBP_AARGH,PBP_AARGHH,PBP_AARGHHH
; PBP_BARG,PBP_BARGH,PBP_BARGHH,PBP_BARGHHH
; PBP_CARG,PBP_CARGH,PBP_CARGHH,PBP_CARGHHH

; SUBROUTINES CALLED
; ATAN, SQR, SUB, MUL, DIV

 LIST
	FPS@32_REQ = 1		; Enable SUBTRACTION
	FPM@32_REQ = 1		; Enable MULTIPLY
	FPD@32_REQ = 1		; Enable DIVIDE
	FP@ATAN_REQ = 1		; Enable ATAN
	FP@SQR_REQ = 1		; Enable SQR
FPASIN@32
	MOVF PBP_AARGHHH,W
    MOVWF PBP_BARGHHH
    MOVWF PBP_CARGHHH     
	MOVF PBP_AARGHH,W
    MOVWF PBP_BARGHH
    MOVWF PBP_CARGHH   
	MOVF PBP_AARGH,W
    MOVWF PBP_BARGH
    MOVWF PBP_CARGH
	MOVF PBP_AARG,W
    MOVWF PBP_BARG
	MOVWF PBP_CARG
	CALL FPM@32
        
	MOVFF PBP_AARGHHH,PBP_BARGHHH
	MOVFF PBP_AARGHH,PBP_BARGHH
	MOVFF PBP_AARGH,PBP_BARGH
	MOVFF PBP_AARG,PBP_BARG
        
	CLRF PBP_AARGHHH
	CLRF PBP_AARGHH
	CLRF PBP_AARGH
	MOVLW 127
	MOVWF PBP_AARG
	CALL FPS@32
	CALL FPSQR@32
	MOVFF PBP_AARGHHH,PBP_BARGHHH
	MOVFF PBP_AARGHH,PBP_BARGHH
	MOVFF PBP_AARGH,PBP_BARGH
	MOVFF PBP_AARG,PBP_BARG
        
; PBP_AARG = ATAN(PBP_CARG / PBP_BARG)
	MOVFF PBP_CARGHHH,PBP_AARGHHH
	MOVFF PBP_CARGHH,PBP_AARGHH
	MOVFF PBP_CARGH,PBP_AARGH
	MOVFF PBP_CARG,PBP_AARG
	CALL FPD@32
 NOLIST
	;CALL FPATAN@32
; Fall through to ATAN
endif

 NOLIST
ifdef FP@ATAN_REQ
;-------------------------------------------------------------------------
; ATAN
; Value to ATAN held in PBP_AARG, PBP_AARGH, PBP_AARGHH, PBP_AARGHHH
; Result of ATAN returned in PBP_AARG, PBP_AARGH, PBP_AARGHH, PBP_AARGHHH
; 
; SYSTEM VARIABLES USED
; PBP_AARG,PBP_AARGH,PBP_AARGHH,PBP_AARGHHH
; PBP_BARG,PBP_BARGH,PBP_BARGHH,PBP_BARGHHH
; PP0, PP0H, PP0HH, PP0HHH
; PP1, PP1H, PP1HH, PP1HHH
; PP2, PP2H, PP2HH, PP2HHH
; PPZHHH

; SUBROUTINES CALLED
; ADD, SUB, MUL, DIV

 LIST	
	FPA@32_REQ = 1		; Enable ADDITION
	FPS@32_REQ = 1		; Enable SUBTRACTION
	FPM@32_REQ = 1		; Enable MULTIPLY
	FPD@32_REQ = 1		; Enable DIVIDE

FPATAN@32
    CLRF  PPZHHH	
    MOVFF PBP_AARGHHH,PP0HHH
	MOVFF PBP_AARGHH,PP0HH
	MOVFF PBP_AARGH,PP0H
	MOVF PBP_AARG,W
	MOVWF PP0
	BZ    ATAN32@5
	BTFSS PBP_AARGH,7
	BRA   ATAN32@5
	BSF PPZHHH,0
    MOVLW 128
	XORWF PP0H,F
ATAN32@5	
	BTFSC PP0H,7
	BRA   ATAN32@6
	MOVLW 1
	SUBWF PP0HHH,W
	MOVLW 0
	SUBWFB PP0HH,W
	MOVLW 0
	SUBWFB PP0H,W
	MOVLW 127
	SUBWFB PP0,W
	BNC   ATAN32@6
	CLRF  PBP_AARGHHH
	CLRF  PBP_AARGHH
	CLRF  PBP_AARGH
	MOVLW 127
	MOVWF PBP_AARG
	MOVFF PP0HHH,PBP_BARGHHH
	MOVFF PP0HH,PBP_BARGHH
	MOVFF PP0H,PBP_BARGH
	MOVFF PP0,PBP_BARG
	CALL FPD@32
	MOVFF PBP_AARGHHH,PP0HHH
	MOVFF PBP_AARGHH,PP0HH
	MOVFF PBP_AARGH,PP0H
	MOVFF PBP_AARG,PP0
    BSF PPZHHH,1
ATAN32@6	
	MOVLW 10
	MOVWF PBP_AARGHHH
	MOVLW 137
	MOVWF PBP_AARGHH
	MOVLW 52
	MOVWF PBP_AARGH
	MOVLW 124
	MOVWF PBP_AARG
	MOVFF PP0HHH,PBP_BARGHHH
	MOVFF PP0HH,PBP_BARGHH
	MOVFF PP0H,PBP_BARGH
	MOVFF PP0,PBP_BARG
	CALL FPM@32
	MOVFF PP0HHH,PBP_BARGHHH
	MOVFF PP0HH,PBP_BARGHH
	MOVFF PP0H,PBP_BARGH
	MOVFF PP0,PBP_BARG
	CALL FPM@32
	MOVLW 124
	MOVWF PBP_BARGHHH
	MOVLW 121
	MOVWF PBP_BARGHH
	MOVLW 53
	MOVWF PBP_BARGH
	MOVLW 129
	MOVWF PBP_BARG
	CALL FPA@32
	MOVFF PP0HHH,PBP_BARGHHH
	MOVFF PP0HH,PBP_BARGHH
	MOVFF PP0H,PBP_BARGH
	MOVFF PP0,PBP_BARG
	CALL FPM@32
	MOVFF PP0HHH,PBP_BARGHHH
	MOVFF PP0HH,PBP_BARGHH
	MOVFF PP0H,PBP_BARGH
	MOVFF PP0,PBP_BARG
	CALL FPM@32
	MOVLW 63
	MOVWF PBP_BARGHHH
	MOVLW 2
	MOVWF PBP_BARGHH
	MOVLW 51
	MOVWF PBP_BARGH
	MOVLW 131
	MOVWF PBP_BARG
	CALL FPA@32
	MOVFF PP0HHH,PBP_BARGHHH
	MOVFF PP0HH,PBP_BARGHH
	MOVFF PP0H,PBP_BARGH
	MOVFF PP0,PBP_BARG
	CALL FPM@32
	MOVFF PP0HHH,PBP_BARGHHH
	MOVFF PP0HH,PBP_BARGHH
	MOVFF PP0H,PBP_BARGH
	MOVFF PP0,PBP_BARG
	CALL FPM@32
	MOVLW 51
	MOVWF PBP_BARGHHH
	MOVLW 140
	MOVWF PBP_BARGHH
	MOVLW 30
	MOVWF PBP_BARGH
	MOVLW 131
	MOVWF PBP_BARG
	CALL FPA@32
	MOVFF PBP_AARGHHH,PP1HHH
	MOVFF PBP_AARGHH,PP1HH
	MOVFF PBP_AARGH,PP1H
	MOVFF PBP_AARG,PP1
	MOVF  PP0HHH,W
	MOVWF PBP_AARGHHH
	MOVF  PP0HH,W
	MOVWF PBP_AARGHH
	MOVF  PP0H,W
	MOVWF PBP_AARGH
	MOVF  PP0,W
	MOVWF PBP_AARG
	MOVFF PP0HHH,PBP_BARGHHH
	MOVFF PP0HH,PBP_BARGHH
	MOVFF PP0H,PBP_BARGH
	MOVFF PP0,PBP_BARG
	CALL FPM@32
	MOVLW 27
	MOVWF PBP_BARGHHH
	MOVLW 228
	MOVWF PBP_BARGHH
	MOVLW 53
	MOVWF PBP_BARGH
	MOVLW 130
	MOVWF PBP_BARG
	CALL FPA@32
	MOVFF PP0HHH,PBP_BARGHHH
	MOVFF PP0HH,PBP_BARGHH
	MOVFF PP0H,PBP_BARGH
	MOVFF PP0,PBP_BARG
	CALL FPM@32
	MOVFF PP0HHH,PBP_BARGHHH
	MOVFF PP0HH,PBP_BARGHH
	MOVFF PP0H,PBP_BARGH
	MOVFF PP0,PBP_BARG
	CALL FPM@32
	MOVLW 164
	MOVWF PBP_BARGHHH
	MOVLW 219
	MOVWF PBP_BARGHH
	MOVLW 103
	MOVWF PBP_BARGH
	MOVLW 131
	MOVWF PBP_BARG
	CALL FPA@32
	MOVFF PP0HHH,PBP_BARGHHH
	MOVFF PP0HH,PBP_BARGHH
	MOVFF PP0H,PBP_BARGH
	MOVFF PP0,PBP_BARG
	CALL FPM@32
	MOVFF PP0HHH,PBP_BARGHHH
	MOVFF PP0HH,PBP_BARGHH
	MOVFF PP0H,PBP_BARGH
	MOVFF PP0,PBP_BARG
	CALL FPM@32
	MOVLW 51
	MOVWF PBP_BARGHHH
	MOVLW 140
	MOVWF PBP_BARGHH
	MOVLW 30
	MOVWF PBP_BARGH
	MOVLW 131
	MOVWF PBP_BARG
	CALL FPA@32
	MOVFF PBP_AARGHHH,PP2HHH
	MOVFF PBP_AARGHH,PP2HH
	MOVFF PBP_AARGH,PP2H
	MOVFF PBP_AARG,PP2
	MOVFF PP0HHH,PBP_AARGHHH
	MOVFF PP0HH,PBP_AARGHH
	MOVFF PP0H,PBP_AARGH
	MOVFF PP0,PBP_AARG
	MOVFF PP1HHH,PBP_BARGHHH
	MOVFF PP1HH,PBP_BARGHH
	MOVFF PP1H,PBP_BARGH
	MOVFF PP1,PBP_BARG
	CALL FPM@32
	MOVFF PP2HHH,PBP_BARGHHH
	MOVFF PP2HH,PBP_BARGHH
	MOVFF PP2H,PBP_BARGH
	MOVFF PP2,PBP_BARG
	CALL FPD@32
    MOVFF PBP_AARGHHH,PBP_BARGHHH
	MOVFF PBP_AARGHH,PBP_BARGHH
	MOVFF PBP_AARGH,PBP_BARGH
	MOVFF PBP_AARG,PBP_BARG
	BTFSS PPZHHH,1
    BRA ATAN32@7    
    MOVLW 219
	MOVWF PBP_AARGHHH
	MOVLW 15
	MOVWF PBP_AARGHH
	MOVLW 73
	MOVWF PBP_AARGH
	MOVLW 127
	MOVWF PBP_AARG
	CALL FPS@32			
ATAN32@7	
	BTFSS PPZHHH,0
    BRA ATAN32@8   
    MOVLW 128
	XORWF PBP_AARGH,F   				
ATAN32@8	
	MOVF  PBP_AARGHHH,W			; return PP1HHH
	RETURN
 NOLIST
endif

 NOLIST
ifdef FP@TAN_REQ
;-------------------------------------------------------------------------
; TAN
; TAN is SIN / COS

; SYSTEM VARIABLES USED
; PBP_AARG,PBP_AARGH,PBP_AARGHH,PBP_AARGHHH
; PBP_BARG,PBP_BARGH,PBP_BARGHH,PBP_BARGHHH
; _FP_FLAGS
; PP0, PP0H, PP0HH, PP0HHH
; PP1, PP1H, PP1HH, PP1HHH
; PP2, PP2H, PP2HH, PP2HHH
; PP7, PP7H, PP7HH, PP7HHH
; PBP_CARG,PBP_CARGH,PBP_CARGHH,PBP_CARGHHH

; SUBROUTINES CALLED
; SIN, COS, DIV (ADD, SUB, MUL, FLOAT to INT, INT to FLOAT)

 LIST	
	FP@COS_REQ = 1		; Enable COS
	FP@SIN_REQ = 1		; Enable SIN
	FPD@32_REQ = 1		; Enable DIVIDE

FPTAN@32	
	MOVFF PBP_AARGHHH,PP7H				; Save value to TAN in PP7
	MOVFF PBP_AARGHH,PP7HH
	MOVFF PBP_AARGH,PP7HHH
	MOVFF PBP_AARG,PP7
	RCALL FPCOS@32						; Find the cosin of the value
	
	MOVFF PBP_AARGHHH,PBP_CARGH			; Save result of COS in PBP_CARG
	MOVFF PBP_AARGHH,PBP_CARGHH
	MOVFF PBP_AARGH,PBP_CARGHHH
	MOVFF PBP_AARG,PBP_CARG
	
	MOVFF PP7H,PBP_AARGHHH				; Setup for SIN with the original value
	MOVFF PP7HH,PBP_AARGHH
	MOVFF PP7HHH,PBP_AARGH
	MOVFF PP7,PBP_AARG
	RCALL FPSIN@32						; Find the sin of the value
	
	; TAN = AARG / CARG
		
	MOVFF PBP_CARGH,PBP_BARGHHH
	MOVFF PBP_CARGHH,PBP_BARGHH
	MOVFF PBP_CARGHHH,PBP_BARGH
	MOVFF PBP_CARG,PBP_BARG	
	GOTO FPD@32							; Return via DIVIDE subroutine
 NOLIST
endif
 NOLIST
ifdef FP@COS_REQ
;-------------------------------------------------------------------------
; COSIN

; SYSTEM VARIABLES USED
; PBP_AARG,PBP_AARGH,PBP_AARGHH,PBP_AARGHHH
; PBP_BARG,PBP_BARGH,PBP_BARGHH,PBP_BARGHHH
; _FP_FLAGS
; PP0, PP0H, PP0HH, PP0HHH
; PP1, PP1H, PP1HH, PP1HHH
; PP2, PP2H, PP2HH, PP2HHH

; SUBROUTINES CALLED
; COSIN32, ADD, SUB, MUL, DIV, FLOAT to INT, INT to FLOAT

 LIST
	FP@COSIN32_REQ = 1
	FPS@32_REQ = 1		; Enable SUBTRACT
	FPA@32_REQ = 1		; Enable ADDITION
	FPM@32_REQ = 1		; Enable MULTIPLY
	INT@3232_REQ = 1	; Enable FLOAT to INT
	FLO@3232S_REQ = 1	; Enable INT to FLOAT
	
FPCOS@32
	MOVLW 1				; Point to COS in cosin32	
	BRA cosin@32
 NOLIST
endif
 NOLIST
ifdef FP@SIN_REQ
;-------------------------------------------------------------------------
;SIN

; SYSTEM VARIABLES USED
; PBP_AARG,PBP_AARGH,PBP_AARGHH,PBP_AARGHHH
; PBP_BARG,PBP_BARGH,PBP_BARGHH,PBP_BARGHHH
; _FP_FLAGS
; PP0, PP0H, PP0HH, PP0HHH
; PP1, PP1H, PP1HH, PP1HHH
; PP2, PP2H, PP2HH, PP2HHH

; SUBROUTINES CALLED
; COSIN32, ADD, SUB, MUL, DIV, FLOAT to INT, INT to FLOAT

 LIST
	FP@COSIN32_REQ = 1
	FPS@32_REQ = 1		; Enable SUBTRACT
	FPA@32_REQ = 1		; Enable ADDITION
	FPM@32_REQ = 1		; Enable MULTIPLY
	INT@3232_REQ = 1	; Enable FLOAT to INT
	FLO@3232S_REQ = 1	; Enable INT to FLOAT
	
FPSIN@32
	MOVLW 0				; Point to SIN in cosin32	
 NOLIST
	; Fall through to cosin@32
endif

 NOLIST
ifdef FP@COSIN32_REQ
;--------------------------------------------------------------------------
; Underlying subroutine for SIN, COS, and TAN

; SYSTEM VARIABLES USED
; PBP_AARG,PBP_AARGH,PBP_AARGHH,PBP_AARGHHH
; PBP_BARG,PBP_BARGH,PBP_BARGHH,PBP_BARGHHH
; _FP_FLAGS
; PP0, PP0H, PP0HH, PP0HHH
; PP1, PP1H, PP1HH, PP1HHH
; PP2, PP2H, PP2HH, PP2HHH

; SUBROUTINES CALLED
; ADD, SUB, MUL, DIV, FLOAT to INT, INT to FLOAT

 LIST
cosin@32
	MOVWF PP2
	MOVFF _FP_FLAGS,PP2HH
	BSF   _FP_FLAGS,6
	CLRF  PP2HHH
	TSTFSZ PP2,0
	BRA   FPSIN@32_7
	BTFSC PBP_AARGH,7
	BSF   PP2HHH,7
FPSIN@32_7	
	BCF   PBP_AARGH,7
	MOVLW 136
	CPFSLT PBP_AARG,0
	BSF   _FP_FLAGS,5
	MOVFF PBP_AARGHHH,PP0
	MOVFF PBP_AARGHH,PP0H
	MOVFF PBP_AARGH,PP0HH
	MOVFF PBP_AARG,PP0HHH
	MOVLW 131
	MOVWF PBP_BARGHHH
	MOVLW 249
	MOVWF PBP_BARGHH
	MOVLW 34
	MOVWF PBP_BARGH
	MOVLW 127
	MOVWF PBP_BARG
	CALL FPM@32
	BCF   _FP_FLAGS,6
	CALL INT@3232
	BSF   _FP_FLAGS,6
	BTFSS PBP_AARGHHH,0
	BRA   FPSIN@32_8
	INCF  PBP_AARGHHH,F
	MOVLW 0
	ADDWFC PBP_AARGHH,F
	ADDWFC PBP_AARGH,F
FPSIN@32_8	
	MOVLW 7
	ANDWF PBP_AARGHHH,W,0
	MOVWF PP2H
	MOVLW 3
	CPFSGT PP2H
	BRA   FPSIN@32_9
	MOVLW 128
	XORWF PP2HHH,F
	MOVLW 4
	SUBWF PP2H,F
FPSIN@32_9	
	CLRF  PBP_AARG
	CALL INT32@TOFLOAT32
	MOVF  PBP_AARG,W
	MOVWF PP1HHH
	BZ    FPSIN@32_10
	MOVFF PBP_AARGHHH,PP1
	MOVFF PBP_AARGHH,PP1H
	MOVFF PBP_AARGH,PP1HH
	CLRF  PBP_BARGHHH
	MOVLW 15
	MOVWF PBP_BARGHH
	MOVLW 201
	MOVWF PBP_BARGH
	MOVLW 126
	MOVWF PBP_BARG
	CALL FPM@32
	MOVFF PP0,PBP_BARGHHH
	MOVFF PP0H,PBP_BARGHH
	MOVFF PP0HH,PBP_BARGH
	MOVFF PP0HHH,PBP_BARG
	CALL FPA@32
	MOVFF PBP_AARGHHH,PP0
	MOVFF PBP_AARGHH,PP0H
	MOVFF PBP_AARGH,PP0HH
	MOVFF PBP_AARG,PP0HHH
	MOVFF PP1,PBP_AARGHHH
	MOVFF PP1H,PBP_AARGHH
	MOVFF PP1HH,PBP_AARGH
	MOVFF PP1HHH,PBP_AARG
	CLRF  PBP_BARGHHH
	MOVLW 162
	MOVWF PBP_BARGHH
	MOVLW 218
	MOVWF PBP_BARGH
	MOVLW 110
	MOVWF PBP_BARG
	CALL FPM@32
	MOVFF PP0,PBP_BARGHHH
	MOVFF PP0H,PBP_BARGHH
	MOVFF PP0HH,PBP_BARGH
	MOVFF PP0HHH,PBP_BARG
	CALL FPA@32
	MOVFF PBP_AARGHHH,PP0
	MOVFF PBP_AARGHH,PP0H
	MOVFF PBP_AARGH,PP0HH
	MOVFF PBP_AARG,PP0HHH
	MOVFF PP1,PBP_AARGHHH
	MOVFF PP1H,PBP_AARGHH
	MOVFF PP1HH,PBP_AARGH
	MOVFF PP1HHH,PBP_AARG
	MOVLW 32
	MOVWF PBP_BARGHHH
	MOVLW 162
	MOVWF PBP_BARGHH
	MOVLW 133
	MOVWF PBP_BARGH
	MOVLW 92
	MOVWF PBP_BARG
	CALL FPM@32
	MOVFF PP0,PBP_BARGHHH
	MOVFF PP0H,PBP_BARGHH
	MOVFF PP0HH,PBP_BARGH
	MOVFF PP0HHH,PBP_BARG
	CALL FPA@32
	MOVF  PBP_AARG,W
	MOVWF PP0HHH
	MOVWF PBP_BARG
	MOVF  PBP_AARGH,W
	MOVWF PP0HH
	MOVWF PBP_BARGH
	MOVF  PBP_AARGHH,W
	MOVWF PP0H
	MOVWF PBP_BARGHH
	MOVF  PBP_AARGHHH,W
	MOVWF PP0,0
	MOVWF PBP_BARGHHH
	BRA   FPSIN@32_11
FPSIN@32_10	
	MOVF  PP0HHH,W
	MOVWF PBP_AARG
	MOVWF PBP_BARG
	MOVF  PP0HH,W
	MOVWF PBP_AARGH
	MOVWF PBP_BARGH
	MOVF  PP0H,W
	MOVWF PBP_AARGHH
	MOVWF PBP_BARGHH
	MOVF  PP0,W
	MOVWF PBP_AARGHHH
	MOVWF PBP_BARGHHH
FPSIN@32_11	
	CALL FPM@32
	MOVFF PBP_AARGHHH,PP1
	MOVFF PBP_AARGHH,PP1H
	MOVFF PBP_AARGH,PP1HH
	MOVFF PBP_AARG,PP1HHH
	RRCF  PP2H,W
	XORWF PP2H,W
	ANDLW 1
	XORWF PP2,W
	BZ    FPSIN@32_12
	MOVLW 206
	MOVWF PBP_BARGHHH
	MOVLW 245
	MOVWF PBP_BARGHH
	MOVLW 76
	MOVWF PBP_BARGH
	MOVLW 111
	MOVWF PBP_BARG
	CALL FPM@32
	MOVLW 26
	MOVWF PBP_BARGHHH
	MOVLW 6
	MOVWF PBP_BARGHH
	MOVLW 182
	MOVWF PBP_BARGH
	MOVLW 117
	MOVWF PBP_BARG
	CALL FPA@32
	MOVFF PP1,PBP_BARGHHH
	MOVFF PP1H,PBP_BARGHH
	MOVFF PP1HH,PBP_BARGH
	MOVFF PP1HHH,PBP_BARG
	CALL FPM@32
	MOVLW 165
	MOVWF PBP_BARGHHH
	MOVLW 170
	MOVWF PBP_BARGHH
	MOVLW 42
	MOVWF PBP_BARGH
	MOVLW 122
	MOVWF PBP_BARG
	CALL FPA@32
	MOVFF PP1,PBP_BARGHHH
	MOVFF PP1H,PBP_BARGHH
	MOVFF PP1HH,PBP_BARGH
	MOVFF PP1HHH,PBP_BARG
	CALL FPM@32
	MOVFF PP1,PBP_BARGHHH
	MOVFF PP1H,PBP_BARGHH
	MOVFF PP1HH,PBP_BARGH
	MOVFF PP1HHH,PBP_BARG
	CALL FPM@32
	MOVFF PP1,PBP_BARGHHH
	MOVFF PP1H,PBP_BARGHH
	MOVFF PP1HH,PBP_BARGH
	MOVFF PP1HHH,PBP_BARG
	TSTFSZ PBP_BARG
	DECF  PBP_BARG,F
	CALL FPS@32
	BCF   _FP_FLAGS,6
	CLRF  PBP_BARGHHH
	CLRF  PBP_BARGHH
	CLRF  PBP_BARGH
	MOVLW 127
	MOVWF PBP_BARG
	CALL FPA@32
	BRA   FPSIN@32_13
FPSIN@32_12	
	MOVLW 249
	MOVWF PBP_BARGHHH
	MOVLW 104
	MOVWF PBP_BARGHH
	MOVLW 54
	MOVWF PBP_BARGH
	MOVLW 108
	MOVWF PBP_BARG
	CALL FPM@32
	MOVLW 192
	MOVWF PBP_BARGHHH
	MOVLW 7
	MOVWF PBP_BARGHH
	MOVLW 208
	MOVWF PBP_BARGH
	MOVLW 114
	MOVWF PBP_BARG
	CALL FPA@32
	MOVFF PP1,PBP_BARGHHH
	MOVFF PP1H,PBP_BARGHH
	MOVFF PP1HH,PBP_BARGH
	MOVFF PP1HHH,PBP_BARG
	CALL FPM@32
	MOVLW 132
	MOVWF PBP_BARGHHH
	MOVLW 136
	MOVWF PBP_BARGHH
	MOVLW 8
	MOVWF PBP_BARGH
	MOVLW 120
	MOVWF PBP_BARG
	CALL FPA@32
	MOVFF PP1,PBP_BARGHHH
	MOVFF PP1H,PBP_BARGHH
	MOVFF PP1HH,PBP_BARGH
	MOVFF PP1HHH,PBP_BARG
	CALL FPM@32
	MOVLW 171
	MOVWF PBP_BARGHHH
	MOVLW 170
	MOVWF PBP_BARGHH
	MOVWF PBP_BARGH
	MOVLW 124
	MOVWF PBP_BARG
	CALL FPA@32
	MOVFF PP1,PBP_BARGHHH
	MOVFF PP1H,PBP_BARGHH
	MOVFF PP1HH,PBP_BARGH
	MOVFF PP1HHH,PBP_BARG
	CALL FPM@32
	MOVFF PP0,PBP_BARGHHH
	MOVFF PP0H,PBP_BARGHH
	MOVFF PP0HH,PBP_BARGH
	MOVFF PP0HHH,PBP_BARG
	CALL FPM@32
	BCF   _FP_FLAGS,6
	MOVFF PP0,PBP_BARGHHH
	MOVFF PP0H,PBP_BARGHH
	MOVFF PP0HH,PBP_BARGH
	MOVFF PP0HHH,PBP_BARG
	CALL FPA@32
FPSIN@32_13	
	MOVLW 128
	MOVF  PP2,F
	BZ    FPSIN@32_14
	BTFSC PP2H,1
	XORWF PP2HHH,F
FPSIN@32_14	
	BTFSC PP2HHH,7
	XORWF PBP_AARGH,F
	BTFSC PP2HH,6
	BSF   _FP_FLAGS,6
	MOVF  PBP_AARGHHH,W
	RETURN
 NOLIST
endif
 
 NOLIST
ifdef FP@SQR_REQ 
;----------------------------------------------------------
; SQUARE ROOT

; SYSTEM VARIABLES USED
; PBP_AARG,PBP_AARGH,PBP_AARGHH,PBP_AARGHHH
; PBP_BARG,PBP_BARGH,PBP_BARGHH,PBP_BARGHHH
; _FP_FLAGS
; PP0, PP0H, PP0HH, PP0HHH
; PP1, PP1H, PP1HH, PP1HHH
; PP2, PP2H, PP2HH

; SUBROUTINES CALLED
; ADD, SUB, MUL, DIV

 LIST
	FPS@32_REQ = 1		; Enable SUBTRACT
	FPA@32_REQ = 1		; Enable ADDITION
	FPM@32_REQ = 1		; Enable MULTIPLY
	FPD@32_REQ = 1		; Enable DIVIDE
	
FPSQR@32
	BTFSC PBP_AARGH,7
	BRA   FPSQRT@32_6
	MOVF  PBP_AARG,1
	BTFSC STATUS,Z
	BRA   FPSQRT@32_7
	MOVFF PBP_AARG,PP2H
	MOVFF _FP_FLAGS,PP2HH
	BSF   _FP_FLAGS,6
	MOVLW 127
	MOVWF PBP_AARG
	CLRF  PBP_BARGHHH
	CLRF  PBP_BARGHH
	CLRF  PBP_BARGH
	MOVWF PBP_BARG
	CALL FPS@32
	MOVFF PBP_AARGHHH,PP0
	MOVFF PBP_AARGHH,PP0H
	MOVFF PBP_AARGH,PP0HH
	MOVFF PBP_AARG,PP0HHH
	MOVLW 19
	MOVWF PBP_BARGHHH
	MOVLW 203
	MOVWF PBP_BARGHH
	MOVLW 3
	MOVWF PBP_BARGH
	MOVLW 132
	MOVWF PBP_BARG
	CALL FPA@32
	MOVFF PP0,PBP_BARGHHH
	MOVFF PP0H,PBP_BARGHH
	MOVFF PP0HH,PBP_BARGH
	MOVFF PP0HHH,PBP_BARG
	CALL FPM@32
	MOVLW 188
	MOVWF PBP_BARGHHH
	MOVLW 90
	MOVWF PBP_BARGHH
	MOVLW 5
	MOVWF PBP_BARGH
	MOVLW 134
	MOVWF PBP_BARG
	CALL FPA@32
	MOVFF PP0,PBP_BARGHHH
	MOVFF PP0H,PBP_BARGHH
	MOVFF PP0HH,PBP_BARGH
	MOVFF PP0HHH,PBP_BARG
	CALL FPM@32
	MOVLW 131
	MOVWF PBP_BARGHHH
	MOVLW 48
	MOVWF PBP_BARGHH
	MOVLW 114
	MOVWF PBP_BARGH
	MOVLW 133
	MOVWF PBP_BARG
	CALL FPA@32
	MOVFF PBP_AARGHHH,PP1
	MOVFF PBP_AARGHH,PP1H
	MOVFF PBP_AARGH,PP1HH
	MOVFF PBP_AARG,PP1HHH
	MOVFF PP0,PBP_AARGHHH
	MOVFF PP0H,PBP_AARGHH
	MOVFF PP0HH,PBP_AARGH
	MOVFF PP0HHH,PBP_AARG
	MOVLW 142
	MOVWF PBP_BARGHHH
	MOVLW 215
	MOVWF PBP_BARGHH
	MOVLW 107
	MOVWF PBP_BARGH
	MOVLW 129
	MOVWF PBP_BARG
	CALL FPM@32
	MOVLW 181
	MOVWF PBP_BARGHHH
	MOVLW 41
	MOVWF PBP_BARGHH
	MOVLW 78
	MOVWF PBP_BARGH
	MOVLW 132
	MOVWF PBP_BARG
	CALL FPA@32
	MOVFF PP0,PBP_BARGHHH
	MOVFF PP0H,PBP_BARGHH
	MOVFF PP0HH,PBP_BARGH
	MOVFF PP0HHH,PBP_BARG
	CALL FPM@32
	MOVLW 128
	MOVWF PBP_BARGHHH
	MOVLW 48
	MOVWF PBP_BARGHH
	MOVLW 114
	MOVWF PBP_BARGH
	MOVLW 132
	MOVWF PBP_BARG
	CALL FPA@32
	MOVFF PP1,PBP_BARGHHH
	MOVFF PP1H,PBP_BARGHH
	MOVFF PP1HH,PBP_BARGH
	MOVFF PP1HHH,PBP_BARG
	CALL FPD@32
	MOVFF PP0,PBP_BARGHHH
	MOVFF PP0H,PBP_BARGHH
	MOVFF PP0HH,PBP_BARGH
	MOVFF PP0HHH,PBP_BARG
	CALL FPM@32
	CLRF  PBP_BARGHHH
	CLRF  PBP_BARGHH
	CLRF  PBP_BARGH
	MOVLW 127
	MOVWF PBP_BARG
	CALL FPA@32
	BTFSC PP2H,0
	BRA   FPSQRT@32_5
	MOVLW 243
	MOVWF PBP_BARGHHH
	MOVLW 4
	MOVWF PBP_BARGHH
	MOVLW 53
	MOVWF PBP_BARGH
	MOVLW 127
	MOVWF PBP_BARG
	CALL FPM@32
FPSQRT@32_5	
	MOVLW 127
	ADDWF PP2H,1
	RRCF  PP2H,W
	MOVWF PBP_AARG
	BTFSC PP2HH,6
	BRA   FPSQRT@32_7
	BCF   _FP_FLAGS,6
	BRA   FPSQRT@32_7
FPSQRT@32_6	
	BSF   _FP_FLAGS,5
FPSQRT@32_7	
	MOVF  PBP_AARGHHH,W
	RETURN
 NOLIST
endif

 NOLIST
ifdef FP@EXP_REQ
;----------------------------------------------------------
; EXP

; SYSTEM VARIABLES USED
; PBP_AARG,PBP_AARGH,PBP_AARGHH,PBP_AARGHHH
; PBP_BARG,PBP_BARGH,PBP_BARGHH,PBP_BARGHHH
; _FP_FLAGS, _AEXP, _BEXP, _SIGN
; PP0, PP0H, PP0HH, PP0HHH
; PP1, PP1H, PP1HH, PP1HHH
; PP2, PP2H, PP2HH, PP2HHH
; PP7, PP7H, PP7HH, PP7HHH

; SUBROUTINES CALLED
; ADD, SUB, MUL, DIV, FLOAT TO BYTE, BYTE TO FLOAT

 LIST
	FPS@32_REQ = 1		; Enable SUBTRACT
	FPA@32_REQ = 1		; Enable ADDITION
	FPM@32_REQ = 1		; Enable MULTIPLY
	FPD@32_REQ = 1		; Enable DIVIDE
	INT@3232_REQ = 1    ; FLOAT to 32-bit integer
	FLO@0832U_REQ = 1	; BYTE to FLOAT

EXP32@CALC
	MOVWF PP7
    MOVFF PP2HHH,PBP_BARGHHH
	MOVFF PP2HH,PBP_BARGHH
	MOVFF PP2H,PBP_BARGH
	MOVFF PP2,PBP_BARG
	CALL FPM@32
	MOVFF PP7HHH,PBP_BARGHHH
	MOVFF PP7HH,PBP_BARGHH
	MOVFF PP7H,PBP_BARGH
	MOVFF PP7,PBP_BARG
	GOTO FPA@32					; RETURN VIA FPA@32	
	
FPEXP@32
    MOVFF PBP_AARGHHH,PP2HHH
	MOVFF PBP_AARGHH,PP2HH
	MOVFF PBP_AARGH,PP2H
	MOVFF PBP_AARG,PP2
    MOVLW 23
	MOVWF PBP_BARGHHH
	MOVLW 114
	MOVWF PBP_BARGHH
	MOVLW 49
	MOVWF PBP_BARGH
	MOVLW 126
	MOVWF PBP_BARG
	CALL FPD@32
	CALL INT@3232
	MOVWF PP0
	BCF PP0H,0
	MOVF PP2,W
	BZ EXP32@LP1
    BTFSS PP2H,7
	BRA EXP32@LP1
	BSF PP0H,0
	NEGF PP0  
    MOVLW 128
    XORWF PP2H,F
EXP32@LP1
	CLRF PP1HHH
	CLRF PP1HH
	CLRF PP1H
	MOVLW 127
	ADDWF PP0,W
	MOVWF PP1
	MOVLW 23
	MOVWF PBP_BARGHHH
	MOVLW 114
	MOVWF PBP_BARGHH
	MOVLW 49
	MOVWF PBP_BARGH
	MOVLW 126
	MOVWF PBP_BARG
	MOVFF PP2HHH,PBP_AARGHHH
	MOVFF PP2HH,PBP_AARGHH
	MOVFF PP2H,PBP_AARGH
	MOVFF PP2,PBP_AARG
	CALL FPD@32
	MOVFF PBP_AARGHHH,PP2HHH
	MOVFF PBP_AARGHH,PP2HH
	MOVFF PBP_AARGH,PP2H
	MOVFF PBP_AARG,PP2
	MOVF PP0,W
	CALL FLO@0832U
	MOVFF PBP_AARGHHH,PBP_BARGHHH
	MOVFF PBP_AARGHH,PBP_BARGHH
	MOVFF PBP_AARGH,PBP_BARGH
	MOVFF PBP_AARG,PBP_BARG
	MOVFF PP2HHH,PBP_AARGHHH
	MOVFF PP2HH,PBP_AARGHH
	MOVFF PP2H,PBP_AARGH
	MOVFF PP2,PBP_AARG
	CALL FPS@32
	MOVFF PBP_AARGHHH,PP2HHH
	MOVFF PBP_AARGHH,PP2HH
	MOVFF PBP_AARGH,PP2H
	MOVFF PBP_AARG,PP2
	MOVLW 125
	MOVWF PBP_AARGHHH
	MOVLW 136
	MOVWF PBP_AARGHH
	MOVLW 89
	MOVWF PBP_AARGH
	MOVLW 114
	MOVWF PBP_AARG
	MOVFF PP2HHH,PBP_BARGHHH
	MOVFF PP2HH,PBP_BARGHH
	MOVFF PP2H,PBP_BARGH
	MOVFF PP2,PBP_BARG
	CALL FPM@32
	MOVLW 225
	MOVWF PBP_BARGHHH
	MOVLW 151
	MOVWF PBP_BARGHH
	MOVLW 38
	MOVWF PBP_BARGH
	MOVLW 117
	MOVWF PBP_BARG   
	CALL FPA@32
	MOVLW 195
	MOVWF PP7HHH
	MOVLW 29
	MOVWF PP7HH
	MOVLW 30
	MOVWF PP7H
	MOVLW 120
	RCALL EXP32@CALC
	MOVLW 93
	MOVWF PP7HHH
	MOVLW 80
	MOVWF PP7HH
	MOVLW 99
	MOVWF PP7H
	MOVLW 122
	RCALL EXP32@CALC
	MOVLW 27
	MOVWF PP7HHH
	MOVLW 254
	MOVWF PP7HH
	MOVLW 117
	MOVWF PP7H
	MOVLW 124
	RCALL EXP32@CALC
	MOVLW 23
	MOVWF PP7HHH
	MOVLW 114
	MOVWF PP7HH
	MOVLW 49
	MOVWF PP7H
	MOVLW 126
	RCALL EXP32@CALC
	MOVFF PP2HHH,PBP_BARGHHH
	MOVFF PP2HH,PBP_BARGHH
	MOVFF PP2H,PBP_BARGH
	MOVFF PP2,PBP_BARG
	CALL FPM@32
	CLRF PBP_BARGHHH
	CLRF PBP_BARGHH
	CLRF PBP_BARGH
	MOVLW 127
	MOVWF PBP_BARG
	CALL FPA@32   
	MOVFF PP1HHH,PBP_BARGHHH
	MOVFF PP1HH,PBP_BARGHH
	MOVFF PP1H,PBP_BARGH
	MOVFF PP1,PBP_BARG
	CALL FPM@32	
    MOVFF PBP_AARGHHH,PBP_BARGHHH
	MOVFF PBP_AARGHH,PBP_BARGHH
	MOVFF PBP_AARGH,PBP_BARGH
	MOVFF PBP_AARG,PBP_BARG	   
	BTFSS PP0H,0
	RETURN
	CLRF PBP_AARGHHH
	CLRF PBP_AARGHH
	CLRF PBP_AARGH
	MOVLW 127
	MOVWF PBP_AARG
	GOTO FPD@32								; Return via FP_DIVIDE	
 NOLIST
endif

 LIST
       
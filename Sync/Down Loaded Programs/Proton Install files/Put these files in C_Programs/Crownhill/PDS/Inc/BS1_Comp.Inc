


	Dim W0  as WORD
	Dim W1  as WORD
	Dim W2  as WORD
	Dim W3  as WORD
	Dim W4  as WORD
	Dim W5  as WORD
	Dim W6  as WORD

	Symbol B0 = W0.LOWBYTE
	Symbol B1 = W0.HIGHBYTE
	Symbol B2 = W1.LOWBYTE
	Symbol B3 = W1.HIGHBYTE
	Symbol B4 = W2.LOWBYTE
	Symbol B5 = W2.HIGHBYTE
	Symbol B6 = W3.LOWBYTE
	Symbol B7 = W3.HIGHBYTE
	Symbol B8 = W4.LOWBYTE
	Symbol B9 = W4.HIGHBYTE
	Symbol B10 = W5.LOWBYTE
	Symbol B11 = W5.HIGHBYTE
	Symbol B12 = W6.LOWBYTE
	Symbol B13 = W6.HIGHBYTE

	Symbol BIT0 = B0.0
	Symbol BIT1 = B0.1
	Symbol BIT2 = B0.2
	Symbol BIT3 = B0.3
	Symbol BIT4 = B0.4 
	Symbol BIT5 = B0.5
	Symbol BIT6 = B0.6
	Symbol BIT7 = B0.7
	Symbol BIT8 = B1.0
	Symbol BIT9 = B1.1
	Symbol BIT10 = B1.2
	Symbol BIT11 = B1.3
	Symbol BIT12 = B1.4
	Symbol BIT13 = B1.5
	Symbol BIT14 = B1.6
	Symbol BIT15 = B1.7

	Symbol PINS  =  PORTB

	Symbol PIN0 = PINS.0
	Symbol PIN1 = PINS.1
	Symbol PIN2 = PINS.2
	Symbol PIN3 = PINS.3
	Symbol PIN4 = PINS.4
	Symbol PIN5 = PINS.5
	Symbol PIN6 = PINS.6
	Symbol PIN7 = PINS.7

	Symbol T300 = 84
	Symbol N300 = 84 + $4000
	Symbol T600 = 84
	Symbol N600 = 84 + $4000
	Symbol T1200 = 84
	Symbol N1200 = 84 + $4000
	Symbol T2400 = 84
	Symbol N2400 = 84 + $4000
	Symbol T4800 = 42
	Symbol N4800 = 42 + $4000
	Symbol T9600 = 84
	Symbol N9600 = 84 + $4000

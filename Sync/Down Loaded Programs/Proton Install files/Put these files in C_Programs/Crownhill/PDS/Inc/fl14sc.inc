NOLIST
ifdef TALTB@32_REQ
LIST
TALTB@32		
		MOVF		PBP_AARGH,W
		XORWF		PBP_BARGH,W
		MOVWF		_FP_TEMPB0
		BTFSC		_FP_TEMPB0,7
		GOTO		TALTB@32O
		BTFSC		PBP_AARGH,7
		GOTO		TALTB@32N
TALTB@32P	
		MOVF		PBP_AARG,W
		SUBWF		PBP_BARG,W
		BTFSS		STATUS,C
		RETLW		0
		BTFSS		STATUS,Z
		RETLW		1
		MOVF		PBP_AARGH,W
		SUBWF		PBP_BARGH,W
		BTFSS		STATUS,C
		RETLW		0
		BTFSS		STATUS,Z
		RETLW		1
		MOVF		PBP_AARGHH,W
		SUBWF		PBP_BARGHH,W
		BTFSS		STATUS,C
		RETLW		0
		BTFSS		STATUS,Z
		RETLW		1
		MOVF		PBP_AARGHHH,W
		SUBWF		PBP_BARGHHH,W
		BTFSS		STATUS,C
		RETLW		0
		BTFSS		STATUS,Z
		RETLW		1
		RETLW		0
TALTB@32N	
		MOVF		PBP_BARG,W
		SUBWF		PBP_AARG,W
		BTFSS		STATUS,C
		RETLW		0
		BTFSS		STATUS,Z
		RETLW		1
		MOVF		PBP_BARGH,W
		SUBWF		PBP_AARGH,W
		BTFSS		STATUS,C
		RETLW		0
		BTFSS		STATUS,Z
		RETLW		1
		MOVF		PBP_BARGHH,W
		SUBWF		PBP_AARGHH,W
		BTFSS		STATUS,C
		RETLW		0
		BTFSS		STATUS,Z
		RETLW		1
		MOVF		PBP_BARGHHH,W
		SUBWF		PBP_AARGHHH,W
		BTFSS		STATUS,C
		RETLW		0
		BTFSS		STATUS,Z
		RETLW		1
		RETLW		0
TALTB@32O	
		BTFSS		PBP_BARGH,7
		RETLW		1
		RETLW		0
NOLIST
endif
LIST
NOLIST
ifdef TALEB@32_REQ
LIST
TALEB@32		
		MOVF		PBP_AARGH,W
		XORWF		PBP_BARGH,W
		MOVWF		_FP_TEMPB0
		BTFSC		_FP_TEMPB0,7
		GOTO		TALEB@32O
		BTFSC		PBP_AARGH,7
		GOTO		TALEB@32N
TALEB@32P	
		MOVF		PBP_AARG,W
		SUBWF		PBP_BARG,W
		BTFSS		STATUS,C
		RETLW		0
		BTFSS		STATUS,Z
		RETLW		1
		MOVF		PBP_AARGH,W
		SUBWF		PBP_BARGH,W
		BTFSS		STATUS,C
		RETLW		0
		BTFSS		STATUS,Z
		RETLW		1
		MOVF		PBP_AARGHH,W
		SUBWF		PBP_BARGHH,W
		BTFSS		STATUS,C
		RETLW		0
		BTFSS		STATUS,Z
		RETLW		1
		MOVF		PBP_AARGHHH,W
		SUBWF		PBP_BARGHHH,W
		BTFSS		STATUS,C
		RETLW		0
		RETLW		1
TALEB@32N	
		MOVF		PBP_BARG,W
		SUBWF		PBP_AARG,W
		BTFSS		STATUS,C
		RETLW		0
		BTFSS		STATUS,Z
		RETLW		1
		MOVF		PBP_BARGH,W
		SUBWF		PBP_AARGH,W
		BTFSS		STATUS,C
		RETLW		0
		BTFSS		STATUS,Z
		RETLW		1
		MOVF		PBP_BARGHH,W
		SUBWF		PBP_AARGHH,W
		BTFSS		STATUS,C
		RETLW		0
		BTFSS		STATUS,Z
		RETLW		1
		MOVF		PBP_BARGHHH,W
		SUBWF		PBP_AARGHHH,W
		BTFSS		STATUS,C
		RETLW		0
		RETLW		1
TALEB@32O	
		BTFSS		PBP_BARGH,7
		RETLW		1
		RETLW		0
NOLIST
endif
LIST
NOLIST
ifdef TAGTB@32_REQ
LIST
TAGTB@32		
		MOVF		PBP_BARGH,W
		XORWF		PBP_AARGH,W
		MOVWF		_FP_TEMPB0
		BTFSC		_FP_TEMPB0,7
		GOTO		TAGTB@32O
		BTFSC		PBP_BARGH,7
		GOTO		TAGTB@32N
TAGTB@32P	
		MOVF		PBP_BARG,W
		SUBWF		PBP_AARG,W
		BTFSS		STATUS,C
		RETLW		0
		BTFSS		STATUS,Z
		RETLW		1
		MOVF		PBP_BARGH,W
		SUBWF		PBP_AARGH,W
		BTFSS		STATUS,C
		RETLW		0
		BTFSS		STATUS,Z
		RETLW		1
		MOVF		PBP_BARGHH,W
		SUBWF		PBP_AARGHH,W
		BTFSS		STATUS,C
		RETLW		0
		BTFSS		STATUS,Z
		RETLW		1
		MOVF		PBP_BARGHHH,W
		SUBWF		PBP_AARGHHH,W
		BTFSS		STATUS,C
		RETLW		0
		BTFSS		STATUS,Z
		RETLW		1
		RETLW		0
TAGTB@32N	
		MOVF		PBP_AARG,W
		SUBWF		PBP_BARG,W
		BTFSS		STATUS,C
		RETLW		0
		BTFSS		STATUS,Z
		RETLW		1
		MOVF		PBP_AARGH,W
		SUBWF		PBP_BARGH,W
		BTFSS		STATUS,C
		RETLW		0
		BTFSS		STATUS,Z
		RETLW		1
		MOVF		PBP_AARGHH,W
		SUBWF		PBP_BARGHH,W
		BTFSS		STATUS,C
		RETLW		0
		BTFSS		STATUS,Z
		RETLW		1
		MOVF		PBP_AARGHHH,W
		SUBWF		PBP_BARGHHH,W
		BTFSS		STATUS,C
		RETLW		0
		BTFSS		STATUS,Z
		RETLW		1
		RETLW		0
TAGTB@32O	
		BTFSS		PBP_AARGH,7
		RETLW		1
		RETLW		0
NOLIST
endif
NOLIST
ifdef TAGEB@32_REQ
LIST
TAGEB@32		
		MOVF		PBP_BARGH,W
		XORWF		PBP_AARGH,W
		MOVWF		_FP_TEMPB0
		BTFSC		_FP_TEMPB0,7
		GOTO		TAGEB@32O
		BTFSC		PBP_BARGH,7
		GOTO		TAGEB@32N
TAGEB@32P	
		MOVF		PBP_BARG,W
		SUBWF		PBP_AARG,W
		BTFSS		STATUS,C
		RETLW		0
		BTFSS		STATUS,Z
		RETLW		1
		MOVF		PBP_BARGH,W
		SUBWF		PBP_AARGH,W
		BTFSS		STATUS,C
		RETLW		0
		BTFSS		STATUS,Z
		RETLW		1
		MOVF		PBP_BARGHH,W
		SUBWF		PBP_AARGHH,W
		BTFSS		STATUS,C
		RETLW		0
		BTFSS		STATUS,Z
		RETLW		1
		MOVF		PBP_BARGHHH,W
		SUBWF		PBP_AARGHHH,W
		BTFSS		STATUS,C
		RETLW		0
		RETLW		1
TAGEB@32N	
		MOVF		PBP_AARG,W
		SUBWF		PBP_BARG,W
		BTFSS		STATUS,C
		RETLW		0
		BTFSS		STATUS,Z
		RETLW		1
		MOVF		PBP_AARGH,W
		SUBWF		PBP_BARGH,W
		BTFSS		STATUS,C
		RETLW		0
		BTFSS		STATUS,Z
		RETLW		1
		MOVF		PBP_AARGHH,W
		SUBWF		PBP_BARGHH,W
		BTFSS		STATUS,C
		RETLW		0
		BTFSS		STATUS,Z
		RETLW		1
		MOVF		PBP_AARGHHH,W
		SUBWF		PBP_BARGHHH,W
		BTFSS		STATUS,C
		RETLW		0
		RETLW		1
TAGEB@32O	
		BTFSS		PBP_AARGH,7
		RETLW		1
		RETLW		0
NOLIST
endif
NOLIST
ifdef TAEQB@32_REQ
LIST
TAEQB@32		
		MOVF		PBP_BARG,W
		SUBWF		PBP_AARG,W
		BTFSS		STATUS,Z
		RETLW		0
		MOVF		PBP_BARGH,W
		SUBWF		PBP_AARGH,W
		BTFSS		STATUS,Z
		RETLW		0
		MOVF		PBP_BARGHH,W
		SUBWF		PBP_AARGHH,W
		BTFSS		STATUS,Z
		RETLW		0
		MOVF		PBP_BARGHHH,W
		SUBWF		PBP_AARGHHH,W
		BTFSS		STATUS,Z
		RETLW		0
		RETLW		1
NOLIST
endif
NOLIST
ifdef TANEB@32_REQ
LIST
TANEB@32		
		MOVF		PBP_BARG,W
		SUBWF		PBP_AARG,W
		BTFSS		STATUS,Z
		RETLW		1
		MOVF		PBP_BARGH,W
		SUBWF		PBP_AARGH,W
		BTFSS		STATUS,Z
		RETLW		1
		MOVF		PBP_BARGHH,W
		SUBWF		PBP_AARGHH,W
		BTFSS		STATUS,Z
		RETLW		1
		MOVF		PBP_BARGHHH,W
		SUBWF		PBP_AARGHHH,W
		BTFSS		STATUS,Z
		RETLW		1
		RETLW		0
endif
NOLIST
ifdef FPS@32_REQ
LIST
FPA@32_REQ = 1
FPS@32  MOVF		PBP_BARG,W		
		BTFSC		STATUS,Z		
		RETLW		0 
		MOVLW		0x80
		XORWF		PBP_BARGH,F
NOLIST
endif
LIST	
NOLIST
ifdef FPA@32_REQ
LIST
NRM@3232_REQ = 1
NRMRND4032_REQ = 1
NRM@4032_REQ = 1
SETFOV@32_REQ = 1
FPA@32   MOVF		PBP_AARGH,W		
		XORWF		PBP_BARGH,W
		MOVWF		_FP_TEMP
		CLRF		_AEXP			
		CLRF		_BEXP
		MOVF		PBP_AARG,W		
		SUBWF		PBP_BARG,W
		BTFSS		STATUS,C
		Goto		USEA@32
		MOVF		 PBP_BARG,W		
		MOVWF		_AARGB5			
		MOVF		 PBP_AARG,W
		MOVWF		PBP_BARG
		MOVF		_AARGB5,W
		MOVWF		PBP_AARG
		MOVF		 PBP_BARGH,W
		MOVWF		_AARGB5
		MOVF		 PBP_AARGH,W
		MOVWF		PBP_BARGH
		MOVF		 _AARGB5,W
		MOVWF		PBP_AARGH
		MOVF		 PBP_BARGHH,W
		MOVWF		_AARGB5
		MOVF		 PBP_AARGHH,W
		MOVWF		PBP_BARGHH
		MOVF		 _AARGB5,W
		MOVWF		PBP_AARGHH
		MOVF		 PBP_BARGHHH,W
		MOVWF		_AARGB5
		MOVF		 PBP_AARGHHH,W
		MOVWF		PBP_BARGHHH
		MOVF		 _AARGB5,W
		MOVWF		PBP_AARGHHH
USEA@32 MOVF		 PBP_BARG,W		
		BTFSC		STATUS,Z
		RETLW		0
		MOVF		 PBP_AARGH,W
		MOVWF		_SIGN		  	
		BSF			PBP_AARGH,7		
		BSF			PBP_BARGH,7
		MOVF		 PBP_BARG,W		
		SUBWF		PBP_AARG,W
		MOVWF		PBP_BARG
		BTFSC		STATUS,Z
		Goto		ALIGNED@32
		MOVLW		8
		SUBWF		PBP_BARG,W
		BTFSS		STATUS,C		
		Goto		 ALIGNB@32
		MOVWF		PBP_BARG
		MOVF		 PBP_BARGHHH,W		
		MOVWF		_BEXP
		MOVF		 PBP_BARGHH,W
		MOVWF		PBP_BARGHHH
		MOVF		 PBP_BARGH,W
		MOVWF		PBP_BARGHH
		CLRF		 PBP_BARGH
		MOVLW		8
		SUBWF		PBP_BARG,W
		BTFSS		STATUS,C		    
		Goto		 ALIGNB@32
		MOVWF		PBP_BARG
		MOVF		 PBP_BARGHHH,W		
		MOVWF		_BEXP
		MOVF		 PBP_BARGHH,W
		MOVWF		PBP_BARGHHH
		CLRF		 PBP_BARGHH
		MOVLW		8
		SUBWF		PBP_BARG,W
		BTFSS		STATUS,C		    
		Goto		ALIGNB@32
		MOVF		_SIGN,W
		MOVWF		PBP_AARGH
		RETLW		0
ALIGNB@32        
		MOVF		 PBP_BARG,W		
		BTFSC		STATUS,Z
		Goto		 ALIGNED@32
ALOOPB@32        
		BCF			STATUS,C		    
		RRF			PBP_BARGH,F
		RRF			PBP_BARGHH,F
		RRF			PBP_BARGHHH,F
		RRF			_BEXP,F
		DECFSZ      PBP_BARG,F
		Goto		ALOOPB@32
ALIGNED@32       
		BTFSS		 _FP_TEMP,7		
		Goto		 AOK@32
		COMF		 _BEXP,F
		COMF		 PBP_BARGHHH,F
		COMF		 PBP_BARGHH,F
		COMF		 PBP_BARGH,F
		INCF		 _BEXP,F
		BTFSC		STATUS,Z
		INCF		 PBP_BARGHHH,F
		BTFSC		STATUS,Z
		INCF		PBP_BARGHH,F
		BTFSC		STATUS,Z
		INCF		PBP_BARGH,F
AOK@32
		MOVF   		_BEXP,W
		ADDWF   	_AEXP,F
		MOVF		PBP_BARGHHH,W
		BTFSC		STATUS,C
		INCFSZ      PBP_BARGHHH,W
		ADDWF		PBP_AARGHHH,F
		MOVF		PBP_BARGHH,W
		BTFSC		STATUS,C
		INCFSZ      PBP_BARGHH,W
		ADDWF		PBP_AARGHH,F
		MOVF		PBP_BARGH,W
		BTFSC		STATUS,C
		INCFSZ      PBP_BARGH,W
		ADDWF		PBP_AARGH,F
		BTFSC		_FP_TEMP,7
		Goto		ACOMP@32
		BTFSS		STATUS,C
		Goto		NRMRND@4032
		RRF			PBP_AARGH,F		 
		RRF			PBP_AARGHH,F
		RRF			PBP_AARGHHH,F
		RRF			_AEXP,F
		INCFSZ      PBP_AARG,F
		Goto		NRMRND@4032
		Goto		SETFOV@32
ACOMP@32 BTFSC		STATUS,C
		Goto		NRM@4032			
		COMF		_AEXP,F
		COMF		PBP_AARGHHH,F		
		COMF		PBP_AARGHH,F		
		COMF		PBP_AARGH,F
		INCF		_AEXP,F
		BTFSC		STATUS,Z
		INCF		PBP_AARGHHH,F
		BTFSC		STATUS,Z
		INCF		PBP_AARGHH,F
		BTFSC		STATUS,Z
		INCF		PBP_AARGH,F
		MOVLW		0x80
		XORWF		_SIGN,F
		Goto		NRM@3232
NOLIST
endif
NOLIST	
ifdef FPD@32_REQ
LIST
RES0@32_REQ = 1
SETFUN@32_REQ = 1
SETFOV@32_REQ = 1
FPD@32		
		MOVF		 PBP_BARG,W		
		BTFSC		STATUS,Z
		Goto		 SETFDZ@32
		MOVF		 PBP_AARG,W
		BTFSC		STATUS,Z
		Goto		 RES0@32
D32@BNE0         
		MOVF		 PBP_AARGH,W
		XORWF		PBP_BARGH,W
		MOVWF		_SIGN		  
		BSF			PBP_AARGH,7		 
		BSF			PBP_BARGH,7
TALIGN@32        
		CLRF		 _FP_TEMP		  
		MOVF		 PBP_AARGH,W
		MOVWF		_AEXP			
		MOVF		 PBP_AARGHH,W
		MOVWF		_AARGB4
		MOVF		 PBP_AARGHHH,W
		MOVWF		_AARGB5
		MOVF		 PBP_BARGHHH,W
		SUBWF		_AARGB5,F
		MOVF		 PBP_BARGHH,W
		BTFSS		STATUS,C
		INCFSZ      PBP_BARGHH,W
TS1ALIGN@32      
		SUBWF		_AARGB4,F
		MOVF		 PBP_BARGH,W
		BTFSS		STATUS,C
		INCFSZ      PBP_BARGH,W
TS2ALIGN@32      
		SUBWF		_AEXP,F
		CLRF		 _AEXP
		CLRF		 _AARGB4
		CLRF		 _AARGB5
		BTFSS		STATUS,C
		Goto		 DALIGN32@OK
		BCF			STATUS,C		    
		RRF			PBP_AARGH,F
		RRF			PBP_AARGHH,F
		RRF			PBP_AARGHHH,F
		RRF			_AEXP,F
		MOVLW		0x01
		MOVWF		_FP_TEMP		           
DALIGN32@OK      
		MOVF		 PBP_BARG,W		
		SUBWF		PBP_AARG,F
		BTFSS		STATUS,C
		Goto		 ALTB@32        
AGEB@32          
		MOVLW		0X7F-1
		ADDWF		_FP_TEMP,W
		ADDWF		PBP_AARG,F
		BTFSC		STATUS,C
		Goto		 SETFOV@32
		Goto		 DARGOK@32		
ALTB@32          
		MOVLW		0X7F-1
		ADDWF		_FP_TEMP,W
		ADDWF		PBP_AARG,F
		BTFSS		STATUS,C
		Goto		 SETFUN@32		
DARGOK@32        
		MOVLW		0x18			
		MOVWF		_FP_TEMPB1
DLOOP@32         
		RLF			_AARGB5,F		
		RLF			_AARGB4,F
		RLF			_AEXP,F
		RLF			PBP_AARGHHH,F
		RLF			PBP_AARGHH,F
		RLF			PBP_AARGH,F
		RLF			_FP_TEMP,F
		MOVF		PBP_BARGHHH,W		
		SUBWF		PBP_AARGHHH,F
		MOVF		 PBP_BARGHH,W
		BTFSS		STATUS,C
		INCFSZ      PBP_BARGHH,W
DS1@32		
		SUBWF		PBP_AARGHH,F
		MOVF		PBP_BARGH,W
		BTFSS		STATUS,C
		INCFSZ      PBP_BARGH,W
DS2@32		
		SUBWF		PBP_AARGH,F
		RLF			PBP_BARGH,W
		IORWF		_FP_TEMP,F		
		BTFSS		_FP_TEMP,0		
		Goto		 DREST@32
		BSF			_AARGB5,0
		Goto		DOK@32
DREST@32         
		MOVF		PBP_BARGHHH,W		
		ADDWF		PBP_AARGHHH,F
		MOVF		PBP_BARGHH,W
		BTFSC		STATUS,C
		INCFSZ      PBP_BARGHH,W
DAREST@32        
		ADDWF		PBP_AARGHH,F

		MOVF		 PBP_BARGH,W
		BTFSC		STATUS,C
		INCF		PBP_BARGH,W
		ADDWF		PBP_AARGH,F
		BCF			_AARGB5,0
DOK@32		
		DECFSZ      _FP_TEMPB1,F
		Goto		DLOOP@32
DROUND@32        
		BTFSC		_FP_FLAGS,6
		BTFSS		_AARGB5,0
		Goto		DIV32@OK
		BCF			STATUS,C
		RLF			PBP_AARGHHH,F		  
		RLF			PBP_AARGHH,F		  
		RLF			PBP_AARGH,F
		RLF			_FP_TEMP,F
		MOVF		PBP_BARGHHH,W		 
		SUBWF		PBP_AARGHHH,F
		MOVF		PBP_BARGHH,W
		BTFSS		STATUS,C
		INCFSZ      PBP_BARGHH,W
		SUBWF		PBP_AARGHH,F
		MOVF		PBP_BARGH,W
		BTFSS		STATUS,C
		INCFSZ      PBP_BARGH,W
		SUBWF		PBP_AARGH,F
		RLF			PBP_BARGH,W
		IORWF		_FP_TEMP,W
		ANDLW		0x01		 
		ADDWF		_AARGB5,F
		BTFSC		STATUS,C
		INCF		_AARGB4,F
		BTFSC		STATUS,Z
		INCF		_AEXP,F
		BTFSS		STATUS,Z		    
		Goto		 DIV32@OK
		RRF			_AEXP,F
		RRF			_AARGB4,F
		RRF			_AARGB5,F
		INCF		PBP_AARG,F
		BTFSC		STATUS,Z		    
		Goto		SETFOV@32
DIV32@OK         
		BTFSS		_SIGN,7
		BCF			_AEXP,7				
		MOVF		_AEXP,W
		MOVWF		PBP_AARGH			
		MOVF		_AARGB4,W
		MOVWF		PBP_AARGHH
		MOVF		 _AARGB5,W
		MOVWF		PBP_AARGHHH
		RETLW		0
SETFDZ@32        
		BSF			_FP_FLAGS,3			
		RETLW		255
 NOLIST
endif
  NOLIST	
ifdef FPM@32_REQ
LIST
RES0@32_REQ = 1
SETFOV@32_REQ = 1
SETFUN@32_REQ = 1
FPM@32		
		MOVF		 PBP_AARG,W		
		BTFSS		STATUS,Z
		MOVF		 PBP_BARG,W
		BTFSC		STATUS,Z
		Goto		 RES0@32
M32@BNE0         
		MOVF		 PBP_AARGH,W
		XORWF		PBP_BARGH,W
		MOVWF		_SIGN		  
		MOVF		 PBP_BARG,W
		ADDWF		PBP_AARG,F
		MOVLW		0X7F-1
		BTFSS		STATUS,C
		Goto		 MTUN@32
		SUBWF		PBP_AARG,F
		BTFSC		STATUS,C
		Goto		 SETFOV@32		
		Goto		 MOK@32
MTUN@32          
		SUBWF		PBP_AARG,F
		BTFSS		STATUS,C
		Goto		 SETFUN@32
MOK@32		
		MOVF		PBP_AARGH,W
		MOVWF		_AEXP
		MOVF		PBP_AARGHH,W
		MOVWF		_AARGB4
		MOVF		PBP_AARGHHH,W
		MOVWF		_AARGB5
		BSF			_AEXP,7		 
		BSF			PBP_BARGH,7
		BCF			STATUS,C
		CLRF		 PBP_AARGH			
		CLRF		 PBP_AARGHH
		CLRF		 PBP_AARGHHH
		MOVLW		0x18
		MOVWF		_FP_TEMP		  
MLOOP@32         
		BTFSS		_AARGB5,0		
		Goto		 MNOADD@32
MADD@32          
		MOVF		 PBP_BARGHHH,W
		ADDWF		PBP_AARGHHH,F
		MOVF		 PBP_BARGHH,W
		BTFSC		STATUS,C
		INCFSZ      PBP_BARGHH,W
		ADDWF		PBP_AARGHH,F
		MOVF		 PBP_BARGH,W
		BTFSC		STATUS,C
		INCFSZ      PBP_BARGH,W
		ADDWF		PBP_AARGH,F
MNOADD@32        
		RRF			PBP_AARGH,F
		RRF			PBP_AARGHH,F
		RRF			PBP_AARGHHH,F
		RRF			_AEXP,F
		RRF			_AARGB4,F
		RRF			_AARGB5,F
		BCF			STATUS,C
		DECFSZ      _FP_TEMP,F
		Goto		MLOOP@32
		BTFSC		PBP_AARGH,7		  
		Goto		 MROUND@32
		RLF			_AEXP,F
		RLF			PBP_AARGHHH,F
		RLF			PBP_AARGHH,F
		RLF			PBP_AARGH,F
		DECF		 PBP_AARG,F
MROUND@32        
		BTFSC		_FP_FLAGS,6
		BTFSS		PBP_AARGHHH,0
		Goto		 MUL32@OK
		BTFSS		_AEXP,7
		Goto		 MUL32@OK
		INCF		PBP_AARGHHH,F
		BTFSC		STATUS,Z
		INCF		 PBP_AARGHH,F
		BTFSC		STATUS,Z
		INCF		 PBP_AARGH,F
		BTFSS		STATUS,Z		    
		Goto		 MUL32@OK
		RRF			PBP_AARGH,F		
		RRF			PBP_AARGHH,F
		RRF			PBP_AARGHHH,F
		INCF		 PBP_AARG,F
		BTFSC		STATUS,Z		   
		Goto		 SETFOV@32
MUL32@OK         
		BTFSS		_SIGN,7
		BCF			PBP_AARGH,7		
		RETLW		0  
NOLIST
endif	
 NOLIST
ifdef INT@3232_REQ
LIST
INT@3232
		MOVF		PBP_AARG,W
		MOVWF		_AEXP		
		CLRF		PBP_AARG
		MOVF		_AEXP,W		
		BTFSC		STATUS,Z
		RETLW		0
		MOVF		PBP_AARGH,W		
		MOVWF		_SIGN
		BSF			PBP_AARGH,7		
		MOVLW		0X7F+0x1F		
		SUBWF		_AEXP,F
		BTFSS		_AEXP,7
		Goto		 SETIOV@32
		COMF		_AEXP,F
		INCF		_AEXP,F        
		MOVLW		8		     	
		SUBWF		_AEXP,W
		BTFSS		STATUS,C
		Goto		TSHIFT@3232
		MOVWF		_AEXP
		RLF			PBP_AARG,F		
		MOVF		PBP_AARGHHH,W
		MOVWF		PBP_AARG
		MOVF		PBP_AARGHH,W
		MOVWF		PBP_AARGHHH
		MOVF		 PBP_AARGH,W
		MOVWF		PBP_AARGHH
		CLRF		PBP_AARGH
		MOVLW		8		     	
		SUBWF		_AEXP,W
		BTFSS		STATUS,C
		Goto		 TSHIFT@3232
		MOVWF		_AEXP
		RLF			PBP_AARG,F		
		MOVF		 PBP_AARGHHH,W
		MOVWF		PBP_AARG
		MOVF		 PBP_AARGHH,W
		MOVWF		PBP_AARGHHH
		CLRF		 PBP_AARGHH
		MOVLW		8		     	
		SUBWF		_AEXP,W
		BTFSS		STATUS,C
		Goto		TSHIFT@3232
		MOVWF		_AEXP
		RLF			PBP_AARG,F		
		MOVF		PBP_AARGHHH,W
		MOVWF		PBP_AARG
		CLRF		PBP_AARGHHH
		MOVLW		8		     	
		SUBWF		_AEXP,W
		BTFSS		STATUS,C
		Goto		 TSHIFT@3232
		MOVWF		_AEXP
		RLF			PBP_AARG,F		
		CLRF		 PBP_AARG
		MOVF		_AEXP,W
		BTFSS		STATUS,Z
		BCF			STATUS,C
		Goto		SHIFT@3232@OK
TSHIFT@3232      
		MOVF		_AEXP,W		 	
		BTFSC		STATUS,Z
		Goto		SHIFT@3232@OK
SHIFT@3232       
		BCF			STATUS,C
		RRF			PBP_AARGH,F		
		RRF			PBP_AARGHH,F
		RRF			PBP_AARGHHH,F
		RRF			PBP_AARG,F
		DECFSZ      _AEXP,F
		Goto		SHIFT@3232
SHIFT@3232@OK     
		BTFSC		_FP_FLAGS,6
		BTFSS		PBP_AARG,0
		Goto		 INT@3232@OK
		BTFSS		STATUS,C
		Goto		 INT@3232@OK
		INCF		 PBP_AARG,F
		BTFSC		STATUS,Z
		INCF		 PBP_AARGHHH,F
		BTFSC		STATUS,Z
		INCF		 PBP_AARGHH,F
		BTFSC		STATUS,Z
		INCF		 PBP_AARGH,F
		BTFSC		PBP_AARGH,7		
		Goto		 SETIOV@3224
INT@3232@OK       
		BTFSS		_SIGN,7					  
		GOTO		INT@32_RET
		COMF		 PBP_AARGH,F
		COMF		 PBP_AARGHH,F
		COMF		 PBP_AARGHHH,F
		COMF		 PBP_AARG,F
		INCF		 PBP_AARG,F
		BTFSC		STATUS,Z
		INCF		 PBP_AARGHHH,F
		BTFSC		STATUS,Z
		INCF		 PBP_AARGHH,F
		BTFSC		STATUS,Z
		INCF		 PBP_AARGH,F
		GOTO		INT@32_RET
IRES0@32         
		CLRF		 PBP_AARGH		
		CLRF		 PBP_AARGHH
		CLRF		 PBP_AARGHHH
		CLRF		 PBP_AARG
		GOTO		INT@32_RET
SETIOV@32        
		BSF			_FP_FLAGS,0		
		BTFSS		_FP_FLAGS,7		
		GOTO		INT@32_RET
		CLRF		 PBP_AARGH		
		BTFSS		_SIGN,7		
		MOVLW		255
		MOVWF		PBP_AARGH			
		MOVWF		PBP_AARGHH			
		MOVWF		PBP_AARGHHH
		MOVWF		PBP_AARG
		RLF			_SIGN,F
		RRF			PBP_AARGH,F
		GOTO		INT@32_RET
SETIOV@3224	
		BSF			_FP_FLAGS,0	
		BTFSS		_FP_FLAGS,7		
		RETLW		255
		CLRF		PBP_AARGH			
		BTFSS		_SIGN,7			
		MOVLW		255
		MOVWF		PBP_AARGH
		MOVWF		PBP_AARGHH
		MOVWF		PBP_AARGHHH
		RLF			_SIGN,F
		RRF			PBP_AARGH,F
INT@32_RET		
		MOVF		PBP_AARG,W
		RETURN
NOLIST
endif
NOLIST
ifdef FLO@0832U_REQ
LIST
FLO@1632U_REQ = 1
FLO@3232S_REQ = 1
FLO@0832U
		Movwf PBP_AARG
		Clrf PBP_AARGH
; Fall through to 16-bit Integer to Float
NOLIST	
endif
NOLIST
ifdef FLO@1632U_REQ
LIST
FLO@3232S_REQ = 1
FLO@1632U
		Clrf PBP_AARGHH
		Clrf PBP_AARGHHH		
		; Fall through to 32-bit Integer to Float
NOLIST
endif
NOLIST
ifdef FLO@3232S_REQ
LIST
NRM@4032_REQ = 1
FLO@3232S         
		MOVF		PBP_AARG,W
		MOVWF		_AEXP
		MOVF		PBP_AARGHHH,W
		MOVWF		PBP_AARG		
		MOVF		PBP_AARGH,W
		MOVWF		PBP_AARGHHH
		MOVF		PBP_AARG,W		
		MOVWF		PBP_AARGH		
		MOVLW		0x1F+0X7F		
		MOVWF		PBP_AARG
		CLRF		_SIGN
		BTFSS		PBP_AARGH,7		
		Goto		NRM@4032
		COMF		_AEXP,F			
		COMF		PBP_AARGHHH,F
		COMF		PBP_AARGHH,F
		COMF		PBP_AARGH,F
		INCF		_AEXP,F
		BTFSC		STATUS,Z
		INCF		PBP_AARGHHH,F
		BTFSC		STATUS,Z
		INCF		PBP_AARGHH,F
		BTFSC		STATUS,Z
		INCF		PBP_AARGH,F
		BSF			_SIGN,7
NOLIST
endif
NOLIST
ifdef NRM@4032_REQ
LIST
NRMRND@4032_REQ = 1
SETFUN@32_REQ = 1
RES0@32_REQ = 1
SETFOV@32_REQ = 1
FIX_SIGN@32_REQ = 1
NRM@4032         
		CLRF		 _FP_TEMP			
		MOVF		 PBP_AARGH,W		
		BTFSS		STATUS,Z
		Goto		 NORM@4032
		MOVF		 PBP_AARGHH,W		
		MOVWF		PBP_AARGH
		MOVF		 PBP_AARGHHH,W
		MOVWF		PBP_AARGHH
		MOVF		 _AEXP,W
		MOVWF		PBP_AARGHHH
		CLRF		 _AEXP
		BSF			_FP_TEMP,3
		MOVF		 PBP_AARGH,W
		BTFSS		STATUS,Z
		Goto		 NORM@4032
		MOVF		 PBP_AARGHH,W
		MOVWF		PBP_AARGH
		MOVF		 PBP_AARGHHH,W
		MOVWF		PBP_AARGHH
		CLRF		 PBP_AARGHHH
		BCF			_FP_TEMP,3
		BSF			_FP_TEMP,4        
		MOVF		 PBP_AARGH,W
		BTFSS		STATUS,Z
		Goto		 NORM@4032
		MOVF		 PBP_AARGHH,W
		MOVWF		PBP_AARGH
		CLRF		 PBP_AARGHH
		BSF			_FP_TEMP,3      
		MOVF		 PBP_AARGH,W
		BTFSC		STATUS,Z
		Goto		 RES0@32
NORM@4032        
		MOVF		 _FP_TEMP,W
		SUBWF		PBP_AARG,F
		BTFSS		STATUS,Z
		BTFSS		STATUS,C
		Goto		 SETFUN@32
		BCF			STATUS,C		
NORM@4032A       
		BTFSC		PBP_AARGH,7
		Goto		 NRMRND@4032
		RLF			_AEXP,F
		RLF			PBP_AARGHHH,F
		RLF			PBP_AARGHH,F
		RLF			PBP_AARGH,F
		DECFSZ       PBP_AARG,F
		Goto		 NORM@4032A
		Goto		 SETFUN@32
NOLIST
endif	
NOLIST
ifdef NRMRND@4032_REQ
LIST
SETFOV@32_REQ = 1
FIX_SIGN@32_REQ = 1
NRMRND@4032      
		BTFSC		_FP_FLAGS,6
		BTFSS		PBP_AARGHHH,0
		Goto		 FIX_SIGN@32
		BTFSS		_AEXP,7				
		Goto		 FIX_SIGN@32
		INCF		PBP_AARGHHH,F
		BTFSC		STATUS,Z
		INCF		 PBP_AARGHH,F
		BTFSC		STATUS,Z
		INCF		 PBP_AARGH,F
		BTFSS		STATUS,Z		    
		Goto		 FIX_SIGN@32
		RRF			PBP_AARGH,F			
		RRF			PBP_AARGHH,F
		RRF			PBP_AARGHHH,F
		INCF		 PBP_AARG,F
		BTFSC		STATUS,Z		    
		Goto		 SETFOV@32
		Goto		 FIX_SIGN@32
NOLIST
endif
NOLIST
ifdef NRM@3232_REQ
LIST
FIX_SIGN@32_REQ = 1
RES0@32_REQ = 1
SETFUN@32_REQ = 1
NRM@3232	
		CLRF		 _FP_TEMP			
		MOVF		 PBP_AARGH,W		
		BTFSS		STATUS,Z
		Goto		 NORM@3232
		MOVF		 PBP_AARGHH,W		
		MOVWF		PBP_AARGH
		MOVF		 PBP_AARGHHH,W
		MOVWF		PBP_AARGHH
		CLRF		 PBP_AARGHHH
		BSF			_FP_TEMP,3			
		MOVF		 PBP_AARGH,W		
		BTFSS		STATUS,Z
		Goto		 NORM@3232
		MOVF		 PBP_AARGHH,W		
		MOVWF		PBP_AARGH
		CLRF		 PBP_AARGHH
		BCF			_FP_TEMP,3			
		BSF			_FP_TEMP,4        
		MOVF		 PBP_AARGH,W		
		BTFSC		STATUS,Z
		Goto		 RES0@32
NORM@3232        
		MOVF		 _FP_TEMP,W
		SUBWF		PBP_AARG,F
		BTFSS		STATUS,Z
		BTFSS		STATUS,C
		Goto		 SETFUN@32
		BCF			STATUS,C			
NORM@3232A       
		BTFSC		PBP_AARGH,7			
		Goto		 FIX_SIGN@32
		RLF			PBP_AARGHHH,F		
		RLF			PBP_AARGHH,F		
		RLF			PBP_AARGH,F
		DECFSZ      PBP_AARG,F
		Goto		NORM@3232A
NOLIST
endif
NOLIST
ifdef SETFUN@32_REQ
LIST
SETFUN@32        
		BSF			_FP_FLAGS,2			
		BTFSS		_FP_FLAGS,7		
		RETLW		255
		MOVLW		1		  			
		MOVWF		PBP_AARG		  	
		CLRF		PBP_AARGH			
		CLRF		PBP_AARGHH
		CLRF		PBP_AARGHHH
		RLF			_SIGN,F
		RRF			PBP_AARGH,F
		RETLW		255
NOLIST
endif
NOLIST
ifdef SETFOV@32_REQ
LIST
SETFOV@32        
		BSF			_FP_FLAGS,1
		BTFSS		_FP_FLAGS,7	
		RETLW		255	
		MOVLW		255
		MOVWF		PBP_AARG
		MOVWF		PBP_AARGH
		MOVWF		PBP_AARGHH	
		MOVWF		PBP_AARGHHH
		RLF			_SIGN,F
		RRF			PBP_AARGH,F
		RETLW		255
NOLIST
endif
NOLIST
ifdef FIX_SIGN@32_REQ
LIST
FIX_SIGN@32       
		BTFSS		_SIGN,7
		BCF			PBP_AARGH,7
		RETLW		0
NOLIST
endif
NOLIST	
ifdef RES0@32_REQ
LIST
RES0@32          
		CLRF		 PBP_AARGH
		CLRF		 PBP_AARGHH
		CLRF		 PBP_AARGHHH
		CLRF		_AEXP
		CLRF		 PBP_AARG
		RETLW		0
NOLIST
endif
LIST